AUTOSAR XML (schema 4-0-3)
package /DaVinci_Project
  module config Com
    ComConfig
      9 x ComSignalGroup:
        SG_Sig_Grp_0x110_oSupA_Led_State_oDBCNetWork_89d57c9b_Tx
          4 x ComGroupSignal, all with ComSignalType=BOOLEAN:
            Led1_State_oSupA_Led_State_oDBCNetWork_987486a5_Tx
            Led2_State_oSupA_Led_State_oDBCNetWork_13a7b8bc_Tx
            Led3_State_oSupA_Led_State_oDBCNetWork_dc39af74_Tx
            Led4_State_oSupA_Led_State_oDBCNetWork_df70c2cf_Tx
        SG_Sig_Grp_0x111_oSupA_Button_State_oDBCNetWork_062df960_Tx
          4 x ComGroupSignal, all with ComSignalType=BOOLEAN:
            Button1_State_oSupA_Button_State_oDBCNetWork_f13c0622_Tx
            Button2_State_oSupA_Button_State_oDBCNetWork_bcd40645_Tx
            Button3_State_oSupA_Button_State_oDBCNetWork_315cfba7_Tx
            Button4_State_oSupA_Button_State_oDBCNetWork_2704068b_Tx
        SG_Sig_Grp_0x112_oSupA_PowerMode_oDBCNetWork_bbf37b55_Tx
          3 x ComGroupSignal, all with ComSignalType=UINT8:
            PowerMode_oSupA_PowerMode_oDBCNetWork_c3b722c7_Tx
            SupA_Checksum_0x112_oSupA_PowerMode_oDBCNetWork_3f776c50_Tx
            SupA_Counter_0x112_oSupA_PowerMode_oDBCNetWork_5e5c6751_Tx
        SG_Sig_Grp_0x113_oSupA_Angle_oDBCNetWork_c5c2558a_Tx
          AAA_Angle_oSupA_Angle_oDBCNetWork_1adb3bf0_Tx (ComGroupSignal): ComSignalType=UINT8
        SG_Sig_Grp_0x114_oSupA_Function_1_oDBCNetWork_fe007f55_Tx
          5 x ComGroupSignal:
            Sig_0x114_Used_1_oSupA_Function_1_oDBCNetWork_6c3a7273_Tx: ComSignalType=UINT8
            Sig_0x114_Used_2_oSupA_Function_1_oDBCNetWork_289b576b_Tx: ComSignalType=UINT16
            Sig_0x114_Used_3_oSupA_Function_1_oDBCNetWork_14fbb463_Tx: ComSignalType=UINT16
            Sig_0x114_Used_4_oSupA_Function_1_oDBCNetWork_a1d91d5b_Tx: ComSignalType=UINT16
            Sig_0x114_Used_5_oSupA_Function_1_oDBCNetWork_9db9fe53_Tx: ComSignalType=UINT8
        SG_Sig_Grp_0x400_oSupB_Led_Control_oDBCNetWork_6275ac6f_Rx: ComNotification=Rte_COMCbk_SG_Sig_Grp_0x400_oSupB_Led_Control_oDBCNetWork_6275ac6f_Rx
          9 x ComGroupSignal:
            CrcSig_Pack_0_oSupB_Led_Control_oDBCNetWork_ecfc9a83_Rx: ComSignalType=UINT8
            CrcSig_Pack_1_oSupB_Led_Control_oDBCNetWork_e21b7252_Rx: ComSignalType=UINT32
            CrcSig_Pack_2_oSupB_Led_Control_oDBCNetWork_f1334b21_Rx: ComSignalType=UINT32
            Led1_Control_oSupB_Led_Control_oDBCNetWork_48297120_Rx: ComSignalType=BOOLEAN
            Led2_Control_oSupB_Led_Control_oDBCNetWork_9bb26ddb_Rx: ComSignalType=BOOLEAN
            Led3_Control_oSupB_Led_Control_oDBCNetWork_d53b6672_Rx: ComSignalType=BOOLEAN
            Led4_Control_oSupB_Led_Control_oDBCNetWork_e7f5526c_Rx: ComSignalType=BOOLEAN
            SupB_Checksum_0x400_oSupB_Led_Control_oDBCNetWork_1c8bf5dc_Rx: ComSignalType=UINT8
            SupB_Counter_0x400_oSupB_Led_Control_oDBCNetWork_2dd3ae1e_Rx: ComSignalType=UINT8
        SG_Sig_Grp_0x401_oSupB_Button_Control_oDBCNetWork_41809065_Rx
          4 x ComGroupSignal, all with ComSignalType=BOOLEAN:
            Button1_Control_oSupB_Button_Control_oDBCNetWork_cbcdfbc4_Rx
            Button2_Control_oSupB_Button_Control_oDBCNetWork_f3f670b7_Rx
            Button3_Control_oSupB_Button_Control_oDBCNetWork_52cff459_Rx
            Button4_Control_oSupB_Button_Control_oDBCNetWork_83816651_Rx
        SG_Sig_Grp_0x402_oSupC_Function_1_oDBCNetWork_20ce0e3b_Rx
          5 x ComGroupSignal:
            Sig_0x402_Used_1_oSupC_Function_1_oDBCNetWork_23971e12_Rx: ComSignalType=UINT8
            Sig_0x402_Used_2_oSupC_Function_1_oDBCNetWork_67363b0a_Rx: ComSignalType=UINT16
            Sig_0x402_Used_3_oSupC_Function_1_oDBCNetWork_5b56d802_Rx: ComSignalType=UINT16
            Sig_0x402_Used_4_oSupC_Function_1_oDBCNetWork_ee74713a_Rx: ComSignalType=UINT16
            Sig_0x402_Used_5_oSupC_Function_1_oDBCNetWork_d2149232_Rx: ComSignalType=UINT16
        SG_Sig_Grp_0x403_oSupC_Function_2_oDBCNetWork_a16481fd_Rx
          5 x ComGroupSignal:
            Sig_0x403_Used_1_oSupC_Function_2_oDBCNetWork_1ead65c3_Rx: ComSignalType=UINT8
            Sig_0x403_Used_2_oSupC_Function_2_oDBCNetWork_5a0c40db_Rx: ComSignalType=UINT16
            Sig_0x403_Used_3_oSupC_Function_2_oDBCNetWork_666ca3d3_Rx: ComSignalType=UINT16
            Sig_0x403_Used_4_oSupC_Function_2_oDBCNetWork_d34e0aeb_Rx: ComSignalType=UINT16
            Sig_0x403_Used_5_oSupC_Function_2_oDBCNetWork_ef2ee9e3_Rx: ComSignalType=UINT16
      Sig_0x114_Used_6_oSupA_Function_1_oDBCNetWork_d918db4b_Tx (ComSignal): ComSignalType=UINT8
  module config Rte
    21 x RteBswModuleInstance:
      BswM
        BswM_MainFunctionTimingEvent0 (RteBswEventToTaskMapping): RteBswUsedOsEventRef=Rte_Ev_Cyclic2_OsTask_Bsw5ms_Core0_0_5ms, RteBswUsedOsAlarmRef=Os/Rte_Al_TE2_OsTask_Bsw5ms_Core0_0_5ms
      Can
        3 x RteBswEventToTaskMapping:
          Can_MainFunction_BusOffTimingEvent0
          Can_MainFunction_ModeTimingEvent0: RteBswUsedOsEventRef=Rte_Ev_Cyclic2_OsTask_Bsw5ms_Core0_0_5ms, RteBswUsedOsAlarmRef=Os/Rte_Al_TE2_OsTask_Bsw5ms_Core0_0_5ms
          Can_MainFunction_WakeupTimingEvent0: RteBswUsedOsEventRef=Rte_Ev_Cyclic2_OsTask_Bsw5ms_Core0_0_5ms, RteBswUsedOsAlarmRef=Os/Rte_Al_TE2_OsTask_Bsw5ms_Core0_0_5ms
      CanIf
      CanNm
        CanNm_MainFunctionTimingEvent0 (RteBswEventToTaskMapping): RteBswUsedOsEventRef=Rte_Ev_Cyclic2_OsTask_Bsw5ms_Core0_0_5ms, RteBswUsedOsAlarmRef=Os/Rte_Al_TE2_OsTask_Bsw5ms_Core0_0_5ms
      CanSM
        CanSM_MainFunctionTimingEvent0 (RteBswEventToTaskMapping): RteBswUsedOsEventRef=Rte_Ev_Cyclic2_OsTask_Bsw5ms_Core0_0_5ms, RteBswUsedOsAlarmRef=Os/Rte_Al_TE2_OsTask_Bsw5ms_Core0_0_5ms
      CanTp
        CanTp_MainFunctionTimingEvent0 (RteBswEventToTaskMapping): RteBswUsedOsEventRef=Rte_Ev_Cyclic2_OsTask_Bsw5ms_Core0_0_5ms, RteBswUsedOsAlarmRef=Os/Rte_Al_TE2_OsTask_Bsw5ms_Core0_0_5ms
      CanTrcv
        CanTrcv_30_Tja1043_MainFunctionTimingEvent0 (RteBswEventToTaskMapping): RteBswUsedOsEventRef=Rte_Ev_Cyclic2_OsTask_Bsw5ms_Core0_0_5ms, RteBswUsedOsAlarmRef=Os/Rte_Al_TE2_OsTask_Bsw5ms_Core0_0_5ms
      Com
        Com_MainFunctionRxTimingEvent0 (RteBswEventToTaskMapping): RteBswUsedOsEventRef=Rte_Ev_Cyclic2_OsTask_Bsw5ms_Core0_0_5ms, RteBswUsedOsAlarmRef=Os/Rte_Al_TE2_OsTask_Bsw5ms_Core0_0_5ms
        Com_MainFunctionTxTimingEvent0 (RteBswEventToTaskMapping): RteBswUsedOsEventRef=Rte_Ev_Cyclic2_OsTask_Bsw5ms_Core0_0_5ms, RteBswUsedOsAlarmRef=Os/Rte_Al_TE2_OsTask_Bsw5ms_Core0_0_5ms
      ComM
        ComM_MainFunction_0TimingEvent0 (RteBswEventToTaskMapping): RteBswUsedOsEventRef=Rte_Ev_Cyclic2_OsTask_Bsw5ms_Core0_0_5ms, RteBswUsedOsAlarmRef=Os/Rte_Al_TE2_OsTask_Bsw5ms_Core0_0_5ms
        ComM_MainFunction_1TimingEvent0 (RteBswEventToTaskMapping): RteBswUsedOsEventRef=Rte_Ev_Cyclic2_OsTask_Bsw5ms_Core0_0_20ms, RteBswUsedOsAlarmRef=Os/Rte_Al_TE2_OsTask_Bsw5ms_Core0_0_20ms
      Dcm
        Dcm_MainFunctionTimingEvent0 (RteBswEventToTaskMapping): RteBswUsedOsEventRef=Rte_Ev_Cyclic2_OsTask_Bsw5ms_Core0_0_5ms, RteBswUsedOsAlarmRef=Os/Rte_Al_TE2_OsTask_Bsw5ms_Core0_0_5ms
      Dem
        Dem_MasterMainFunctionTimingEvent0 (RteBswEventToTaskMapping): RteBswUsedOsEventRef=Rte_Ev_Cyclic2_OsTask_Bsw5ms_Core0_0_5ms, RteBswUsedOsAlarmRef=Os/Rte_Al_TE2_OsTask_Bsw5ms_Core0_0_5ms
        Dem_SatelliteMainFunctionTimingEvent0 (RteBswEventToTaskMapping): RteBswUsedOsEventRef=Rte_Ev_Cyclic2_OsTask_Bsw5ms_Core0_0_5ms, RteBswUsedOsAlarmRef=Os/Rte_Al_TE2_OsTask_Bsw5ms_Core0_0_5ms
      Det
      Dio
      EcuM
        3 x RteBswEventToTaskMapping:
          EcuM_MainFunctionTimingEvent0: RteBswUsedOsEventRef=Rte_Ev_Cyclic2_OsTask_Bsw5ms_Core0_0_5ms, RteBswUsedOsAlarmRef=Os/Rte_Al_TE2_OsTask_Bsw5ms_Core0_0_5ms
          EcuM_MainFunctionTimingEvent1: RteBswUsedOsEventRef=Rte_Ev_RunS2_EcuM_EcuM_MainFunction, RteBswUsedOsAlarmRef=Os/Rte_Al_TE2_EcuM_EcuM_MainFunction
          EcuM_MainFunctionTimingEvent2: RteBswUsedOsEventRef=Rte_Ev_Cyclic2_OsTask_App10ms_Core2_0_5ms, RteBswUsedOsAlarmRef=Os/Rte_Al_TE2_OsTask_App10ms_Core2_0_5ms
      Icu
      IoHwAb_0
      Irq
      Mcu
      Nm
      PduR
      Port
    20 x RteSwComponentInstance:
      AppButtonCtrl_EcuSwComposition
        TMT_AppButtonCtrl_MainFunction (RteEventToTaskMapping): RteUsedOsEventRef=Rte_Ev_Cyclic_OsTask_App10ms_Core0_0_10ms, RteUsedOsAlarmRef=Os/Rte_Al_TE_OsTask_App10ms_Core0_0_10ms
      AppComRx_EcuSwComposition
        TMT_AppComRx_MainFunction (RteEventToTaskMapping): RteUsedOsEventRef=Rte_Ev_Cyclic_OsTask_App10ms_Core0_0_10ms, RteUsedOsAlarmRef=Os/Rte_Al_TE_OsTask_App10ms_Core0_0_10ms
      AppComTx_EcuSwComposition
        TMT_AppComTx_MainFunction (RteEventToTaskMapping): RteUsedOsEventRef=Rte_Ev_Cyclic_OsTask_App10ms_Core0_0_10ms, RteUsedOsAlarmRef=Os/Rte_Al_TE_OsTask_App10ms_Core0_0_10ms
      AppCtrl_EcuSwComposition
        TMT_AppCtrl_MainFunction (RteEventToTaskMapping): RteUsedOsEventRef=Rte_Ev_Cyclic_OsTask_App10ms_Core0_0_10ms, RteUsedOsAlarmRef=Os/Rte_Al_TE_OsTask_App10ms_Core0_0_10ms
      AppCtrl1_EcuSwComposition
        TMT_AppCtrl1_MainFuntion (RteEventToTaskMapping): RteUsedOsEventRef=Rte_Ev_Run_AppCtrl1_AppCtrl1_MainFuntion, RteUsedOsAlarmRef=Os/Rte_Al_TE_AppCtrl1_AppCtrl1_MainFuntion
      AppCtrl2_EcuSwComposition
        TMT_AppCtrl2_MainFunction (RteEventToTaskMapping): RteUsedOsEventRef=Rte_Ev_Run_AppCtrl2_AppCtrl2_MainFunction, RteUsedOsAlarmRef=Os/Rte_Al_TE_AppCtrl2_AppCtrl2_MainFunction
      AppLedCtrl_EcuSwComposition
        TMT_Runnable (RteEventToTaskMapping): RteUsedOsEventRef=Rte_Ev_Cyclic_OsTask_App10ms_Core0_0_10ms, RteUsedOsAlarmRef=Os/Rte_Al_TE_OsTask_App10ms_Core0_0_10ms
      AppWakeUpCtrl_EcuSwComposition
        TMT_AppWakeUpCtrl_MainFunction (RteEventToTaskMapping): RteUsedOsEventRef=Rte_Ev_Cyclic_OsTask_App10ms_Core0_0_10ms, RteUsedOsAlarmRef=Os/Rte_Al_TE_OsTask_App10ms_Core0_0_10ms
      BswM_EcuSwComposition
        Timer_BswM_MainFunction (RteEventToTaskMapping): RteUsedOsEventRef=Rte_Ev_Cyclic2_OsTask_Bsw5ms_Core0_0_5ms, RteUsedOsAlarmRef=Os/Rte_Al_TE2_OsTask_Bsw5ms_Core0_0_5ms
      ComM_EcuSwComposition
        Timer_ComM_MainFunction_0 (RteEventToTaskMapping): RteUsedOsEventRef=Rte_Ev_Cyclic2_OsTask_Bsw5ms_Core0_0_5ms, RteUsedOsAlarmRef=Os/Rte_Al_TE2_OsTask_Bsw5ms_Core0_0_5ms
        Timer_ComM_MainFunction_1 (RteEventToTaskMapping): RteUsedOsEventRef=Rte_Ev_Cyclic2_OsTask_Bsw5ms_Core0_0_20ms, RteUsedOsAlarmRef=Os/Rte_Al_TE2_OsTask_Bsw5ms_Core0_0_20ms
      Dcm_EcuSwComposition
        Timer_Dcm_MainFunction (RteEventToTaskMapping): RteUsedOsEventRef=Rte_Ev_Cyclic2_OsTask_Bsw5ms_Core0_0_5ms, RteUsedOsAlarmRef=Os/Rte_Al_TE2_OsTask_Bsw5ms_Core0_0_5ms
      DemMaster_0_EcuSwComposition
        Timer_Dem_MasterMainFunction (RteEventToTaskMapping): RteUsedOsEventRef=Rte_Ev_Cyclic2_OsTask_Bsw5ms_Core0_0_5ms, RteUsedOsAlarmRef=Os/Rte_Al_TE2_OsTask_Bsw5ms_Core0_0_5ms
      DemSatellite_0_EcuSwComposition
        Timer_Dem_SatelliteMainFunction (RteEventToTaskMapping): RteUsedOsEventRef=Rte_Ev_Cyclic2_OsTask_Bsw5ms_Core0_0_5ms, RteUsedOsAlarmRef=Os/Rte_Al_TE2_OsTask_Bsw5ms_Core0_0_5ms
      Det_EcuSwComposition
      EcuM_EcuSwComposition
        Timer_EcuM_MainFunction (RteEventToTaskMapping): RteUsedOsEventRef=Rte_Ev_Cyclic2_OsTask_App10ms_Core2_0_5ms, RteUsedOsAlarmRef=Os/Rte_Al_TE2_OsTask_App10ms_Core2_0_5ms
      IcuCdd_EcuSwComposition
        TMT_IcuCdd_MainFunction (RteEventToTaskMapping): RteUsedOsEventRef=Rte_Ev_Cyclic_OsTask_App10ms_Core0_0_10ms, RteUsedOsAlarmRef=Os/Rte_Al_TE_OsTask_App10ms_Core0_0_10ms
      IoHwAb_EcuSwComposition
        Timer_IoHwAb_IoHwAbRunnable (RteEventToTaskMapping): RteUsedOsEventRef=Rte_Ev_Run_IoHwAb_IoHwAb_IoHwAbRunnable, RteUsedOsAlarmRef=Os/Rte_Al_TE_IoHwAb_IoHwAb_IoHwAbRunnable
      Os_OsCore{0..2}_swc_EcuSwComposition
    RteOsInteraction
      8 x RteUsedOsActivation, all with RteExpectedActivationOffset=0:
        Rte_Al_TE_OsTask_App10ms_Core0_0_10ms: RteActivationOsAlarmRef=Os/Rte_Al_TE_OsTask_App10ms_Core0_0_10ms, RteActivationOsTaskRef=OsTask_App10ms_Core0
        Rte_Al_TE2_EcuM_EcuM_MainFunction: RteActivationOsAlarmRef=Os/Rte_Al_TE2_EcuM_EcuM_MainFunction, RteActivationOsTaskRef=OsTask_App10ms_Core1
        Rte_Al_TE_AppCtrl1_AppCtrl1_MainFuntion: RteActivationOsAlarmRef=Os/Rte_Al_TE_AppCtrl1_AppCtrl1_MainFuntion, RteActivationOsTaskRef=OsTask_App10ms_Core1
        Rte_Al_TE2_OsTask_App10ms_Core2_0_5ms: RteActivationOsAlarmRef=Os/Rte_Al_TE2_OsTask_App10ms_Core2_0_5ms, RteActivationOsTaskRef=OsTask_App10ms_Core2
        Rte_Al_TE_AppCtrl2_AppCtrl2_MainFunction: RteActivationOsAlarmRef=Os/Rte_Al_TE_AppCtrl2_AppCtrl2_MainFunction, RteActivationOsTaskRef=OsTask_App10ms_Core2
        Rte_Al_TE2_OsTask_Bsw5ms_Core0_0_20ms: RteActivationOsAlarmRef=Os/Rte_Al_TE2_OsTask_Bsw5ms_Core0_0_20ms, RteActivationOsTaskRef=OsTask_Bsw5ms_Core0
        Rte_Al_TE2_OsTask_Bsw5ms_Core0_0_5ms: RteActivationOsAlarmRef=Os/Rte_Al_TE2_OsTask_Bsw5ms_Core0_0_5ms, RteActivationOsTaskRef=OsTask_Bsw5ms_Core0
        Rte_Al_TE_IoHwAb_IoHwAb_IoHwAbRunnable: RteActivationOsAlarmRef=Os/Rte_Al_TE_IoHwAb_IoHwAb_IoHwAbRunnable, RteActivationOsTaskRef=OsTask_Bsw5ms_Core0
  module config NvM
  module config Os
    OsTask_App10ms_Core0 (OsTask):
      OsTaskActivation = 1
      OsTaskPriority = 34
      OsTaskSchedule = NON
      OsTaskEventRef = Rte_Ev_Cyclic_OsTask_App10ms_Core0_0_10ms
      OsTaskAccessingApplication = SystemApplication_OsCore1
      OsTaskAccessingApplication = SystemApplication_OsCore2
    Rte_Al_TE_OsTask_App10ms_Core0_0_10ms (OsAlarm):
      OsAlarmCounterRef = SystemTimer_Core0
      OsAlarmAccessingApplication = SystemApplication_OsCore1
      OsAlarmAccessingApplication = SystemApplication_OsCore2
      OsAlarmAction
        OsAlarmSetEvent: OsAlarmSetEventRef=Rte_Ev_Cyclic_OsTask_App10ms_Core0_0_10ms, OsAlarmSetEventTaskRef=OsTask_App10ms_Core0
    OsTask_App10ms_Core1 (OsTask):
      OsTaskActivation = 1
      OsTaskPriority = 42
      OsTaskSchedule = NON
      OsTaskEventRef = Rte_Ev_RunS2_EcuM_EcuM_MainFunction
      OsTaskEventRef = Rte_Ev_Run_AppCtrl1_AppCtrl1_MainFuntion
      OsTaskAccessingApplication = SystemApplication_OsCore0
      OsTaskAccessingApplication = SystemApplication_OsCore2
    Rte_Al_TE2_EcuM_EcuM_MainFunction (OsAlarm):
      OsAlarmCounterRef = SystemTimer_Core1
      OsAlarmAccessingApplication = SystemApplication_OsCore0
      OsAlarmAccessingApplication = SystemApplication_OsCore2
      OsAlarmAction
        OsAlarmSetEvent: OsAlarmSetEventRef=Rte_Ev_RunS2_EcuM_EcuM_MainFunction, OsAlarmSetEventTaskRef=OsTask_App10ms_Core1
    Rte_Al_TE_AppCtrl1_AppCtrl1_MainFuntion (OsAlarm):
      OsAlarmCounterRef = SystemTimer_Core1
      OsAlarmAccessingApplication = SystemApplication_OsCore0
      OsAlarmAccessingApplication = SystemApplication_OsCore2
      OsAlarmAction
        OsAlarmSetEvent: OsAlarmSetEventRef=Rte_Ev_Run_AppCtrl1_AppCtrl1_MainFuntion, OsAlarmSetEventTaskRef=OsTask_App10ms_Core1
    OsTask_App10ms_Core2 (OsTask):
      OsTaskActivation = 1
      OsTaskPriority = 46
      OsTaskSchedule = NON
      OsTaskEventRef = Rte_Ev_Cyclic2_OsTask_App10ms_Core2_0_5ms
      OsTaskEventRef = Rte_Ev_Run_AppCtrl2_AppCtrl2_MainFunction
      OsTaskAccessingApplication = SystemApplication_OsCore0
      OsTaskAccessingApplication = SystemApplication_OsCore1
    Rte_Al_TE2_OsTask_App10ms_Core2_0_5ms (OsAlarm):
      OsAlarmCounterRef = SystemTimer_Core2
      OsAlarmAccessingApplication = SystemApplication_OsCore0
      OsAlarmAccessingApplication = SystemApplication_OsCore1
      OsAlarmAction
        OsAlarmSetEvent: OsAlarmSetEventRef=Rte_Ev_Cyclic2_OsTask_App10ms_Core2_0_5ms, OsAlarmSetEventTaskRef=OsTask_App10ms_Core2
    Rte_Al_TE_AppCtrl2_AppCtrl2_MainFunction (OsAlarm):
      OsAlarmCounterRef = SystemTimer_Core2
      OsAlarmAccessingApplication = SystemApplication_OsCore0
      OsAlarmAccessingApplication = SystemApplication_OsCore1
      OsAlarmAction
        OsAlarmSetEvent: OsAlarmSetEventRef=Rte_Ev_Run_AppCtrl2_AppCtrl2_MainFunction, OsAlarmSetEventTaskRef=OsTask_App10ms_Core2
    OsTask_App_Init_Task (OsTask):
      OsTaskActivation = 1
      OsTaskPriority = 50
      OsTaskSchedule = NON
      OsTaskAccessingApplication = SystemApplication_OsCore1
      OsTaskAccessingApplication = SystemApplication_OsCore2
    OsTask_Bsw5ms_Core0 (OsTask):
      OsTaskActivation = 1
      OsTaskPriority = 0
      OsTaskSchedule = FULL
      OsTaskEventRef = Rte_Ev_Cyclic2_OsTask_Bsw5ms_Core0_0_20ms
      OsTaskEventRef = Rte_Ev_Cyclic2_OsTask_Bsw5ms_Core0_0_5ms
      OsTaskEventRef = Rte_Ev_Run_IoHwAb_IoHwAb_IoHwAbRunnable
      OsTaskAccessingApplication = SystemApplication_OsCore1
      OsTaskAccessingApplication = SystemApplication_OsCore2
    3 x OsAlarm, all with OsAlarmCounterRef=SystemTimer_Core0, OsAlarmAccessingApplication=SystemApplication_OsCore1, OsAlarmAccessingApplication=SystemApplication_OsCore2:
      Rte_Al_TE2_OsTask_Bsw5ms_Core0_0_20ms
        OsAlarmAction
          OsAlarmSetEvent: OsAlarmSetEventRef=Rte_Ev_Cyclic2_OsTask_Bsw5ms_Core0_0_20ms, OsAlarmSetEventTaskRef=OsTask_Bsw5ms_Core0
      Rte_Al_TE2_OsTask_Bsw5ms_Core0_0_5ms
        OsAlarmAction
          OsAlarmSetEvent: OsAlarmSetEventRef=Rte_Ev_Cyclic2_OsTask_Bsw5ms_Core0_0_5ms, OsAlarmSetEventTaskRef=OsTask_Bsw5ms_Core0
      Rte_Al_TE_IoHwAb_IoHwAb_IoHwAbRunnable
        OsAlarmAction
          OsAlarmSetEvent: OsAlarmSetEventRef=Rte_Ev_Run_IoHwAb_IoHwAb_IoHwAbRunnable, OsAlarmSetEventTaskRef=OsTask_Bsw5ms_Core0
    8 x OsEvent:
      Rte_Ev_Cyclic2_OsTask_App10ms_Core2_0_5ms
      Rte_Ev_Cyclic2_OsTask_Bsw5ms_Core0_0_20ms
      Rte_Ev_Cyclic2_OsTask_Bsw5ms_Core0_0_5ms
      Rte_Ev_Cyclic_OsTask_App10ms_Core0_0_10ms
      Rte_Ev_RunS2_EcuM_EcuM_MainFunction
      Rte_Ev_Run_AppCtrl1_AppCtrl1_MainFuntion
      Rte_Ev_Run_AppCtrl2_AppCtrl2_MainFunction
      Rte_Ev_Run_IoHwAb_IoHwAb_IoHwAbRunnable
    3 x OsApplication, all with OsTrusted=true:
      SystemApplication_OsCore0: OsAppTaskRef=OsTask_App10ms_Core0, OsAppAlarmRef=Os/Rte_Al_TE_OsTask_App10ms_Core0_0_10ms, OsAppTaskRef=OsTask_App_Init_Task, OsAppTaskRef=OsTask_Bsw5ms_Core0, OsAppAlarmRef=Os/Rte_Al_TE2_OsTask_Bsw5ms_Core0_0_20ms, OsAppAlarmRef=Os/Rte_Al_TE2_OsTask_Bsw5ms_Core0_0_5ms, OsAppAlarmRef=Os/Rte_Al_TE_IoHwAb_IoHwAb_IoHwAbRunnable
      SystemApplication_OsCore1: OsAppTaskRef=OsTask_App10ms_Core1, OsAppAlarmRef=Os/Rte_Al_TE2_EcuM_EcuM_MainFunction, OsAppAlarmRef=Os/Rte_Al_TE_AppCtrl1_AppCtrl1_MainFuntion
      SystemApplication_OsCore2: OsAppTaskRef=OsTask_App10ms_Core2, OsAppAlarmRef=Os/Rte_Al_TE2_OsTask_App10ms_Core2_0_5ms, OsAppAlarmRef=Os/Rte_Al_TE_AppCtrl2_AppCtrl2_MainFunction
  module config EcuC
  ecuc value collection DaVinci_Project: ecuc-values=[Com, Rte, Os, EcuC, NvM]
