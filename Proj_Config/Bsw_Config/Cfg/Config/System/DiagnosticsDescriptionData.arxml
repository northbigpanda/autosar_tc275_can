AUTOSAR XML (schema 00046)
package /InitialEcuC
  ecuc value collection InitialEcuC: ecuc-values=[Dcm, Dem]
  module config Dcm: module-description=Dcm_Impl
    DcmConfigSet
      DcmDsd
        DcmDsdServiceTable
          8 x DcmDsdService:
            EcuReset: DcmDsdSidTabServiceId=17, DcmDsdSidTabSubfuncAvail=true
              Hard (DcmDsdSubService): DcmDsdSubServiceId=1
              Soft (DcmDsdSubService): DcmDsdSubServiceId=3
            ClearDiagInfo: DcmDsdSidTabServiceId=20, DcmDsdSidTabSubfuncAvail=false
            ReadDtcInfo: DcmDsdSidTabServiceId=25, DcmDsdSidTabSubfuncAvail=true
              RDTCBSM (DcmDsdSubService): DcmDsdSubServiceId=2
              RNODTCBSM (DcmDsdSubService): DcmDsdSubServiceId=1
            ReadDataById: DcmDsdSidTabServiceId=34, DcmDsdSidTabSubfuncAvail=false
            CommunicationControl: DcmDsdSidTabServiceId=40, DcmDsdSidTabSubfuncAvail=true
              EnableRxAndTx (DcmDsdSubService): DcmDsdSubServiceId=0
              EnableRxAndDisableTx (DcmDsdSubService): DcmDsdSubServiceId=1
            RoutineControl: DcmDsdSidTabServiceId=49, DcmDsdSidTabSubfuncAvail=true
            TesterPresent: DcmDsdSidTabServiceId=62, DcmDsdSidTabSubfuncAvail=true
              TesterPresent (DcmDsdSubService): DcmDsdSubServiceId=0
            ControlDtcSetting: DcmDsdSidTabServiceId=133, DcmDsdSidTabSubfuncAvail=true
              Enable (DcmDsdSubService): DcmDsdSubServiceId=1
              Disable (DcmDsdSubService): DcmDsdSubServiceId=2
      DcmDsp: DcmDspMaxDidToRead=1
        Braking_Brake_Pedal (DcmDspData): DcmDspDataSize=8, DcmDspDataType=UINT8, DcmDspDataInfoRef=DataInfo_Braking_Brake_Pedal
        DataInfo_Braking_Brake_Pedal (DcmDspDataInfo): DcmDspDataFixedLength=true
        Braking (DcmDspDid): DcmDspDidIdentifier=256, DcmDspDidInfoRef=DidInfo_Braking
          Brake_Pedal (DcmDspDidSignal): DcmDspDidDataPos=0, DcmDspDidDataRef=Braking_Brake_Pedal
        DidInfo_Braking (DcmDspDidInfo)
          DcmDspDidAccess
            DcmDspDidRead
        ECU_Check (DcmDspRoutine):
          DcmDspRequestResultsRoutineSupported = true
          DcmDspStopRoutineSupported = false
          DcmDspRoutineIdentifier = 256
          DcmDspRoutineInfoRef = RoutineInfo_ECU_Check
        RoutineInfo_ECU_Check (DcmDspRoutineInfo)
          DcmDspRoutineAuthorization
          DcmDspStartRoutineIn
            In_Start_ECU_Check (DcmDspStartRoutineInSignal): DcmDspRoutineSignalLength=8, DcmDspRoutineSignalType=UINT8, DcmDspRoutineSignalPos=0
          DcmDspStartRoutineOut
            Out_ECU_Check_is_in_progress (DcmDspStartRoutineOutSignal): DcmDspRoutineSignalLength=8, DcmDspRoutineSignalType=UINT8, DcmDspRoutineSignalPos=0
          DcmDspRoutineRequestResOut
            Out_ECU_Check_status (DcmDspRoutineRequestResOutSignal): DcmDspRoutineSignalLength=8, DcmDspRoutineSignalType=UINT8, DcmDspRoutineSignalPos=0
        ComControl (DcmDspComControl)
          DspComContolAllChannel (DcmDspComControlAllChannel)
  module config Dem: module-description=Dem_Impl
    DemConfigSet
      DTCClass_DTC_0x402011 (DemDTCClass): DemUdsDTC=4202513
      DTC_0x402011 (DemEventParameter): DemEventKind=DEM_EVENT_KIND_SWC, DemDTCClassRef=DTCClass_DTC_0x402011
        DemEventClass:
          DemEventDestination = DEM_DTC_ORIGIN_PRIMARY_MEMORY
          DemEventSignificance = DEM_EVENT_SIGNIFICANCE_FAULT
          DemAgingCycleRef = PowerCycle
          DemOperationCycleRef = PowerCycle
          DemDebounceAlgorithmClass
            DemDebounceMonitorInternal
              DemCallbackGetFDC
    DemGeneral:
      DemAgingCycleCounterProcessing = DEM_PROCESS_AGINGCTR_INTERN
      DemDtcStatusAvailabilityMask = 127
      DemMaxNumberEventEntryMirror = 0
      DemPTOSupport = false
      DemTypeOfFreezeFrameRecordNumeration = DEM_FF_RECNUM_CALCULATED
      PowerCycle (DemOperationCycle): DemOperationCycleType=DEM_OPCYC_POWER
