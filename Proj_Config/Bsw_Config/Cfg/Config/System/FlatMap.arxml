AUTOSAR XML (schema 00046)
package /COM/VECTOR/CFG/WORKFLOW/SYSDESC/SYNC
  flat map FLATMAP
    30 x flat instance descriptor:
      AppCtrl: upstream-reference=EcuSwComposition.AppCtrl, ecu-extract-reference=COMPOSITIONTYPE.AppCtrl
      AppComTx: upstream-reference=EcuSwComposition.AppComTx, ecu-extract-reference=COMPOSITIONTYPE.AppComTx
      AppComRx: upstream-reference=EcuSwComposition.AppComRx, ecu-extract-reference=COMPOSITIONTYPE.AppComRx
      SG_Sig_Grp_0x110: upstream-reference=EcuSwComposition.SG_Sig_Grp_0x110.SG_Sig_Grp_0x110, ecu-extract-reference=COMPOSITIONTYPE.SG_Sig_Grp_0x110.SG_Sig_Grp_0x110
      SG_Sig_Grp_0x110_001: upstream-reference=EcuSwComposition.SG_Sig_Grp_0x110, ecu-extract-reference=COMPOSITIONTYPE.SG_Sig_Grp_0x110
      SG_Sig_Grp_0x111: upstream-reference=EcuSwComposition.SG_Sig_Grp_0x111.SG_Sig_Grp_0x111, ecu-extract-reference=COMPOSITIONTYPE.SG_Sig_Grp_0x111.SG_Sig_Grp_0x111
      SG_Sig_Grp_0x111_001: upstream-reference=EcuSwComposition.SG_Sig_Grp_0x111, ecu-extract-reference=COMPOSITIONTYPE.SG_Sig_Grp_0x111
      SG_Sig_Grp_0x112: upstream-reference=EcuSwComposition.SG_Sig_Grp_0x112.SG_Sig_Grp_0x112, ecu-extract-reference=COMPOSITIONTYPE.SG_Sig_Grp_0x112.SG_Sig_Grp_0x112
      SG_Sig_Grp_0x112_001: upstream-reference=EcuSwComposition.SG_Sig_Grp_0x112, ecu-extract-reference=COMPOSITIONTYPE.SG_Sig_Grp_0x112
      SG_Sig_Grp_0x113: upstream-reference=EcuSwComposition.SG_Sig_Grp_0x113.SG_Sig_Grp_0x113, ecu-extract-reference=COMPOSITIONTYPE.SG_Sig_Grp_0x113.SG_Sig_Grp_0x113
      SG_Sig_Grp_0x113_001: upstream-reference=EcuSwComposition.SG_Sig_Grp_0x113, ecu-extract-reference=COMPOSITIONTYPE.SG_Sig_Grp_0x113
      SG_Sig_Grp_0x114: upstream-reference=EcuSwComposition.SG_Sig_Grp_0x114.SG_Sig_Grp_0x114, ecu-extract-reference=COMPOSITIONTYPE.SG_Sig_Grp_0x114.SG_Sig_Grp_0x114
      SG_Sig_Grp_0x114_001: upstream-reference=EcuSwComposition.SG_Sig_Grp_0x114, ecu-extract-reference=COMPOSITIONTYPE.SG_Sig_Grp_0x114
      SG_Sig_Grp_0x400: upstream-reference=EcuSwComposition.SG_Sig_Grp_0x400.SG_Sig_Grp_0x400, ecu-extract-reference=COMPOSITIONTYPE.SG_Sig_Grp_0x400.SG_Sig_Grp_0x400
      SG_Sig_Grp_0x400_001: upstream-reference=EcuSwComposition.SG_Sig_Grp_0x400, ecu-extract-reference=COMPOSITIONTYPE.SG_Sig_Grp_0x400
      SG_Sig_Grp_0x401: upstream-reference=EcuSwComposition.SG_Sig_Grp_0x401.SG_Sig_Grp_0x401, ecu-extract-reference=COMPOSITIONTYPE.SG_Sig_Grp_0x401.SG_Sig_Grp_0x401
      SG_Sig_Grp_0x401_001: upstream-reference=EcuSwComposition.SG_Sig_Grp_0x401, ecu-extract-reference=COMPOSITIONTYPE.SG_Sig_Grp_0x401
      SG_Sig_Grp_0x402: upstream-reference=EcuSwComposition.SG_Sig_Grp_0x402.SG_Sig_Grp_0x402, ecu-extract-reference=COMPOSITIONTYPE.SG_Sig_Grp_0x402.SG_Sig_Grp_0x402
      SG_Sig_Grp_0x402_001: upstream-reference=EcuSwComposition.SG_Sig_Grp_0x402, ecu-extract-reference=COMPOSITIONTYPE.SG_Sig_Grp_0x402
      SG_Sig_Grp_0x403: upstream-reference=EcuSwComposition.SG_Sig_Grp_0x403.SG_Sig_Grp_0x403, ecu-extract-reference=COMPOSITIONTYPE.SG_Sig_Grp_0x403.SG_Sig_Grp_0x403
      SG_Sig_Grp_0x403_001: upstream-reference=EcuSwComposition.SG_Sig_Grp_0x403, ecu-extract-reference=COMPOSITIONTYPE.SG_Sig_Grp_0x403
      AppWakeUpCtrl: upstream-reference=EcuSwComposition.AppWakeUpCtrl, ecu-extract-reference=COMPOSITIONTYPE.AppWakeUpCtrl
      AppButtonCtrl: upstream-reference=EcuSwComposition.AppButtonCtrl, ecu-extract-reference=COMPOSITIONTYPE.AppButtonCtrl
      AppLedCtrl: upstream-reference=EcuSwComposition.AppLedCtrl, ecu-extract-reference=COMPOSITIONTYPE.AppLedCtrl
      IoHwAb: upstream-reference=EcuSwComposition.IoHwAb, ecu-extract-reference=COMPOSITIONTYPE.IoHwAb
      AppCtrl2: upstream-reference=EcuSwComposition.AppCtrl2, ecu-extract-reference=COMPOSITIONTYPE.AppCtrl2
      AppCtrl1: upstream-reference=EcuSwComposition.AppCtrl1, ecu-extract-reference=COMPOSITIONTYPE.AppCtrl1
      IcuCdd: upstream-reference=EcuSwComposition.IcuCdd, ecu-extract-reference=COMPOSITIONTYPE.IcuCdd
      Sig_0x114_Used_6: upstream-reference=EcuSwComposition.Sig_0x114_Used_6.Sig_0x114_Used_6, ecu-extract-reference=COMPOSITIONTYPE.Sig_0x114_Used_6.Sig_0x114_Used_6
      Sig_0x114_Used_7: upstream-reference=EcuSwComposition.Sig_0x114_Used_6, ecu-extract-reference=COMPOSITIONTYPE.Sig_0x114_Used_6
