AUTOSAR XML (schema 00046)
package /AURIX/Port_ib_bswmd/BswModuleDescriptions
  bsw module description Port
    bsw internal behavior PortBehavior
