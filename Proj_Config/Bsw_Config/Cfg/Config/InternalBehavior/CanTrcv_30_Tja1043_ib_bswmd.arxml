AUTOSAR XML (schema 00046)
package /MICROSAR/CanTrcv_Tja1043
  bsw implementation CanTrcv_Impl: programming-language=C, sw-version=4.04.00, used-code-generator=DaVinci Configurator5, vendor-id=30, ar-release-version=4.00.03, vendor-api-infix=Tja1043
package /MICROSAR/CanTrcv_Tja1043_ib_bswmd/BswModuleDescriptions
  bsw module description CanTrcv: provided-entrys=CanTrcv_30_Tja1043_MainFunction
    bsw internal behavior CanTrcv_Tja1043_Behavior
      exclusive area CANTRCV_30_TJA1043_EXCLUSIVE_AREA_0
      bsw schedulable entity CanTrcv_30_Tja1043_MainFunction: implemented-entry=CanTrcv_30_Tja1043_MainFunction
      bsw timing event CanTrcv_30_Tja1043_MainFunctionTimingEvent0: starts-on-event=CanTrcv_30_Tja1043_MainFunction, period=0.005
  bsw module entry CanTrcv_30_Tja1043_MainFunction: call-type=SCHEDULED, execution-context=TASK
