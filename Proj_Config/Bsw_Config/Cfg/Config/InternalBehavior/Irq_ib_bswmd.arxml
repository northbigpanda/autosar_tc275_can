AUTOSAR XML (schema 00046)
package /AURIX/Irq_ib_bswmd/BswModuleDescriptions
  bsw module description Irq
    bsw internal behavior IrqBehavior
