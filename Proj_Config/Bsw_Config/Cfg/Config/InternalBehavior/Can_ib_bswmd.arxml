AUTOSAR XML (schema 00046)
package /MICROSAR/Can_TricoreMultican_ib_bswmd/BswModuleDescriptions
  bsw module description Can: provided-entrys=[Can_MainFunction_BusOff, Can_MainFunction_Wakeup, Can_MainFunction_Mode]
    bsw internal behavior Can_TricoreMultican_Behavior
      8 x exclusive area:
        CAN_EXCLUSIVE_AREA_{0..7}
      bsw schedulable entity Can_MainFunction_Wakeup: implemented-entry=Can_MainFunction_Wakeup
      bsw schedulable entity Can_MainFunction_Mode: implemented-entry=Can_MainFunction_Mode
      bsw schedulable entity Can_MainFunction_BusOff: implemented-entry=Can_MainFunction_BusOff
      bsw timing event Can_MainFunction_WakeupTimingEvent0: starts-on-event=Can_MainFunction_Wakeup, period=0.005
      bsw timing event Can_MainFunction_ModeTimingEvent0: starts-on-event=Can_MainFunction_Mode, period=0.005
      bsw timing event Can_MainFunction_BusOffTimingEvent0: starts-on-event=Can_MainFunction_BusOff, period=0.005
  bsw module entry Can_MainFunction_BusOff: call-type=SCHEDULED, execution-context=TASK
  bsw module entry Can_MainFunction_Wakeup: call-type=SCHEDULED, execution-context=TASK
  bsw module entry Can_MainFunction_Mode: call-type=SCHEDULED, execution-context=TASK
