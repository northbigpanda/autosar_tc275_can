AUTOSAR XML (schema 00046)
package /Irq
  module config Irq: implementation-config-variant=VARIANT-PRE-COMPILE, module-description=Irq_Impl
    IrqGeneral: IrqOsekEnable=true
    IrqAscLinConfig_0 (IrqAscLinConfig)
      IrqAscLinCatConfig
        IrqAscLinErrCatConfig: IrqAscLin0ErrorCat=CAT1, IrqAscLin1ErrorCat=CAT1, IrqAscLin2ErrorCat=CAT1, IrqAscLin3ErrorCat=CAT1
        IrqAscLinRxCatConfig: IrqAscLin0RxCat=CAT1, IrqAscLin1RxCat=CAT1, IrqAscLin2RxCat=CAT1, IrqAscLin3RxCat=CAT1
        IrqAscLinTxCatConfig: IrqAscLin0TxCat=CAT1, IrqAscLin1TxCat=CAT1, IrqAscLin2TxCat=CAT1, IrqAscLin3TxCat=CAT1
      IrqAscLinPrioConfig
        IrqAscLinErrPrioConfig: IrqAscLin0ErrorPrio=0, IrqAscLin1ErrorPrio=0, IrqAscLin2ErrorPrio=0, IrqAscLin3ErrorPrio=0
        IrqAscLinRxPrioConfig: IrqAscLin0RxPrio=0, IrqAscLin1RxPrio=0, IrqAscLin2RxPrio=0, IrqAscLin3RxPrio=0
        IrqAscLinTxPrioConfig: IrqAscLin0TxPrio=0, IrqAscLin1TxPrio=0, IrqAscLin2TxPrio=0, IrqAscLin3TxPrio=0
      IrqAscLinTosConfig
        IrqAscLinErrTosConfig: IrqAscLin0ErrTos=CPU0, IrqAscLin1ErrTos=CPU0, IrqAscLin2ErrTos=CPU0, IrqAscLin3ErrTos=CPU0
        IrqAscLinRxTosConfig: IrqAscLin0RxTos=CPU0, IrqAscLin1RxTos=CPU0, IrqAscLin2RxTos=CPU0, IrqAscLin3RxTos=CPU0
        IrqAscLinTxTosConfig: IrqAscLin0TxTos=CPU0, IrqAscLin1TxTos=CPU0, IrqAscLin2TxTos=CPU0, IrqAscLin3TxTos=CPU0
    IrqQspiConfig_0 (IrqQspiConfig)
      IrqQspiCatConfig
        IrqQspiErrCatConfig: IrqQspi0ErrCat=CAT1, IrqQspi1ErrCat=CAT1, IrqQspi2ErrCat=CAT1, IrqQspi3ErrCat=CAT1
        IrqQspiHCCatConfig: IrqQspi0HCCat=CAT1, IrqQspi1HCCat=CAT1, IrqQspi2HCCat=CAT1, IrqQspi3HCCat=CAT1
        IrqQspiPTCatConfig: IrqQspi0PTCat=CAT1, IrqQspi1PTCat=CAT1, IrqQspi2PTCat=CAT1, IrqQspi3PTCat=CAT1
        IrqQspiRxCatConfig: IrqQspi0RxCat=CAT1, IrqQspi1RxCat=CAT1, IrqQspi2RxCat=CAT1, IrqQspi3RxCat=CAT1
        IrqQspiTxCatConfig: IrqQspi0TxCat=CAT1, IrqQspi1TxCat=CAT1, IrqQspi2TxCat=CAT1, IrqQspi3TxCat=CAT1
        IrqQspiUDCatConfig: IrqQspi0UDCat=CAT1, IrqQspi1UDCat=CAT1, IrqQspi2UDCat=CAT1, IrqQspi3UDCat=CAT1
      IrqQspiPrioConfig
        IrqQspiErrPrioConfig: IrqQspi0ErrPrio=0, IrqQspi1ErrPrio=0, IrqQspi2ErrPrio=0, IrqQspi3ErrPrio=0
        IrqQspiHCPrioConfig: IrqQspi0HCPrio=0, IrqQspi1HCPrio=0, IrqQspi2HCPrio=0, IrqQspi3HCPrio=0
        IrqQspiPTPrioConfig: IrqQspi0PTPrio=0, IrqQspi1PTPrio=0, IrqQspi2PTPrio=0, IrqQspi3PTPrio=0
        IrqQspiRxPrioConfig: IrqQspi0RxPrio=0, IrqQspi1RxPrio=0, IrqQspi2RxPrio=0, IrqQspi3RxPrio=0
        IrqQspiTxPrioConfig: IrqQspi0TxPrio=0, IrqQspi1TxPrio=0, IrqQspi2TxPrio=0, IrqQspi3TxPrio=0
        IrqQspiUDPrioConfig: IrqQspi0UDPrio=0, IrqQspi1UDPrio=0, IrqQspi2UDPrio=0, IrqQspi3UDPrio=0
      IrqQspiTosConfig
        IrqQspiErrTosConfig: IrqQspi0ErrTos=CPU0, IrqQspi1ErrTos=CPU0, IrqQspi2ErrTos=CPU0, IrqQspi3ErrTos=CPU0
        IrqQspiHCTosConfig: IrqQspi0HCTos=CPU0, IrqQspi1HCTos=CPU0, IrqQspi2HCTos=CPU0, IrqQspi3HCTos=CPU0
        IrqQspiPTTosConfig: IrqQspi0PTTos=CPU0, IrqQspi1PTTos=CPU0, IrqQspi2PTTos=CPU0, IrqQspi3PTTos=CPU0
        IrqQspiRxTosConfig: IrqQspi0RxTos=CPU0, IrqQspi1RxTos=CPU0, IrqQspi2RxTos=CPU0, IrqQspi3RxTos=CPU0
        IrqQspiTxTosConfig: IrqQspi0TxTos=CPU0, IrqQspi1TxTos=CPU0, IrqQspi2TxTos=CPU0, IrqQspi3TxTos=CPU0
        IrqQspiUDTosConfig: IrqQspi0UDTos=CPU0, IrqQspi1UDTos=CPU0, IrqQspi2UDTos=CPU0, IrqQspi3UDTos=CPU0
    IrqMscConfig_0 (IrqMscConfig)
      IrqMsc0Config
        IrqMsc0CatConfig: IrqMsc0SR0Cat=CAT1, IrqMsc0SR1Cat=CAT1, IrqMsc0SR2Cat=CAT1, IrqMsc0SR3Cat=CAT1, IrqMsc0SR4Cat=CAT1
        IrqMsc0PrioConfig: IrqMsc0SR0Prio=0, IrqMsc0SR1Prio=0, IrqMsc0SR2Prio=0, IrqMsc0SR3Prio=0, IrqMsc0SR4Prio=0
        IrqMsc0TosConfig: IrqMsc0SR0Tos=CPU0, IrqMsc0SR1Tos=CPU0, IrqMsc0SR2Tos=CPU0, IrqMsc0SR3Tos=CPU0, IrqMsc0SR4Tos=CPU0
      IrqMsc1Config
        IrqMsc1CatConfig: IrqMsc1SR0Cat=CAT1, IrqMsc1SR1Cat=CAT1, IrqMsc1SR2Cat=CAT1, IrqMsc1SR3Cat=CAT1, IrqMsc1SR4Cat=CAT1
        IrqMsc1PrioConfig: IrqMsc1SR0Prio=0, IrqMsc1SR1Prio=0, IrqMsc1SR2Prio=0, IrqMsc1SR3Prio=0, IrqMsc1SR4Prio=0
        IrqMsc1TosConfig: IrqMsc1SR0Tos=CPU0, IrqMsc1SR1Tos=CPU0, IrqMsc1SR2Tos=CPU0, IrqMsc1SR3Tos=CPU0, IrqMsc1SR4Tos=CPU0
    IrqCCU6Config_0 (IrqCCU6Config)
      IrqCCU60Config
        IrqCCU60CatConfig: IrqCCU60SR0Cat=CAT1, IrqCCU60SR1Cat=CAT1, IrqCCU60SR2Cat=CAT1, IrqCCU60SR3Cat=CAT1
        IrqCCU60PrioConfig: IrqCCU60SR0Prio=0, IrqCCU60SR1Prio=0, IrqCCU60SR2Prio=0, IrqCCU60SR3Prio=0
        IrqCCU60TosConfig: IrqCCU60SR0Tos=CPU0, IrqCCU60SR1Tos=CPU0, IrqCCU60SR2Tos=CPU0, IrqCCU60SR3Tos=CPU0
      IrqCCU61Config
        IrqCCU61CatConfig: IrqCCU61SR0Cat=CAT1, IrqCCU61SR1Cat=CAT1, IrqCCU61SR2Cat=CAT1, IrqCCU61SR3Cat=CAT1
        IrqCCU61PrioConfig: IrqCCU61SR0Prio=0, IrqCCU61SR1Prio=0, IrqCCU61SR2Prio=0, IrqCCU61SR3Prio=0
        IrqCCU61TosConfig: IrqCCU61SR0Tos=CPU0, IrqCCU61SR1Tos=CPU0, IrqCCU61SR2Tos=CPU0, IrqCCU61SR3Tos=CPU0
    IrqGptConfig_0 (IrqGptConfig)
      IrqGpt120Config
        IrqGpt120CatConfig: IrqGpt120CARPELCat=CAT1, IrqGpt120T2Cat=CAT1, IrqGpt120T3Cat=CAT1, IrqGpt120T4Cat=CAT1, IrqGpt120T5Cat=CAT1, IrqGpt120T6Cat=CAT1
        IrqGpt120PrioConfig: IrqGpt120CARPELPrio=0, IrqGpt120T2Prio=0, IrqGpt120T3Prio=0, IrqGpt120T4Prio=0, IrqGpt120T5Prio=0, IrqGpt120T6Prio=0
        IrqGpt120TosConfig: IrqGpt120CARPELTos=CPU0, IrqGpt120T2Tos=CPU0, IrqGpt120T3Tos=CPU0, IrqGpt120T4Tos=CPU0, IrqGpt120T5Tos=CPU0, IrqGpt120T6Tos=CPU0
    IrqStmConfig_0 (IrqStmConfig)
      IrqStm0Config
        IrqStm0CatConfig: IrqStm0SR0Cat=CAT1, IrqStm0SR1Cat=CAT1
        IrqStm0PrioConfig: IrqStm0SR0Prio=0, IrqStm0SR1Prio=0
        IrqStm0TosConfig: IrqStm0SR0Tos=CPU0, IrqStm0SR1Tos=CPU0
      IrqStm1Config
        IrqStm1CatConfig: IrqStm1SR0Cat=CAT1, IrqStm1SR1Cat=CAT1
        IrqStm1PrioConfig: IrqStm1SR0Prio=0, IrqStm1SR1Prio=0
        IrqStm1TosConfig: IrqStm1SR0Tos=CPU0, IrqStm1SR1Tos=CPU0
      IrqStm2Config
        IrqStm2CatConfig: IrqStm2SR0Cat=CAT1, IrqStm2SR1Cat=CAT1
        IrqStm2PrioConfig: IrqStm2SR0Prio=0, IrqStm2SR1Prio=0
        IrqStm2TosConfig: IrqStm2SR0Tos=CPU0, IrqStm2SR1Tos=CPU0
    IrqDmaConfig_0 (IrqDmaConfig)
      IrqDmaCatConfig:
        IrqDmaCh0SRCat = CAT1
        IrqDmaCh{10..19}SRCat = CAT1
        IrqDmaCh1SRCat = CAT1
        IrqDmaCh{20..29}SRCat = CAT1
        IrqDmaCh2SRCat = CAT1
        IrqDmaCh{30..39}SRCat = CAT1
        IrqDmaCh3SRCat = CAT1
        IrqDmaCh{40..49}SRCat = CAT1
        IrqDmaCh4SRCat = CAT1
        IrqDmaCh{50..59}SRCat = CAT1
        IrqDmaCh5SRCat = CAT1
        IrqDmaCh{60..63}SRCat = CAT1
        IrqDmaCh{6..9}SRCat = CAT1
        IrqDmaErrSRCat = CAT1
      IrqDmaPrioConfig:
        IrqDmaCh0SRPrio = 0
        IrqDmaCh{10..19}SRPrio = 0
        IrqDmaCh1SRPrio = 0
        IrqDmaCh{20..29}SRPrio = 0
        IrqDmaCh2SRPrio = 0
        IrqDmaCh{30..39}SRPrio = 0
        IrqDmaCh3SRPrio = 0
        IrqDmaCh{40..49}SRPrio = 0
        IrqDmaCh4SRPrio = 0
        IrqDmaCh{50..59}SRPrio = 0
        IrqDmaCh5SRPrio = 0
        IrqDmaCh{60..63}SRPrio = 0
        IrqDmaCh{6..9}SRPrio = 0
        IrqDmaErrSRPrio = 0
      IrqDmaTosConfig:
        IrqDmaCh0SRTos = CPU0
        IrqDmaCh{10..19}SRTos = CPU0
        IrqDmaCh1SRTos = CPU0
        IrqDmaCh{20..29}SRTos = CPU0
        IrqDmaCh2SRTos = CPU0
        IrqDmaCh{30..39}SRTos = CPU0
        IrqDmaCh3SRTos = CPU0
        IrqDmaCh{40..49}SRTos = CPU0
        IrqDmaCh4SRTos = CPU0
        IrqDmaCh{50..59}SRTos = CPU0
        IrqDmaCh5SRTos = CPU0
        IrqDmaCh{60..63}SRTos = CPU0
        IrqDmaCh{6..9}SRTos = CPU0
        IrqDmaErrSRTos = CPU0
    IrqETHConfig_0 (IrqETHConfig)
      IrqETHCatConfig: IrqETHSRCat=CAT1
      IrqETHPrioConfig: IrqETHSRPrio=0
      IrqETHTosConfig: IrqETHSRTos=CPU0
    IrqCanConfig_0 (IrqCanConfig)
      IrqCanCatConfig:
        IrqCanSR0Cat = CAT1
        IrqCanSR{10..15}Cat = CAT1
        IrqCanSR{1..9}Cat = CAT1
      IrqCanPrioConfig:
        IrqCanSR0Prio = 10
        IrqCanSR10Prio = 20
        IrqCanSR11Prio = 21
        IrqCanSR12Prio = 22
        IrqCanSR13Prio = 23
        IrqCanSR14Prio = 24
        IrqCanSR15Prio = 25
        IrqCanSR1Prio = 11
        IrqCanSR2Prio = 12
        IrqCanSR3Prio = 13
        IrqCanSR4Prio = 14
        IrqCanSR5Prio = 15
        IrqCanSR6Prio = 16
        IrqCanSR7Prio = 17
        IrqCanSR8Prio = 18
        IrqCanSR9Prio = 19
      IrqCanTosConfig:
        IrqCanSR0Tos = CPU0
        IrqCanSR{10..15}Tos = CPU0
        IrqCanSR{1..9}Tos = CPU0
    IrqAdcConfig_0 (IrqAdcConfig)
      IrqAdc0Config
        IrqAdc0CatConfig: IrqAdc0SR0Cat=CAT1, IrqAdc0SR1Cat=CAT1, IrqAdc0SR2Cat=CAT1, IrqAdc0SR3Cat=CAT1
        IrqAdc0PrioConfig: IrqAdc0SR0Prio=0, IrqAdc0SR1Prio=0, IrqAdc0SR2Prio=0, IrqAdc0SR3Prio=0
        IrqAdc0TosConfig: IrqAdc0SR0Tos=CPU0, IrqAdc0SR1Tos=CPU0, IrqAdc0SR2Tos=CPU0, IrqAdc0SR3Tos=CPU0
      IrqAdc1Config
        IrqAdc1CatConfig: IrqAdc1SR0Cat=CAT1, IrqAdc1SR1Cat=CAT1, IrqAdc1SR2Cat=CAT1, IrqAdc1SR3Cat=CAT1
        IrqAdc1PrioConfig: IrqAdc1SR0Prio=0, IrqAdc1SR1Prio=0, IrqAdc1SR2Prio=0, IrqAdc1SR3Prio=0
        IrqAdc1TosConfig: IrqAdc1SR0Tos=CPU0, IrqAdc1SR1Tos=CPU0, IrqAdc1SR2Tos=CPU0, IrqAdc1SR3Tos=CPU0
      IrqAdc2Config
        IrqAdc2CatConfig: IrqAdc2SR0Cat=CAT1, IrqAdc2SR1Cat=CAT1, IrqAdc2SR2Cat=CAT1, IrqAdc2SR3Cat=CAT1
        IrqAdc2PrioConfig: IrqAdc2SR0Prio=0, IrqAdc2SR1Prio=0, IrqAdc2SR2Prio=0, IrqAdc2SR3Prio=0
        IrqAdc2TosConfig: IrqAdc2SR0Tos=CPU0, IrqAdc2SR1Tos=CPU0, IrqAdc2SR2Tos=CPU0, IrqAdc2SR3Tos=CPU0
      IrqAdc3Config
        IrqAdc3CatConfig: IrqAdc3SR0Cat=CAT1, IrqAdc3SR1Cat=CAT1, IrqAdc3SR2Cat=CAT1, IrqAdc3SR3Cat=CAT1
        IrqAdc3PrioConfig: IrqAdc3SR0Prio=0, IrqAdc3SR1Prio=0, IrqAdc3SR2Prio=0, IrqAdc3SR3Prio=0
        IrqAdc3TosConfig: IrqAdc3SR0Tos=CPU0, IrqAdc3SR1Tos=CPU0, IrqAdc3SR2Tos=CPU0, IrqAdc3SR3Tos=CPU0
      IrqAdc4Config
        IrqAdc4CatConfig: IrqAdc4SR0Cat=CAT1, IrqAdc4SR1Cat=CAT1, IrqAdc4SR2Cat=CAT1, IrqAdc4SR3Cat=CAT1
        IrqAdc4PrioConfig: IrqAdc4SR0Prio=0, IrqAdc4SR1Prio=0, IrqAdc4SR2Prio=0, IrqAdc4SR3Prio=0
        IrqAdc4TosConfig: IrqAdc4SR0Tos=CPU0, IrqAdc4SR1Tos=CPU0, IrqAdc4SR2Tos=CPU0, IrqAdc4SR3Tos=CPU0
      IrqAdc5Config
        IrqAdc5CatConfig: IrqAdc5SR0Cat=CAT1, IrqAdc5SR1Cat=CAT1, IrqAdc5SR2Cat=CAT1, IrqAdc5SR3Cat=CAT1
        IrqAdc5PrioConfig: IrqAdc5SR0Prio=0, IrqAdc5SR1Prio=0, IrqAdc5SR2Prio=0, IrqAdc5SR3Prio=0
        IrqAdc5TosConfig: IrqAdc5SR0Tos=CPU0, IrqAdc5SR1Tos=CPU0, IrqAdc5SR2Tos=CPU0, IrqAdc5SR3Tos=CPU0
      IrqAdc6Config
        IrqAdc6CatConfig: IrqAdc6SR0Cat=CAT1, IrqAdc6SR1Cat=CAT1, IrqAdc6SR2Cat=CAT1, IrqAdc6SR3Cat=CAT1
        IrqAdc6PrioConfig: IrqAdc6SR0Prio=0, IrqAdc6SR1Prio=0, IrqAdc6SR2Prio=0, IrqAdc6SR3Prio=0
        IrqAdc6TosConfig: IrqAdc6SR0Tos=CPU0, IrqAdc6SR1Tos=CPU0, IrqAdc6SR2Tos=CPU0, IrqAdc6SR3Tos=CPU0
      IrqAdc7Config
        IrqAdc7CatConfig: IrqAdc7SR0Cat=CAT1, IrqAdc7SR1Cat=CAT1, IrqAdc7SR2Cat=CAT1, IrqAdc7SR3Cat=CAT1
        IrqAdc7PrioConfig: IrqAdc7SR0Prio=0, IrqAdc7SR1Prio=0, IrqAdc7SR2Prio=0, IrqAdc7SR3Prio=0
        IrqAdc7TosConfig: IrqAdc7SR0Tos=CPU0, IrqAdc7SR1Tos=CPU0, IrqAdc7SR2Tos=CPU0, IrqAdc7SR3Tos=CPU0
      IrqAdcCG0Config
        IrqAdcCG0CatConfig: IrqAdcCG0SR0Cat=CAT1, IrqAdcCG0SR1Cat=CAT1, IrqAdcCG0SR2Cat=CAT1, IrqAdcCG0SR3Cat=CAT1
        IrqAdcCG0PrioConfig: IrqAdcCG0SR0Prio=0, IrqAdcCG0SR1Prio=0, IrqAdcCG0SR2Prio=0, IrqAdcCG0SR3Prio=0
        IrqAdcCG0TosConfig: IrqAdcCG0SR0Tos=CPU0, IrqAdcCG0SR1Tos=CPU0, IrqAdcCG0SR2Tos=CPU0, IrqAdcCG0SR3Tos=CPU0
      IrqAdcCG1Config
        IrqAdcCG1CatConfig: IrqAdcCG1SR0Cat=CAT1, IrqAdcCG1SR1Cat=CAT1, IrqAdcCG1SR2Cat=CAT1, IrqAdcCG1SR3Cat=CAT1
        IrqAdcCG1PrioConfig: IrqAdcCG1SR0Prio=0, IrqAdcCG1SR1Prio=0, IrqAdcCG1SR2Prio=0, IrqAdcCG1SR3Prio=0
        IrqAdcCG1TosConfig: IrqAdcCG1SR0Tos=CPU0, IrqAdcCG1SR1Tos=CPU0, IrqAdcCG1SR2Tos=CPU0, IrqAdcCG1SR3Tos=CPU0
    IrqDSAdcConfig_0 (IrqDSAdcConfig)
      IrqDSAdcCatConfig:
        IrqDSAdcSRA{0..5}Cat = CAT1
        IrqDSAdcSRM{0..5}Cat = CAT1
      IrqDSAdcPrioConfig:
        IrqDSAdcSRA{0..5}Prio = 0
        IrqDSAdcSRM{0..5}Prio = 0
      IrqDSAdcTosConfig:
        IrqDSAdcSRA{0..5}Tos = CPU0
        IrqDSAdcSRM{0..5}Tos = CPU0
    IrqFlexRayConfig_0 (IrqFlexRayConfig)
      IrqFlexRay0Config
        IrqFlexRay0CatConfig:
          IrqFlexRay0IBBusyCat = CAT1
          IrqFlexRay0MBSC0Cat = CAT1
          IrqFlexRay0MBSC1Cat = CAT1
          IrqFlexRay0NewData0Cat = CAT1
          IrqFlexRay0NewData1Cat = CAT1
          IrqFlexRay0OBBusyCat = CAT1
          IrqFlexRay0SR0Cat = CAT1
          IrqFlexRay0SR1Cat = CAT1
          IrqFlexRay0TimerInt0Cat = CAT1
          IrqFlexRay0TimerInt1Cat = CAT1
        IrqFlexRay0PrioConfig:
          IrqFlexRay0IBBusyPrio = 0
          IrqFlexRay0MBSC0Prio = 0
          IrqFlexRay0MBSC1Prio = 0
          IrqFlexRay0NewData0Prio = 0
          IrqFlexRay0NewData1Prio = 0
          IrqFlexRay0OBBusyPrio = 0
          IrqFlexRay0SR0Prio = 0
          IrqFlexRay0SR1Prio = 0
          IrqFlexRay0TimerInt0Prio = 0
          IrqFlexRay0TimerInt1Prio = 0
        IrqFlexRay0TosConfig:
          IrqFlexRay0IBBusyTos = CPU0
          IrqFlexRay0MBSC0Tos = CPU0
          IrqFlexRay0MBSC1Tos = CPU0
          IrqFlexRay0NewData0Tos = CPU0
          IrqFlexRay0NewData1Tos = CPU0
          IrqFlexRay0OBBusyTos = CPU0
          IrqFlexRay0SR0Tos = CPU0
          IrqFlexRay0SR1Tos = CPU0
          IrqFlexRay0TimerInt0Tos = CPU0
          IrqFlexRay0TimerInt1Tos = CPU0
    IrqPMU0Config_0 (IrqPMU0Config)
      IrqPMU0CatConfig: IrqPMU0SR0Cat=CAT1, IrqPMU0SR1Cat=CAT1
      IrqPMU0PrioConfig: IrqPMU0SR0Prio=0, IrqPMU0SR1Prio=0
      IrqPMU0TosConfig: IrqPMU0SR0Tos=CPU0, IrqPMU0SR1Tos=CPU0
    IrqScuConfig_0 (IrqScuConfig)
      IrqScuCatConfig: IrqScuDtsSRCat=CAT1, IrqScuEruSR0Cat=CAT1, IrqScuEruSR1Cat=CAT1, IrqScuEruSR2Cat=CAT1, IrqScuEruSR3Cat=CAT1
      IrqScuPrioConfig: IrqScuDtsSRPrio=0, IrqScuEruSR0Prio=0, IrqScuEruSR1Prio=0, IrqScuEruSR2Prio=0, IrqScuEruSR3Prio=0
      IrqScuTosConfig: IrqScuDtsSRTos=CPU0, IrqScuEruSR0Tos=CPU0, IrqScuEruSR1Tos=CPU0, IrqScuEruSR2Tos=CPU0, IrqScuEruSR3Tos=CPU0
    IrqGPSRGroupConfig_0 (IrqGPSRGroupConfig)
      IrqGPSRGroup0Config
        IrqGPSRGroup0CatConfig: IrqGPSRGroup0SR0Cat=CAT1, IrqGPSRGroup0SR1Cat=CAT1, IrqGPSRGroup0SR2Cat=CAT1, IrqGPSRGroup0SR3Cat=CAT1
        IrqGPSRGroup0PrioConfig: IrqGPSRGroup0SR0Prio=0, IrqGPSRGroup0SR1Prio=0, IrqGPSRGroup0SR2Prio=0, IrqGPSRGroup0SR3Prio=0
        IrqGPSRGroup0TosConfig: IrqGPSRGroup0SR0Tos=CPU0, IrqGPSRGroup0SR1Tos=CPU0, IrqGPSRGroup0SR2Tos=CPU0, IrqGPSRGroup0SR3Tos=CPU0
      IrqGPSRGroup1Config
        IrqGPSRGroup1CatConfig: IrqGPSRGroup1SR0Cat=CAT1, IrqGPSRGroup1SR1Cat=CAT1, IrqGPSRGroup1SR2Cat=CAT1, IrqGPSRGroup1SR3Cat=CAT1
        IrqGPSRGroup1PrioConfig: IrqGPSRGroup1SR0Prio=0, IrqGPSRGroup1SR1Prio=0, IrqGPSRGroup1SR2Prio=0, IrqGPSRGroup1SR3Prio=0
        IrqGPSRGroup1TosConfig: IrqGPSRGroup1SR0Tos=CPU0, IrqGPSRGroup1SR1Tos=CPU0, IrqGPSRGroup1SR2Tos=CPU0, IrqGPSRGroup1SR3Tos=CPU0
      IrqGPSRGroup2Config
        IrqGPSRGroup2CatConfig: IrqGPSRGroup2SR0Cat=CAT1, IrqGPSRGroup2SR1Cat=CAT1, IrqGPSRGroup2SR2Cat=CAT1, IrqGPSRGroup2SR3Cat=CAT1
        IrqGPSRGroup2PrioConfig: IrqGPSRGroup2SR0Prio=0, IrqGPSRGroup2SR1Prio=0, IrqGPSRGroup2SR2Prio=0, IrqGPSRGroup2SR3Prio=0
        IrqGPSRGroup2TosConfig: IrqGPSRGroup2SR0Tos=CPU0, IrqGPSRGroup2SR1Tos=CPU0, IrqGPSRGroup2SR2Tos=CPU0, IrqGPSRGroup2SR3Tos=CPU0
    IrqGtmConfig_0 (IrqGtmConfig)
      IrqGtmAEIConfig
        IrqGtmAEICatConfig: IrqGtmAEICat=CAT1
        IrqGtmAEIPrioConfig: IrqGtmAEIPrio=0
        IrqGtmAEITosConfig: IrqGtmAEITos=CPU0
      IrqGtmARUConfig
        IrqGtmARUCatConfig: IrqGtmARUSR0Cat=CAT1, IrqGtmARUSR1Cat=CAT1, IrqGtmARUSR2Cat=CAT1
        IrqGtmARUPrioConfig: IrqGtmARUSR0Prio=0, IrqGtmARUSR1Prio=0, IrqGtmARUSR2Prio=0
        IrqGtmARUTosConfig: IrqGtmARUSR0Tos=CPU0, IrqGtmARUSR1Tos=CPU0, IrqGtmARUSR2Tos=CPU0
      IrqGtmATOM0Config
        IrqGtmATOM0CatConfig: IrqGtmATOM0SR0Cat=CAT1, IrqGtmATOM0SR1Cat=CAT1, IrqGtmATOM0SR2Cat=CAT1, IrqGtmATOM0SR3Cat=CAT1
        IrqGtmATOM0PrioConfig: IrqGtmATOM0SR0Prio=0, IrqGtmATOM0SR1Prio=0, IrqGtmATOM0SR2Prio=0, IrqGtmATOM0SR3Prio=0
        IrqGtmATOM0TosConfig: IrqGtmATOM0SR0Tos=CPU0, IrqGtmATOM0SR1Tos=CPU0, IrqGtmATOM0SR2Tos=CPU0, IrqGtmATOM0SR3Tos=CPU0
      IrqGtmATOM1Config
        IrqGtmATOM1CatConfig: IrqGtmATOM1SR0Cat=CAT1, IrqGtmATOM1SR1Cat=CAT1, IrqGtmATOM1SR2Cat=CAT1, IrqGtmATOM1SR3Cat=CAT1
        IrqGtmATOM1PrioConfig: IrqGtmATOM1SR0Prio=0, IrqGtmATOM1SR1Prio=0, IrqGtmATOM1SR2Prio=0, IrqGtmATOM1SR3Prio=0
        IrqGtmATOM1TosConfig: IrqGtmATOM1SR0Tos=CPU0, IrqGtmATOM1SR1Tos=CPU0, IrqGtmATOM1SR2Tos=CPU0, IrqGtmATOM1SR3Tos=CPU0
      IrqGtmATOM2Config
        IrqGtmATOM2CatConfig: IrqGtmATOM2SR0Cat=CAT1, IrqGtmATOM2SR1Cat=CAT1, IrqGtmATOM2SR2Cat=CAT1, IrqGtmATOM2SR3Cat=CAT1
        IrqGtmATOM2PrioConfig: IrqGtmATOM2SR0Prio=0, IrqGtmATOM2SR1Prio=0, IrqGtmATOM2SR2Prio=0, IrqGtmATOM2SR3Prio=0
        IrqGtmATOM2TosConfig: IrqGtmATOM2SR0Tos=CPU0, IrqGtmATOM2SR1Tos=CPU0, IrqGtmATOM2SR2Tos=CPU0, IrqGtmATOM2SR3Tos=CPU0
      IrqGtmATOM3Config
        IrqGtmATOM3CatConfig: IrqGtmATOM3SR0Cat=CAT1, IrqGtmATOM3SR1Cat=CAT1, IrqGtmATOM3SR2Cat=CAT1, IrqGtmATOM3SR3Cat=CAT1
        IrqGtmATOM3PrioConfig: IrqGtmATOM3SR0Prio=0, IrqGtmATOM3SR1Prio=0, IrqGtmATOM3SR2Prio=0, IrqGtmATOM3SR3Prio=0
        IrqGtmATOM3TosConfig: IrqGtmATOM3SR0Tos=CPU0, IrqGtmATOM3SR1Tos=CPU0, IrqGtmATOM3SR2Tos=CPU0, IrqGtmATOM3SR3Tos=CPU0
      IrqGtmATOM4Config
        IrqGtmATOM4CatConfig: IrqGtmATOM4SR0Cat=CAT1, IrqGtmATOM4SR1Cat=CAT1, IrqGtmATOM4SR2Cat=CAT1, IrqGtmATOM4SR3Cat=CAT1
        IrqGtmATOM4PrioConfig: IrqGtmATOM4SR0Prio=0, IrqGtmATOM4SR1Prio=0, IrqGtmATOM4SR2Prio=0, IrqGtmATOM4SR3Prio=0
        IrqGtmATOM4TosConfig: IrqGtmATOM4SR0Tos=CPU0, IrqGtmATOM4SR1Tos=CPU0, IrqGtmATOM4SR2Tos=CPU0, IrqGtmATOM4SR3Tos=CPU0
      IrqGtmBRCConfig
        IrqGtmBRCCatConfig: IrqGtmBRCCat=CAT1
        IrqGtmBRCPrioConfig: IrqGtmBRCPrio=0
        IrqGtmBRCTosConfig: IrqGtmBRCTos=CPU0
      IrqGtmCMPConfig
        IrqGtmCMPCatConfig: IrqGtmCMPCat=CAT1
        IrqGtmCMPPrioConfig: IrqGtmCMPPrio=0
        IrqGtmCMPTosConfig: IrqGtmCMPTos=CPU0
      IrqGtmDPLLConfig
        IrqGtmDPLLCatConfig:
          IrqGtmDPLLSR0Cat = CAT1
          IrqGtmDPLLSR{10..19}Cat = CAT1
          IrqGtmDPLLSR1Cat = CAT1
          IrqGtmDPLLSR{20..26}Cat = CAT1
          IrqGtmDPLLSR{2..9}Cat = CAT1
        IrqGtmDPLLPrioConfig:
          IrqGtmDPLLSR0Prio = 0
          IrqGtmDPLLSR{10..19}Prio = 0
          IrqGtmDPLLSR1Prio = 0
          IrqGtmDPLLSR{20..26}Prio = 0
          IrqGtmDPLLSR{2..9}Prio = 0
        IrqGtmDPLLTosConfig:
          IrqGtmDPLLSR0Tos = CPU0
          IrqGtmDPLLSR{10..19}Tos = CPU0
          IrqGtmDPLLSR1Tos = CPU0
          IrqGtmDPLLSR{20..26}Tos = CPU0
          IrqGtmDPLLSR{2..9}Tos = CPU0
      IrqGtmERRConfig
        IrqGtmERRCatConfig: IrqGtmERRSRCat=CAT1
        IrqGtmERRPrioConfig: IrqGtmERRSRPrio=0
        IrqGtmERRTosConfig: IrqGtmERRSRTos=CPU0
      IrqGtmMCS0Config
        IrqGtmMCS0CatConfig:
          IrqGtmMCS0SR{0..7}Cat = CAT1
        IrqGtmMCS0PrioConfig:
          IrqGtmMCS0SR{0..7}Prio = 0
        IrqGtmMCS0TosConfig:
          IrqGtmMCS0SR{0..7}Tos = CPU0
      IrqGtmMCS1Config
        IrqGtmMCS1CatConfig:
          IrqGtmMCS1SR{0..7}Cat = CAT1
        IrqGtmMCS1PrioConfig:
          IrqGtmMCS1SR{0..7}Prio = 0
        IrqGtmMCS1TosConfig:
          IrqGtmMCS1SR{0..7}Tos = CPU0
      IrqGtmMCS2Config
        IrqGtmMCS2CatConfig:
          IrqGtmMCS2SR{0..7}Cat = CAT1
        IrqGtmMCS2PrioConfig:
          IrqGtmMCS2SR{0..7}Prio = 0
        IrqGtmMCS2TosConfig:
          IrqGtmMCS2SR{0..7}Tos = CPU0
      IrqGtmMCS3Config
        IrqGtmMCS3CatConfig:
          IrqGtmMCS3SR{0..7}Cat = CAT1
        IrqGtmMCS3PrioConfig:
          IrqGtmMCS3SR{0..7}Prio = 0
        IrqGtmMCS3TosConfig:
          IrqGtmMCS3SR{0..7}Tos = CPU0
      IrqGtmPSM0Config
        IrqGtmPSM0CatConfig:
          IrqGtmPSM0SR{0..7}Cat = CAT1
        IrqGtmPSM0PrioConfig:
          IrqGtmPSM0SR{0..7}Prio = 0
        IrqGtmPSM0TosConfig:
          IrqGtmPSM0SR{0..7}Tos = CPU0
      IrqGtmSPEConfig
        IrqGtmSPECatConfig: IrqGtmSPE0Cat=CAT1, IrqGtmSPE1Cat=CAT1
        IrqGtmSPEPrioConfig: IrqGtmSPE0Prio=0, IrqGtmSPE1Prio=0
        IrqGtmSPETosConfig: IrqGtmSPE0Tos=CPU0, IrqGtmSPE1Tos=CPU0
      IrqGtmTIM0Config
        IrqGtmTIM0CatConfig:
          IrqGtmTIM0SR{0..7}Cat = CAT1
        IrqGtmTIM0PrioConfig:
          IrqGtmTIM0SR{0..7}Prio = 0
        IrqGtmTIM0TosConfig:
          IrqGtmTIM0SR{0..7}Tos = CPU0
      IrqGtmTIM1Config
        IrqGtmTIM1CatConfig:
          IrqGtmTIM1SR{0..7}Cat = CAT1
        IrqGtmTIM1PrioConfig:
          IrqGtmTIM1SR{0..7}Prio = 0
        IrqGtmTIM1TosConfig:
          IrqGtmTIM1SR{0..7}Tos = CPU0
      IrqGtmTIM2Config
        IrqGtmTIM2CatConfig:
          IrqGtmTIM2SR{0..6}Cat = CAT1
          IrqGtmTIM2SR7Cat = CAT23
        IrqGtmTIM2PrioConfig:
          IrqGtmTIM2SR{0..6}Prio = 0
          IrqGtmTIM2SR7Prio = 9
        IrqGtmTIM2TosConfig:
          IrqGtmTIM2SR{0..7}Tos = CPU0
      IrqGtmTIM3Config
        IrqGtmTIM3CatConfig:
          IrqGtmTIM3SR{0..7}Cat = CAT1
        IrqGtmTIM3PrioConfig:
          IrqGtmTIM3SR{0..7}Prio = 0
        IrqGtmTIM3TosConfig:
          IrqGtmTIM3SR{0..7}Tos = CPU0
      IrqGtmTOM0Config
        IrqGtmTOM0CatConfig:
          IrqGtmTOM0SR{0..7}Cat = CAT1
        IrqGtmTOM0PrioConfig:
          IrqGtmTOM0SR{0..7}Prio = 0
        IrqGtmTOM0TosConfig:
          IrqGtmTOM0SR{0..7}Tos = CPU0
      IrqGtmTOM1Config
        IrqGtmTOM1CatConfig:
          IrqGtmTOM1SR{0..7}Cat = CAT1
        IrqGtmTOM1PrioConfig:
          IrqGtmTOM1SR{0..7}Prio = 0
        IrqGtmTOM1TosConfig:
          IrqGtmTOM1SR{0..7}Tos = CPU0
      IrqGtmTOM2Config
        IrqGtmTOM2CatConfig:
          IrqGtmTOM2SR{0..7}Cat = CAT1
        IrqGtmTOM2PrioConfig:
          IrqGtmTOM2SR{0..7}Prio = 0
        IrqGtmTOM2TosConfig:
          IrqGtmTOM2SR{0..7}Tos = CPU0
    IrqSentConfig_0 (IrqSentConfig)
      IrqSentCatConfig:
        IrqSentSR{0..9}Cat = CAT1
      IrqSentPrioConfig:
        IrqSentSR{0..9}Prio = 0
      IrqSentTosConfig:
        IrqSentSR{0..9}Tos = CPU0
    IrqI2CConfig_0 (IrqI2CConfig)
      IrqI2C0Config
        IrqI2C0CatConfig: IrqI2C0BReqCat=CAT1, IrqI2C0ErrCat=CAT1, IrqI2C0LBReqCat=CAT1, IrqI2C0LSReqCat=CAT1, IrqI2C0PCat=CAT1, IrqI2C0SReqCat=CAT1
        IrqI2C0PrioConfig: IrqI2C0BReqPrio=0, IrqI2C0ErrPrio=0, IrqI2C0LBReqPrio=0, IrqI2C0LSReqPrio=0, IrqI2C0PPrio=0, IrqI2C0SReqPrio=0
        IrqI2C0TosConfig: IrqI2C0BReqTos=CPU0, IrqI2C0ErrTos=CPU0, IrqI2C0LBReqTos=CPU0, IrqI2C0LSReqTos=CPU0, IrqI2C0PTos=CPU0, IrqI2C0SReqTos=CPU0
    IrqHSMConfig_0 (IrqHSMConfig)
      IrqHSMCatConfig: IrqHSMSR0Cat=CAT1, IrqHSMSR1Cat=CAT1
      IrqHSMPrioConfig: IrqHSMSR0Prio=0, IrqHSMSR1Prio=0
      IrqHSMTosConfig: IrqHSMSR0Tos=CPU0, IrqHSMSR1Tos=CPU0
    IrqHsslConfig_0 (IrqHsslConfig)
      IrqHsslCatConfig
        IrqHsslCokCatConfig: IrqHssl0CokCat=CAT1, IrqHssl1CokCat=CAT1, IrqHssl2CokCat=CAT1, IrqHssl3CokCat=CAT1, IrqHssl4CokCat=CAT1
        IrqHsslErrCatConfig: IrqHssl0ErrCat=CAT1, IrqHssl1ErrCat=CAT1, IrqHssl2ErrCat=CAT1, IrqHssl3ErrCat=CAT1, IrqHssl4ErrCat=CAT1
        IrqHsslExiCatConfig: IrqHsslExiCat=CAT1
        IrqHsslRdiCatConfig: IrqHssl0RdiCat=CAT1, IrqHssl1RdiCat=CAT1, IrqHssl2RdiCat=CAT1, IrqHssl3RdiCat=CAT1, IrqHssl4RdiCat=CAT1
        IrqHsslTrgCatConfig: IrqHssl0TrgCat=CAT1, IrqHssl1TrgCat=CAT1, IrqHssl2TrgCat=CAT1, IrqHssl3TrgCat=CAT1, IrqHssl4TrgCat=CAT1
      IrqHsslPrioConfig
        IrqHsslCokPrioConfig: IrqHssl0CokPrio=0, IrqHssl1CokPrio=0, IrqHssl2CokPrio=0, IrqHssl3CokPrio=0, IrqHssl4CokPrio=0
        IrqHsslErrPrioConfig: IrqHssl0ErrPrio=0, IrqHssl1ErrPrio=0, IrqHssl2ErrPrio=0, IrqHssl3ErrPrio=0, IrqHssl4ErrPrio=0
        IrqHsslExiPrioConfig: IrqHsslExiPrio=0
        IrqHsslRdiPrioConfig: IrqHssl0RdiPrio=0, IrqHssl1RdiPrio=0, IrqHssl2RdiPrio=0, IrqHssl3RdiPrio=0, IrqHssl4RdiPrio=0
        IrqHsslTrgPrioConfig: IrqHssl0TrgPrio=0, IrqHssl1TrgPrio=0, IrqHssl2TrgPrio=0, IrqHssl3TrgPrio=0, IrqHssl4TrgPrio=0
      IrqHsslTosConfig
        IrqHsslCokTosConfig: IrqHssl0CokTos=CPU0, IrqHssl1CokTos=CPU0, IrqHssl2CokTos=CPU0, IrqHssl3CokTos=CPU0, IrqHssl4CokTos=CPU0
        IrqHsslErrTosConfig: IrqHssl0ErrTos=CPU0, IrqHssl1ErrTos=CPU0, IrqHssl2ErrTos=CPU0, IrqHssl3ErrTos=CPU0, IrqHssl4ErrTos=CPU0
        IrqHsslExiTosConfig: IrqHsslExiTos=CPU0
        IrqHsslRdiTosConfig: IrqHssl0RdiTos=CPU0, IrqHssl1RdiTos=CPU0, IrqHssl2RdiTos=CPU0, IrqHssl3RdiTos=CPU0, IrqHssl4RdiTos=CPU0
        IrqHsslTrgTosConfig: IrqHssl0TrgTos=CPU0, IrqHssl1TrgTos=CPU0, IrqHssl2TrgTos=CPU0, IrqHssl3TrgTos=CPU0, IrqHssl4TrgTos=CPU0
    CommonPublishedInformation:
      ArMajorVersion = 0
      ArMinorVersion = 0
      ArPatchVersion = 0
      ModuleId = 255
      Release = _TRICORE_TC275
      SwMajorVersion = 5
      SwMinorVersion = 1
      SwPatchVersion = 0
      VendorId = 17
