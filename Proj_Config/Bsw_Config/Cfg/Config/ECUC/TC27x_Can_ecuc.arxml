AUTOSAR XML (schema 00046)
package /ActiveEcuC
  module config Can: implementation-config-variant=VARIANT-PRE-COMPILE, module-description=Can_Impl
    CanConfigSet
      CT_DBCNetWork_78f82e94 (CanController):
        CanControllerActivation = true
        CanBusoffProcessing = INTERRUPT
        CanControllerBaseAddress = 4026630912
        CanControllerId = 0
        CanRxProcessing = INTERRUPT
        CanTxProcessing = INTERRUPT
        CanWakeupProcessing = INTERRUPT
        CanWakeupSupport = false
        CanWakeupSourceId = 0
        CanPhysicalNode = Node1
        CanIOPort = b_001
        CanInterruptPriority = 10
        CanSRC = 1
        CanChannelCanObjectStartIndex = 0
        CanNumberOfCANObj = 20
        CanSrcTos = CPU0
        CanInterruptGroupPriority = 0
        CanClockFrequency = 80000000
        CanControllerDefaultBaudrate = CanControllerBaudrateConfig
        CanControllerSystemRef = CT_DBCNetWork
        CanWakeupSourceRef = CN_DBCNetWork_9ed72b09
        CanCpuClockRef = McuClockReferencePoint
        CanControllerBaudrateConfig:
          CanControllerBaudRate = 500
          CanControllerBaudRateConfigID = 0
          CanControllerPropSeg = 5
          CanControllerSeg1 = 2
          CanControllerSeg2 = 2
          CanControllerSyncJumpWidth = 2
          CanBaudrateClock = 80000
          CanBaudratePrescaler = 16
          CanBaudrateDiv8 = false
        CanFilterMask: CanFilterMaskValue=0, CanFilterCodeValue=0, IsLocked=false
      CN_DBCNetWork_b9b38c08_Rx (CanHardwareObject):
        CanHandleType = BASIC
        CanIdType = STANDARD
        CanIdValue = 0
        CanObjectType = RECEIVE
        CanObjectId = 1
        CanHwProcessing = false
        CanObjectHwSize = 10
        CanObjectHwHandle = 1
        CanMaxDataLen = 8
        CanFdPaddingValue = 0
        CanObjectMultiplexedTransmission = false
        CanObjectHwFifo = false
        CanControllerRef = CT_DBCNetWork_78f82e94
        CanFilterMaskRef = CanFilterMask
      CN_DBCNetWork_9ed72b09_Tx (CanHardwareObject):
        CanHandleType = BASIC
        CanIdValue = 0
        CanObjectType = TRANSMIT
        CanIdType = STANDARD
        CanObjectId = 0
        CanHwProcessing = false
        CanObjectHwSize = 1
        CanObjectHwHandle = 0
        CanMaxDataLen = 8
        CanFdPaddingValue = 0
        CanObjectMultiplexedTransmission = false
        CanObjectHwFifo = false
        CanControllerRef = CT_DBCNetWork_78f82e94
    CanGeneral:
      CanIndex = 0
      CanChangeBaudrateApi = false
      CanDevErrorDetection = true
      CanHardwareCancellation = false
      CanIdenticalIdCancellation = false
      CanMainFunctionBusoffPeriod = 0.005
      CanMainFunctionModePeriod = 0.005
      CanMainFunctionWakeupPeriod = 0.005
      CanMultiplexedTransmission = false
      CanSetBaudrateApi = false
      CanTimeoutDuration = 0.01
      CanVersionInfoApi = false
      CanGenericPrecopy = false
      CanHardwareLoopCheck = true
      CanRxFullCANSupport = false
      CanTxFullCANSupport = false
      CanRxBasicCANSupport = true
      CanUseNestedCANInterrupts = false
      CanHardwareCancelByAppl = false
      CanIndividualProcessing = false
      CanGenericConfirmation = false
      CanGenericConfirmationAPI2 = false
      CanRxQueue = false
      CanSupportMixedID = false
      CanRxQueueSize = 10
      CanMultipleBasicCANObjects = false
      CanMultipleBasicCANTxObjects = false
      CanHardwareHandleType = UINT8
      CanOptimizeOneController = true
      CanInterruptCategory = CATEGORY2
      CanGetStatus = false
      CanInterruptLock = DRIVER
      CanWakeupSupport = false
      CanRamCheck = None
      CanOverrunNotification = DET
      CanReinitStart = false
      CanGenericPreTransmit = false
      CanFdSupport = NONE
      CanRuntimeMeasurementSupport = false
      CanMaxRxDataLen = 8
      CanMaxTxDataLen = 8
      CanUsePeripheralAccessApi = false
      CanEnableMultipleCanDriver = false
      CanMaxNumberOfHwCANChannels = 4
      CanMaxNumberOfHwCANChannelsR = 0
      CanMaxNumberOfHwCANObj = 256
      CanMaxNumberOfHwCANObjR = 0
      CanClockDividerMode = NORMAL
      CanClockDivider = 1
      CanBaseAddress = 4026630144
      CanBaseAddressR = 0
      CanSrcAddress = 4026763520
      CanSrcAddressR = 0
      CanClockSourceSelection = Fclc
      CanFreezeDisable = false
      CanMirrorModeSupport = false
      CanUseOsInterruptControl = true
      CanRxHwFiFoFullNotification = false
      CanFdIsoSupport = false
      CanFdNiso = false
      CanFdPed = false
      CanSafeBswChecks = false
      CanSilentModeSupport = false
      CanHwTxFifoSupport = false
      CanCheckWakeupCanRetType = false
      CanFdHardwareBufferOptimization = false
      CanCounterRef = SystemTimer_Core0
      CanMainFunctionRWPeriods
