AUTOSAR XML (schema 00046)
package /ActiveEcuC
  module config Can: implementation-config-variant=VARIANT-PRE-COMPILE, module-description=Can_Impl
    CanConfigSet
      CT_DBCNetWork_78f82e94 (CanController):
        CanControllerActivation = true
        CanBusoffProcessing = INTERRUPT
        CanControllerBaseAddress = 4026630912
        CanControllerId = 0
        CanRxProcessing = INTERRUPT
        CanTxProcessing = INTERRUPT
        CanWakeupProcessing = INTERRUPT
        CanWakeupSupport = false
        CanWakeupSourceId = 0
        CanPhysicalNode = Node1
        CanIOPort = b_001
        CanInterruptPriority = 10
        CanSRC = 1
        CanChannelCanObjectStartIndex = 0
        CanNumberOfCANObj = 20
        CanSrcTos = CPU0
        CanInterruptGroupPriority = 0
        CanClockFrequency = 80000000
        CanControllerDefaultBaudrate = CT_DBCNetWork_78f82e94/CanControllerBaudrateConfig
        CanControllerSystemRef = CT_DBCNetWork
        CanWakeupSourceRef = CN_DBCNetWork_9ed72b09
        CanCpuClockRef = McuClockReferencePoint
        CanControllerBaudrateConfig:
          CanControllerBaudRate = 500
          CanControllerBaudRateConfigID = 0
          CanControllerPropSeg = 5
          CanControllerSeg1 = 2
          CanControllerSeg2 = 2
          CanControllerSyncJumpWidth = 2
          CanBaudrateClock = 80000
          CanBaudratePrescaler = 16
          CanBaudrateDiv8 = false
        CanFilterMask: CanFilterMaskValue=1792, CanFilterCodeValue=1536, IsLocked=false
      8 x CanHardwareObject, all with CanIdType=STANDARD, CanHwProcessing=false, CanMaxDataLen=8, CanFdPaddingValue=0, CanObjectMultiplexedTransmission=false, CanObjectHwFifo=false, CanControllerRef=CT_DBCNetWork_78f82e94:
        CN_DBCNetWork_b9b38c08_Rx_SupB_Button_Control: CanHandleType=FULL, CanIdValue=1025, CanObjectType=RECEIVE, CanObjectId=5, CanObjectHwSize=1, CanObjectHwHandle=5
        CN_DBCNetWork_9ed72b09_Tx: CanHandleType=BASIC, CanIdValue=0, CanObjectType=TRANSMIT, CanObjectId=0, CanObjectHwSize=1, CanObjectHwHandle=0
        CN_DBCNetWork_b9b38c08_Rx_Meg_PhyDiag_Tp: CanHandleType=FULL, CanIdValue=1793, CanObjectId=2, CanObjectType=RECEIVE, CanObjectHwSize=1, CanObjectHwHandle=2
        CN_DBCNetWork_b9b38c08_Rx_SupB_Led_Control: CanHandleType=FULL, CanIdValue=1024, CanObjectId=6, CanObjectType=RECEIVE, CanObjectHwSize=1, CanObjectHwHandle=6
        CN_DBCNetWork_b9b38c08_Rx_SupC_Function_1: CanHandleType=FULL, CanIdValue=1026, CanObjectId=4, CanObjectType=RECEIVE, CanObjectHwSize=1, CanObjectHwHandle=4
        CN_DBCNetWork_b9b38c08_Rx_SupC_Function_2: CanHandleType=FULL, CanIdValue=1027, CanObjectId=3, CanObjectType=RECEIVE, CanObjectHwSize=1, CanObjectHwHandle=3
        CN_DBCNetWork_b9b38c08_Rx_NM: CanHandleType=BASIC, CanIdValue=1536, CanObjectId=7, CanObjectType=RECEIVE, CanObjectHwSize=2, CanObjectHwHandle=7, CanFilterMaskRef=CanFilterMask
        CN_DBCNetWork_b9b38c08_Rx_Meg_FunDiag_Tp: CanHandleType=FULL, CanIdValue=2015, CanObjectId=1, CanObjectType=RECEIVE, CanObjectHwSize=1, CanObjectHwHandle=1
      CT_DBCNetWork_Can0_5928070d (CanController):
        CanControllerActivation = true
        CanBusoffProcessing = INTERRUPT
        CanControllerBaseAddress = 4026630656
        CanControllerId = 1
        CanRxProcessing = INTERRUPT
        CanTxProcessing = INTERRUPT
        CanWakeupProcessing = INTERRUPT
        CanWakeupSupport = false
        CanWakeupSourceId = 0
        CanPhysicalNode = Node0
        CanIOPort = b_001
        CanInterruptPriority = 10
        CanSRC = 0
        CanChannelCanObjectStartIndex = 20
        CanNumberOfCANObj = 7
        CanSrcTos = CPU0
        CanInterruptGroupPriority = 0
        CanClockFrequency = 80000000
        CanControllerDefaultBaudrate = CT_DBCNetWork_Can0_5928070d/CanControllerBaudrateConfig
        CanControllerSystemRef = CT_DBCNetWork_Can0
        CanWakeupSourceRef = CN_DBCNetWork_Can0_7c554129
        CanCpuClockRef = McuClockReferencePoint
        CanControllerBaudrateConfig:
          CanControllerBaudRate = 500
          CanControllerBaudRateConfigID = 0
          CanControllerPropSeg = 5
          CanControllerSeg1 = 2
          CanControllerSeg2 = 2
          CanControllerSyncJumpWidth = 2
          CanBaudrateClock = 80000
          CanBaudratePrescaler = 16
          CanBaudrateDiv8 = false
        CanFilterMask_Can0 (CanFilterMask): CanFilterMaskValue=0, CanFilterCodeValue=0, IsLocked=false
      CN_DBCNetWork_Can0_7c554129_Tx (CanHardwareObject):
        CanHandleType = BASIC
        CanIdValue = 0
        CanObjectType = TRANSMIT
        CanIdType = STANDARD
        CanObjectId = 8
        CanHwProcessing = false
        CanObjectHwSize = 1
        CanObjectHwHandle = 20
        CanMaxDataLen = 8
        CanFdPaddingValue = 0
        CanObjectMultiplexedTransmission = false
        CanObjectHwFifo = false
        CanControllerRef = CT_DBCNetWork_Can0_5928070d
      CN_DBCNetWork_Can0_3e6cf38a_Rx (CanHardwareObject):
        CanHandleType = BASIC
        CanIdType = STANDARD
        CanIdValue = 0
        CanObjectType = RECEIVE
        CanObjectId = 9
        CanHwProcessing = false
        CanObjectHwSize = 2
        CanObjectHwHandle = 21
        CanMaxDataLen = 8
        CanFdPaddingValue = 0
        CanObjectMultiplexedTransmission = false
        CanObjectHwFifo = false
        CanControllerRef = CT_DBCNetWork_Can0_5928070d
        CanFilterMaskRef = CanFilterMask_Can0
    CanGeneral:
      CanIndex = 0
      CanChangeBaudrateApi = false
      CanDevErrorDetection = true
      CanHardwareCancellation = false
      CanIdenticalIdCancellation = false
      CanMainFunctionBusoffPeriod = 0.005
      CanMainFunctionModePeriod = 0.005
      CanMainFunctionWakeupPeriod = 0.005
      CanMultiplexedTransmission = false
      CanSetBaudrateApi = false
      CanTimeoutDuration = 0.01
      CanVersionInfoApi = false
      CanGenericPrecopy = false
      CanHardwareLoopCheck = true
      CanRxFullCANSupport = true
      CanTxFullCANSupport = false
      CanRxBasicCANSupport = true
      CanUseNestedCANInterrupts = false
      CanHardwareCancelByAppl = false
      CanIndividualProcessing = false
      CanGenericConfirmation = false
      CanGenericConfirmationAPI2 = false
      CanRxQueue = false
      CanSupportMixedID = false
      CanRxQueueSize = 10
      CanMultipleBasicCANObjects = false
      CanMultipleBasicCANTxObjects = false
      CanHardwareHandleType = UINT8
      CanOptimizeOneController = false
      CanInterruptCategory = CATEGORY2
      CanGetStatus = false
      CanInterruptLock = DRIVER
      CanWakeupSupport = false
      CanRamCheck = None
      CanOverrunNotification = DET
      CanReinitStart = false
      CanGenericPreTransmit = false
      CanFdSupport = NONE
      CanRuntimeMeasurementSupport = false
      CanMaxRxDataLen = 8
      CanMaxTxDataLen = 8
      CanUsePeripheralAccessApi = false
      CanEnableMultipleCanDriver = false
      CanMaxNumberOfHwCANChannels = 4
      CanMaxNumberOfHwCANChannelsR = 0
      CanMaxNumberOfHwCANObj = 256
      CanMaxNumberOfHwCANObjR = 0
      CanClockDividerMode = NORMAL
      CanClockDivider = 1
      CanBaseAddress = 4026630144
      CanBaseAddressR = 0
      CanSrcAddress = 4026763520
      CanSrcAddressR = 0
      CanClockSourceSelection = Fclc
      CanFreezeDisable = false
      CanMirrorModeSupport = false
      CanUseOsInterruptControl = true
      CanRxHwFiFoFullNotification = false
      CanFdIsoSupport = false
      CanFdNiso = false
      CanFdPed = false
      CanSafeBswChecks = false
      CanSilentModeSupport = false
      CanHwTxFifoSupport = false
      CanCheckWakeupCanRetType = false
      CanFdHardwareBufferOptimization = false
      CanCounterRef = SystemTimer_Core0
      CanMainFunctionRWPeriods
