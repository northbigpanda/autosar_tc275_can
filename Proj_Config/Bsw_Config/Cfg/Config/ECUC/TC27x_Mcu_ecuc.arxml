[part 1 of 2: package /Mcu]
AUTOSAR XML (schema 00046)
package /Mcu
  module config Mcu: implementation-config-variant=VARIANT-POST-BUILD-LOADABLE, module-description=Mcu_Impl
    McuPublishedInformation
      18 x McuResetReasonConf:
        MCU_CB0_RESET: McuResetReason=8
        MCU_CB1_RESET: McuResetReason=9
        MCU_CB3_RESET: McuResetReason=10
        MCU_ESR0_RESET: McuResetReason=0
        MCU_ESR1_RESET: McuResetReason=1
        MCU_EVR13_RESET: McuResetReason=12
        MCU_EVR33_RESET: McuResetReason=13
        MCU_POWER_ON_RESET: McuResetReason=7
        MCU_RESET_MULTIPLE: McuResetReason=254
        MCU_RESET_UNDEFINED: McuResetReason=255
        MCU_SMU_RESET: McuResetReason=2
        MCU_STBYR_RESET: McuResetReason=15
        MCU_STM0_RESET: McuResetReason=4
        MCU_STM1_RESET: McuResetReason=5
        MCU_STM2_RESET: McuResetReason=6
        MCU_SUPPLY_WDOG_RESET: McuResetReason=14
        MCU_SW_RESET: McuResetReason=3
        MCU_TP_RESET: McuResetReason=11
    McuGeneralConfiguration:
      McuClearColdResetApi = false
      McuDeInitApi = false
      McuDevErrorDetect = false
      McuErayPllDisable = false
      McuErayPllInitDelay = 10
      McuFmPllEnable = false
      McuGetRamStateApi = false
      McuIdleModeCpuCore = INDIVIDUAL_CORES
      McuInitClock = true
      McuMainOscillatorFrequency = 20
      McuNoPll = false
      McuPBFixedAddress = false
      McuPerformResetApi = true
      McuPllInitDelay = 10
      McuResetSfrAtInit = false
      McuRunningInUser0Mode = false
      McuSystemModeCpuCore = CPU_CORE_0
      McuUserModeDeInitApiEnable = false
      McuUserModeInitApiEnable = false
      McuUserModeRuntimeApiEnable = false
      McuVersionInfoApi = false
    McuModuleConfiguration_0 (McuModuleConfiguration):
      McuClockSrcFailureNotification = DISABLED
      McuNumberOfMcuModes = 1
      McuRamSectors = 0
      McuResetSetting = 2
      McuStm{0..2}ResetDisable = false
      AscLinConfiguration: AscLin0=USE_FOR_NONE, AscLin1=USE_FOR_NONE, AscLin2=USE_FOR_NONE, AscLin3=USE_FOR_NONE
      GtmConfiguration_0 (GtmConfiguration)
        5 x Atom:
          Atom_0
            8 x AtomChannel:
              AtomChannel_0
                AtomChannelAruConfiguration:
                  AtomChAruBlockingMode = GTM_ABM_DISABLED
                  AtomChAruReadAddress0 = 510
                  AtomChAruReadAddress1 = 510
                  AtomChannelAruEnable = false
                  AtomChannelCpuWriteRequest = false
                AtomChannelEnable: AtomChDisableOnAgcTrigger=false, AtomChannelEnable=AT_START
                AtomChannelInterrupt:
                  AtomCcu0Notification = NULL_PTR
                  AtomCcu1Notification = NULL_PTR
                  AtomGlobalCcuSel = false
                  AtomIntEnableOnCcu0Trigger = false
                  AtomIntEnableOnCcu1Trigger = false
                  AtomInterruptMode = GTM_INTERRUPT_LEVEL_MODE
                  AtomNotification = NULL_PTR
                AtomChannelOutput:
                  AtomChOutputDisableOnAgcTrig = false
                  AtomChannelOutputControl = DONT_ENABLE_CHANNEL_OUTPUT
                  AtomChannelOutputSignalLevel = LOW
                  AtomChannelPortPinSelect = TOUT9_SELC_PORT0_PIN0
                AtomChannelTimerParameters:
                  AtomChEnableForceUpdate = false
                  AtomChResetCn0OnForceUpdate = false
                  AtomChShadowCompareValSr0 = 0
                  AtomChShadowCompareValSr1 = 0
                  AtomChSomcCompareStrategy = TIMEBASE_GREATER_EQUAL_TO_CMx
                  AtomChSomcTimebaseForComparison = TBU_TS1
                  AtomChUpdateEnableOnCn0Reset = false
                  AtomChannelClockSelect = GTM_CONFIGURABLE_CLOCK_0
                  AtomChannelCompareValueCm0 = 0
                  AtomChannelCompareValueCm1 = 0
                  AtomChannelCounterCn0Reset = ON_COMPARE_MATCH_ON_CHANNEL
                  AtomChannelCounterValCn0 = 0
                  AtomChannelModeSelect = ATOM_SIG_OUTPUT_MODE_IMMEDIATE
                  AtomChannelOneShotMode = false
                  AtomChannelTriggerOutput = TRIG_FROM_PREVIOUS_CHANNEL
                  AtomModeControlBits = 0
                  AtomServeLastAruCommStrategy = false
                AtomChannelUsage: AtomChannelUsage=USED_BY_OTHER_DRIVERS_OR_UNUSED
              AtomChannel_1
                AtomChannelAruConfiguration:
                  AtomChAruBlockingMode = GTM_ABM_DISABLED
                  AtomChAruReadAddress0 = 510
                  AtomChAruReadAddress1 = 510
                  AtomChannelAruEnable = false
                  AtomChannelCpuWriteRequest = false
                AtomChannelEnable: AtomChDisableOnAgcTrigger=false, AtomChannelEnable=AT_START
                AtomChannelInterrupt:
                  AtomCcu0Notification = NULL_PTR
                  AtomCcu1Notification = NULL_PTR
                  AtomGlobalCcuSel = false
                  AtomIntEnableOnCcu0Trigger = false
                  AtomIntEnableOnCcu1Trigger = false
                  AtomInterruptMode = GTM_INTERRUPT_LEVEL_MODE
                  AtomNotification = NULL_PTR
                AtomChannelOutput:
                  AtomChOutputDisableOnAgcTrig = false
                  AtomChannelOutputControl = DONT_ENABLE_CHANNEL_OUTPUT
                  AtomChannelOutputSignalLevel = LOW
                  AtomChannelPortPinSelect = TOUT10_SELC_PORT0_PIN1
                AtomChannelTimerParameters:
                  AtomChEnableForceUpdate = false
                  AtomChResetCn0OnForceUpdate = false
                  AtomChShadowCompareValSr0 = 0
                  AtomChShadowCompareValSr1 = 0
                  AtomChSomcCompareStrategy = TIMEBASE_GREATER_EQUAL_TO_CMx
                  AtomChSomcTimebaseForComparison = TBU_TS1
                  AtomChUpdateEnableOnCn0Reset = false
                  AtomChannelClockSelect = GTM_CONFIGURABLE_CLOCK_0
                  AtomChannelCompareValueCm0 = 0
                  AtomChannelCompareValueCm1 = 0
                  AtomChannelCounterCn0Reset = ON_COMPARE_MATCH_ON_CHANNEL
                  AtomChannelCounterValCn0 = 0
                  AtomChannelModeSelect = ATOM_SIG_OUTPUT_MODE_IMMEDIATE
                  AtomChannelOneShotMode = false
                  AtomChannelTriggerOutput = TRIG_FROM_PREVIOUS_CHANNEL
                  AtomModeControlBits = 0
                  AtomServeLastAruCommStrategy = false
                AtomChannelUsage: AtomChannelUsage=USED_BY_OTHER_DRIVERS_OR_UNUSED
              AtomChannel_2
                AtomChannelAruConfiguration:
                  AtomChAruBlockingMode = GTM_ABM_DISABLED
                  AtomChAruReadAddress0 = 510
                  AtomChAruReadAddress1 = 510
                  AtomChannelAruEnable = false
                  AtomChannelCpuWriteRequest = false
                AtomChannelEnable: AtomChDisableOnAgcTrigger=false, AtomChannelEnable=AT_START
                AtomChannelInterrupt:
                  AtomCcu0Notification = NULL_PTR
                  AtomCcu1Notification = NULL_PTR
                  AtomGlobalCcuSel = false
                  AtomIntEnableOnCcu0Trigger = false
                  AtomIntEnableOnCcu1Trigger = false
                  AtomInterruptMode = GTM_INTERRUPT_LEVEL_MODE
                  AtomNotification = NULL_PTR
                AtomChannelOutput:
                  AtomChOutputDisableOnAgcTrig = false
                  AtomChannelOutputControl = DONT_ENABLE_CHANNEL_OUTPUT
                  AtomChannelOutputSignalLevel = LOW
                  AtomChannelPortPinSelect = TOUT12_SELC_PORT0_PIN3
                AtomChannelTimerParameters:
                  AtomChEnableForceUpdate = false
                  AtomChResetCn0OnForceUpdate = false
                  AtomChShadowCompareValSr0 = 0
                  AtomChShadowCompareValSr1 = 0
                  AtomChSomcCompareStrategy = TIMEBASE_GREATER_EQUAL_TO_CMx
                  AtomChSomcTimebaseForComparison = TBU_TS1
                  AtomChUpdateEnableOnCn0Reset = false
                  AtomChannelClockSelect = GTM_CONFIGURABLE_CLOCK_0
                  AtomChannelCompareValueCm0 = 0
                  AtomChannelCompareValueCm1 = 0
                  AtomChannelCounterCn0Reset = ON_COMPARE_MATCH_ON_CHANNEL
                  AtomChannelCounterValCn0 = 0
                  AtomChannelModeSelect = ATOM_SIG_OUTPUT_MODE_IMMEDIATE
                  AtomChannelOneShotMode = false
                  AtomChannelTriggerOutput = TRIG_FROM_PREVIOUS_CHANNEL
                  AtomModeControlBits = 0
                  AtomServeLastAruCommStrategy = false
                AtomChannelUsage: AtomChannelUsage=USED_BY_OTHER_DRIVERS_OR_UNUSED
              AtomChannel_3
                AtomChannelAruConfiguration:
                  AtomChAruBlockingMode = GTM_ABM_DISABLED
                  AtomChAruReadAddress0 = 510
                  AtomChAruReadAddress1 = 510
                  AtomChannelAruEnable = false
                  AtomChannelCpuWriteRequest = false
                AtomChannelEnable: AtomChDisableOnAgcTrigger=false, AtomChannelEnable=AT_START
                AtomChannelInterrupt:
                  AtomCcu0Notification = NULL_PTR
                  AtomCcu1Notification = NULL_PTR
                  AtomGlobalCcuSel = false
                  AtomIntEnableOnCcu0Trigger = false
                  AtomIntEnableOnCcu1Trigger = false
                  AtomInterruptMode = GTM_INTERRUPT_LEVEL_MODE
                  AtomNotification = NULL_PTR
                AtomChannelOutput:
                  AtomChOutputDisableOnAgcTrig = false
                  AtomChannelOutputControl = DONT_ENABLE_CHANNEL_OUTPUT
                  AtomChannelOutputSignalLevel = LOW
                  AtomChannelPortPinSelect = TOUT13_SELC_PORT0_PIN4
                AtomChannelTimerParameters:
                  AtomChEnableForceUpdate = false
                  AtomChResetCn0OnForceUpdate = false
                  AtomChShadowCompareValSr0 = 0
                  AtomChShadowCompareValSr1 = 0
                  AtomChSomcCompareStrategy = TIMEBASE_GREATER_EQUAL_TO_CMx
                  AtomChSomcTimebaseForComparison = TBU_TS1
                  AtomChUpdateEnableOnCn0Reset = false
                  AtomChannelClockSelect = GTM_CONFIGURABLE_CLOCK_0
                  AtomChannelCompareValueCm0 = 0
                  AtomChannelCompareValueCm1 = 0
                  AtomChannelCounterCn0Reset = ON_COMPARE_MATCH_ON_CHANNEL
                  AtomChannelCounterValCn0 = 0
                  AtomChannelModeSelect = ATOM_SIG_OUTPUT_MODE_IMMEDIATE
                  AtomChannelOneShotMode = false
                  AtomChannelTriggerOutput = TRIG_FROM_PREVIOUS_CHANNEL
                  AtomModeControlBits = 0
                  AtomServeLastAruCommStrategy = false
                AtomChannelUsage: AtomChannelUsage=USED_BY_OTHER_DRIVERS_OR_UNUSED
              AtomChannel_4
                AtomChannelAruConfiguration:
                  AtomChAruBlockingMode = GTM_ABM_DISABLED
                  AtomChAruReadAddress0 = 510
                  AtomChAruReadAddress1 = 510
                  AtomChannelAruEnable = false
                  AtomChannelCpuWriteRequest = false
                AtomChannelEnable: AtomChDisableOnAgcTrigger=false, AtomChannelEnable=AT_START
                AtomChannelInterrupt:
                  AtomCcu0Notification = NULL_PTR
                  AtomCcu1Notification = NULL_PTR
                  AtomGlobalCcuSel = false
                  AtomIntEnableOnCcu0Trigger = false
                  AtomIntEnableOnCcu1Trigger = false
                  AtomInterruptMode = GTM_INTERRUPT_LEVEL_MODE
                  AtomNotification = NULL_PTR
                AtomChannelOutput:
                  AtomChOutputDisableOnAgcTrig = false
                  AtomChannelOutputControl = DONT_ENABLE_CHANNEL_OUTPUT
                  AtomChannelOutputSignalLevel = LOW
                  AtomChannelPortPinSelect = TOUT14_SELC_PORT0_PIN5
                AtomChannelTimerParameters:
                  AtomChEnableForceUpdate = false
                  AtomChResetCn0OnForceUpdate = false
                  AtomChShadowCompareValSr0 = 0
                  AtomChShadowCompareValSr1 = 0
                  AtomChSomcCompareStrategy = TIMEBASE_GREATER_EQUAL_TO_CMx
                  AtomChSomcTimebaseForComparison = TBU_TS1
                  AtomChUpdateEnableOnCn0Reset = false
                  AtomChannelClockSelect = GTM_CONFIGURABLE_CLOCK_0
                  AtomChannelCompareValueCm0 = 0
                  AtomChannelCompareValueCm1 = 0
                  AtomChannelCounterCn0Reset = ON_COMPARE_MATCH_ON_CHANNEL
                  AtomChannelCounterValCn0 = 0
                  AtomChannelModeSelect = ATOM_SIG_OUTPUT_MODE_IMMEDIATE
                  AtomChannelOneShotMode = false
                  AtomChannelTriggerOutput = TRIG_FROM_PREVIOUS_CHANNEL
                  AtomModeControlBits = 0
                  AtomServeLastAruCommStrategy = false
                AtomChannelUsage: AtomChannelUsage=USED_BY_OTHER_DRIVERS_OR_UNUSED
              AtomChannel_5
                AtomChannelAruConfiguration:
                  AtomChAruBlockingMode = GTM_ABM_DISABLED
                  AtomChAruReadAddress0 = 510
                  AtomChAruReadAddress1 = 510
                  AtomChannelAruEnable = false
                  AtomChannelCpuWriteRequest = false
                AtomChannelEnable: AtomChDisableOnAgcTrigger=false, AtomChannelEnable=AT_START
                AtomChannelInterrupt:
                  AtomCcu0Notification = NULL_PTR
                  AtomCcu1Notification = NULL_PTR
                  AtomGlobalCcuSel = false
                  AtomIntEnableOnCcu0Trigger = false
                  AtomIntEnableOnCcu1Trigger = false
                  AtomInterruptMode = GTM_INTERRUPT_LEVEL_MODE
                  AtomNotification = NULL_PTR
                AtomChannelOutput:
                  AtomChOutputDisableOnAgcTrig = false
                  AtomChannelOutputControl = DONT_ENABLE_CHANNEL_OUTPUT
                  AtomChannelOutputSignalLevel = LOW
                  AtomChannelPortPinSelect = TOUT15_SELC_PORT0_PIN6
                AtomChannelTimerParameters:
                  AtomChEnableForceUpdate = false
                  AtomChResetCn0OnForceUpdate = false
                  AtomChShadowCompareValSr0 = 0
                  AtomChShadowCompareValSr1 = 0
                  AtomChSomcCompareStrategy = TIMEBASE_GREATER_EQUAL_TO_CMx
                  AtomChSomcTimebaseForComparison = TBU_TS1
                  AtomChUpdateEnableOnCn0Reset = false
                  AtomChannelClockSelect = GTM_CONFIGURABLE_CLOCK_0
                  AtomChannelCompareValueCm0 = 0
                  AtomChannelCompareValueCm1 = 0
                  AtomChannelCounterCn0Reset = ON_COMPARE_MATCH_ON_CHANNEL
                  AtomChannelCounterValCn0 = 0
                  AtomChannelModeSelect = ATOM_SIG_OUTPUT_MODE_IMMEDIATE
                  AtomChannelOneShotMode = false
                  AtomChannelTriggerOutput = TRIG_FROM_PREVIOUS_CHANNEL
                  AtomModeControlBits = 0
                  AtomServeLastAruCommStrategy = false
                AtomChannelUsage: AtomChannelUsage=USED_BY_OTHER_DRIVERS_OR_UNUSED
              AtomChannel_6
                AtomChannelAruConfiguration:
                  AtomChAruBlockingMode = GTM_ABM_DISABLED
                  AtomChAruReadAddress0 = 510
                  AtomChAruReadAddress1 = 510
                  AtomChannelAruEnable = false
                  AtomChannelCpuWriteRequest = false
                AtomChannelEnable: AtomChDisableOnAgcTrigger=false, AtomChannelEnable=AT_START
                AtomChannelInterrupt:
                  AtomCcu0Notification = NULL_PTR
                  AtomCcu1Notification = NULL_PTR
                  AtomGlobalCcuSel = false
                  AtomIntEnableOnCcu0Trigger = false
                  AtomIntEnableOnCcu1Trigger = false
                  AtomInterruptMode = GTM_INTERRUPT_LEVEL_MODE
                  AtomNotification = NULL_PTR
                AtomChannelOutput:
                  AtomChOutputDisableOnAgcTrig = false
                  AtomChannelOutputControl = DONT_ENABLE_CHANNEL_OUTPUT
                  AtomChannelOutputSignalLevel = LOW
                  AtomChannelPortPinSelect = TOUT16_SELC_PORT0_PIN7
                AtomChannelTimerParameters:
                  AtomChEnableForceUpdate = false
                  AtomChResetCn0OnForceUpdate = false
                  AtomChShadowCompareValSr0 = 0
                  AtomChShadowCompareValSr1 = 0
                  AtomChSomcCompareStrategy = TIMEBASE_GREATER_EQUAL_TO_CMx
                  AtomChSomcTimebaseForComparison = TBU_TS1
                  AtomChUpdateEnableOnCn0Reset = false
                  AtomChannelClockSelect = GTM_CONFIGURABLE_CLOCK_0
                  AtomChannelCompareValueCm0 = 0
                  AtomChannelCompareValueCm1 = 0
                  AtomChannelCounterCn0Reset = ON_COMPARE_MATCH_ON_CHANNEL
                  AtomChannelCounterValCn0 = 0
                  AtomChannelModeSelect = ATOM_SIG_OUTPUT_MODE_IMMEDIATE
                  AtomChannelOneShotMode = false
                  AtomChannelTriggerOutput = TRIG_FROM_PREVIOUS_CHANNEL
                  AtomModeControlBits = 0
                  AtomServeLastAruCommStrategy = false
                AtomChannelUsage: AtomChannelUsage=USED_BY_OTHER_DRIVERS_OR_UNUSED
              AtomChannel_7
                AtomChannelAruConfiguration:
                  AtomChAruBlockingMode = GTM_ABM_DISABLED
                  AtomChAruReadAddress0 = 510
                  AtomChAruReadAddress1 = 510
                  AtomChannelAruEnable = false
                  AtomChannelCpuWriteRequest = false
                AtomChannelEnable: AtomChDisableOnAgcTrigger=false, AtomChannelEnable=AT_START
                AtomChannelInterrupt:
                  AtomCcu0Notification = NULL_PTR
                  AtomCcu1Notification = NULL_PTR
                  AtomGlobalCcuSel = false
                  AtomIntEnableOnCcu0Trigger = false
                  AtomIntEnableOnCcu1Trigger = false
                  AtomInterruptMode = GTM_INTERRUPT_LEVEL_MODE
                  AtomNotification = NULL_PTR
                AtomChannelOutput:
                  AtomChOutputDisableOnAgcTrig = false
                  AtomChannelOutputControl = DONT_ENABLE_CHANNEL_OUTPUT
                  AtomChannelOutputSignalLevel = LOW
                  AtomChannelPortPinSelect = TOUT17_SELC_PORT0_PIN8
                AtomChannelTimerParameters:
                  AtomChEnableForceUpdate = false
                  AtomChResetCn0OnForceUpdate = false
                  AtomChShadowCompareValSr0 = 0
                  AtomChShadowCompareValSr1 = 0
                  AtomChSomcCompareStrategy = TIMEBASE_GREATER_EQUAL_TO_CMx
                  AtomChSomcTimebaseForComparison = TBU_TS1
                  AtomChUpdateEnableOnCn0Reset = false
                  AtomChannelClockSelect = GTM_CONFIGURABLE_CLOCK_0
                  AtomChannelCompareValueCm0 = 0
                  AtomChannelCompareValueCm1 = 0
                  AtomChannelCounterCn0Reset = ON_COMPARE_MATCH_ON_CHANNEL
                  AtomChannelCounterValCn0 = 0
                  AtomChannelModeSelect = ATOM_SIG_OUTPUT_MODE_IMMEDIATE
                  AtomChannelOneShotMode = false
                  AtomChannelTriggerOutput = TRIG_FROM_PREVIOUS_CHANNEL
                  AtomModeControlBits = 0
                  AtomServeLastAruCommStrategy = false
                AtomChannelUsage: AtomChannelUsage=USED_BY_OTHER_DRIVERS_OR_UNUSED
            AtomTriggerForAgc
              AtomAgcInternalTriggerSelect:
                AtomAgcIntTriggerFromChannel{0..7} = false
              AtomAgcTriggerByTimebase: AtomAgcTbuTimebaseSelect=TBU_TS0_TIMEBASE, AtomAgcTimeBaseTriggerEnable=false, AtomAgcTimebaseMatchValue=0
          Atom_1
            8 x AtomChannel:
              AtomChannel_0
                AtomChannelAruConfiguration:
                  AtomChAruBlockingMode = GTM_ABM_DISABLED
                  AtomChAruReadAddress0 = 510
                  AtomChAruReadAddress1 = 510
                  AtomChannelAruEnable = false
                  AtomChannelCpuWriteRequest = false
                AtomChannelEnable: AtomChDisableOnAgcTrigger=false, AtomChannelEnable=AT_START
                AtomChannelInterrupt:
                  AtomCcu0Notification = NULL_PTR
                  AtomCcu1Notification = NULL_PTR
                  AtomGlobalCcuSel = false
                  AtomIntEnableOnCcu0Trigger = false
                  AtomIntEnableOnCcu1Trigger = false
                  AtomInterruptMode = GTM_INTERRUPT_LEVEL_MODE
                  AtomNotification = NULL_PTR
                AtomChannelOutput:
                  AtomChOutputDisableOnAgcTrig = false
                  AtomChannelOutputControl = DONT_ENABLE_CHANNEL_OUTPUT
                  AtomChannelOutputSignalLevel = LOW
                  AtomChannelPortPinSelect = TOUT9_SELD_PORT0_PIN0
                AtomChannelTimerParameters:
                  AtomChEnableForceUpdate = false
                  AtomChResetCn0OnForceUpdate = false
                  AtomChShadowCompareValSr0 = 0
                  AtomChShadowCompareValSr1 = 0
                  AtomChSomcCompareStrategy = TIMEBASE_GREATER_EQUAL_TO_CMx
                  AtomChSomcTimebaseForComparison = TBU_TS1
                  AtomChUpdateEnableOnCn0Reset = false
                  AtomChannelClockSelect = GTM_CONFIGURABLE_CLOCK_0
                  AtomChannelCompareValueCm0 = 0
                  AtomChannelCompareValueCm1 = 0
                  AtomChannelCounterCn0Reset = ON_COMPARE_MATCH_ON_CHANNEL
                  AtomChannelCounterValCn0 = 0
                  AtomChannelModeSelect = ATOM_SIG_OUTPUT_MODE_IMMEDIATE
                  AtomChannelOneShotMode = false
                  AtomChannelTriggerOutput = TRIG_FROM_PREVIOUS_CHANNEL
                  AtomModeControlBits = 0
                  AtomServeLastAruCommStrategy = false
                AtomChannelUsage: AtomChannelUsage=USED_BY_OTHER_DRIVERS_OR_UNUSED
              AtomChannel_1
                AtomChannelAruConfiguration:
                  AtomChAruBlockingMode = GTM_ABM_DISABLED
                  AtomChAruReadAddress0 = 510
                  AtomChAruReadAddress1 = 510
                  AtomChannelAruEnable = false
                  AtomChannelCpuWriteRequest = false
                AtomChannelEnable: AtomChDisableOnAgcTrigger=false, AtomChannelEnable=AT_START
                AtomChannelInterrupt:
                  AtomCcu0Notification = NULL_PTR
                  AtomCcu1Notification = NULL_PTR
                  AtomGlobalCcuSel = false
                  AtomIntEnableOnCcu0Trigger = false
                  AtomIntEnableOnCcu1Trigger = false
                  AtomInterruptMode = GTM_INTERRUPT_LEVEL_MODE
                  AtomNotification = NULL_PTR
                AtomChannelOutput:
                  AtomChOutputDisableOnAgcTrig = false
                  AtomChannelOutputControl = DONT_ENABLE_CHANNEL_OUTPUT
                  AtomChannelOutputSignalLevel = LOW
                  AtomChannelPortPinSelect = TOUT10_SELD_PORT0_PIN1
                AtomChannelTimerParameters:
                  AtomChEnableForceUpdate = false
                  AtomChResetCn0OnForceUpdate = false
                  AtomChShadowCompareValSr0 = 0
                  AtomChShadowCompareValSr1 = 0
                  AtomChSomcCompareStrategy = TIMEBASE_GREATER_EQUAL_TO_CMx
                  AtomChSomcTimebaseForComparison = TBU_TS1
                  AtomChUpdateEnableOnCn0Reset = false
                  AtomChannelClockSelect = GTM_CONFIGURABLE_CLOCK_0
                  AtomChannelCompareValueCm0 = 0
                  AtomChannelCompareValueCm1 = 0
                  AtomChannelCounterCn0Reset = ON_COMPARE_MATCH_ON_CHANNEL
                  AtomChannelCounterValCn0 = 0
                  AtomChannelModeSelect = ATOM_SIG_OUTPUT_MODE_IMMEDIATE
                  AtomChannelOneShotMode = false
                  AtomChannelTriggerOutput = TRIG_FROM_PREVIOUS_CHANNEL
                  AtomModeControlBits = 0
                  AtomServeLastAruCommStrategy = false
                AtomChannelUsage: AtomChannelUsage=USED_BY_OTHER_DRIVERS_OR_UNUSED
              AtomChannel_2
                AtomChannelAruConfiguration:
                  AtomChAruBlockingMode = GTM_ABM_DISABLED
                  AtomChAruReadAddress0 = 510
                  AtomChAruReadAddress1 = 510
                  AtomChannelAruEnable = false
                  AtomChannelCpuWriteRequest = false
                AtomChannelEnable: AtomChDisableOnAgcTrigger=false, AtomChannelEnable=AT_START
                AtomChannelInterrupt:
                  AtomCcu0Notification = NULL_PTR
                  AtomCcu1Notification = NULL_PTR
                  AtomGlobalCcuSel = false
                  AtomIntEnableOnCcu0Trigger = false
                  AtomIntEnableOnCcu1Trigger = false
                  AtomInterruptMode = GTM_INTERRUPT_LEVEL_MODE
                  AtomNotification = NULL_PTR
                AtomChannelOutput:
                  AtomChOutputDisableOnAgcTrig = false
                  AtomChannelOutputControl = DONT_ENABLE_CHANNEL_OUTPUT
                  AtomChannelOutputSignalLevel = LOW
                  AtomChannelPortPinSelect = TOUT12_SELD_PORT0_PIN3
                AtomChannelTimerParameters:
                  AtomChEnableForceUpdate = false
                  AtomChResetCn0OnForceUpdate = false
                  AtomChShadowCompareValSr0 = 0
                  AtomChShadowCompareValSr1 = 0
                  AtomChSomcCompareStrategy = TIMEBASE_GREATER_EQUAL_TO_CMx
                  AtomChSomcTimebaseForComparison = TBU_TS1
                  AtomChUpdateEnableOnCn0Reset = false
                  AtomChannelClockSelect = GTM_CONFIGURABLE_CLOCK_0
                  AtomChannelCompareValueCm0 = 0
                  AtomChannelCompareValueCm1 = 0
                  AtomChannelCounterCn0Reset = ON_COMPARE_MATCH_ON_CHANNEL
                  AtomChannelCounterValCn0 = 0
                  AtomChannelModeSelect = ATOM_SIG_OUTPUT_MODE_IMMEDIATE
                  AtomChannelOneShotMode = false
                  AtomChannelTriggerOutput = TRIG_FROM_PREVIOUS_CHANNEL
                  AtomModeControlBits = 0
                  AtomServeLastAruCommStrategy = false
                AtomChannelUsage: AtomChannelUsage=USED_BY_OTHER_DRIVERS_OR_UNUSED
              AtomChannel_3
                AtomChannelAruConfiguration:
                  AtomChAruBlockingMode = GTM_ABM_DISABLED
                  AtomChAruReadAddress0 = 510
                  AtomChAruReadAddress1 = 510
                  AtomChannelAruEnable = false
                  AtomChannelCpuWriteRequest = false
                AtomChannelEnable: AtomChDisableOnAgcTrigger=false, AtomChannelEnable=AT_START
                AtomChannelInterrupt:
                  AtomCcu0Notification = NULL_PTR
                  AtomCcu1Notification = NULL_PTR
                  AtomGlobalCcuSel = false
                  AtomIntEnableOnCcu0Trigger = false
                  AtomIntEnableOnCcu1Trigger = false
                  AtomInterruptMode = GTM_INTERRUPT_LEVEL_MODE
                  AtomNotification = NULL_PTR
                AtomChannelOutput:
                  AtomChOutputDisableOnAgcTrig = false
                  AtomChannelOutputControl = DONT_ENABLE_CHANNEL_OUTPUT
                  AtomChannelOutputSignalLevel = LOW
                  AtomChannelPortPinSelect = TOUT13_SELD_PORT0_PIN4
                AtomChannelTimerParameters:
                  AtomChEnableForceUpdate = false
                  AtomChResetCn0OnForceUpdate = false
                  AtomChShadowCompareValSr0 = 0
                  AtomChShadowCompareValSr1 = 0
                  AtomChSomcCompareStrategy = TIMEBASE_GREATER_EQUAL_TO_CMx
                  AtomChSomcTimebaseForComparison = TBU_TS1
                  AtomChUpdateEnableOnCn0Reset = false
                  AtomChannelClockSelect = GTM_CONFIGURABLE_CLOCK_0
                  AtomChannelCompareValueCm0 = 0
                  AtomChannelCompareValueCm1 = 0
                  AtomChannelCounterCn0Reset = ON_COMPARE_MATCH_ON_CHANNEL
                  AtomChannelCounterValCn0 = 0
                  AtomChannelModeSelect = ATOM_SIG_OUTPUT_MODE_IMMEDIATE
                  AtomChannelOneShotMode = false
                  AtomChannelTriggerOutput = TRIG_FROM_PREVIOUS_CHANNEL
                  AtomModeControlBits = 0
                  AtomServeLastAruCommStrategy = false
                AtomChannelUsage: AtomChannelUsage=USED_BY_OTHER_DRIVERS_OR_UNUSED
              AtomChannel_4
                AtomChannelAruConfiguration:
                  AtomChAruBlockingMode = GTM_ABM_DISABLED
                  AtomChAruReadAddress0 = 510
                  AtomChAruReadAddress1 = 510
                  AtomChannelAruEnable = false
                  AtomChannelCpuWriteRequest = false
                AtomChannelEnable: AtomChDisableOnAgcTrigger=false, AtomChannelEnable=AT_START
                AtomChannelInterrupt:
                  AtomCcu0Notification = NULL_PTR
                  AtomCcu1Notification = NULL_PTR
                  AtomGlobalCcuSel = false
                  AtomIntEnableOnCcu0Trigger = false
                  AtomIntEnableOnCcu1Trigger = false
                  AtomInterruptMode = GTM_INTERRUPT_LEVEL_MODE
                  AtomNotification = NULL_PTR
                AtomChannelOutput:
                  AtomChOutputDisableOnAgcTrig = false
                  AtomChannelOutputControl = DONT_ENABLE_CHANNEL_OUTPUT
                  AtomChannelOutputSignalLevel = LOW
                  AtomChannelPortPinSelect = TOUT14_SELD_PORT0_PIN5
                AtomChannelTimerParameters:
                  AtomChEnableForceUpdate = false
                  AtomChResetCn0OnForceUpdate = false
                  AtomChShadowCompareValSr0 = 0
                  AtomChShadowCompareValSr1 = 0
                  AtomChSomcCompareStrategy = TIMEBASE_GREATER_EQUAL_TO_CMx
                  AtomChSomcTimebaseForComparison = TBU_TS1
                  AtomChUpdateEnableOnCn0Reset = false
                  AtomChannelClockSelect = GTM_CONFIGURABLE_CLOCK_0
                  AtomChannelCompareValueCm0 = 0
                  AtomChannelCompareValueCm1 = 0
                  AtomChannelCounterCn0Reset = ON_COMPARE_MATCH_ON_CHANNEL
                  AtomChannelCounterValCn0 = 0
                  AtomChannelModeSelect = ATOM_SIG_OUTPUT_MODE_IMMEDIATE
                  AtomChannelOneShotMode = false
                  AtomChannelTriggerOutput = TRIG_FROM_PREVIOUS_CHANNEL
                  AtomModeControlBits = 0
                  AtomServeLastAruCommStrategy = false
                AtomChannelUsage: AtomChannelUsage=USED_BY_OTHER_DRIVERS_OR_UNUSED
              AtomChannel_5
                AtomChannelAruConfiguration:
                  AtomChAruBlockingMode = GTM_ABM_DISABLED
                  AtomChAruReadAddress0 = 510
                  AtomChAruReadAddress1 = 510
                  AtomChannelAruEnable = false
                  AtomChannelCpuWriteRequest = false
                AtomChannelEnable: AtomChDisableOnAgcTrigger=false, AtomChannelEnable=AT_START
                AtomChannelInterrupt:
                  AtomCcu0Notification = NULL_PTR
                  AtomCcu1Notification = NULL_PTR
                  AtomGlobalCcuSel = false
                  AtomIntEnableOnCcu0Trigger = false
                  AtomIntEnableOnCcu1Trigger = false
                  AtomInterruptMode = GTM_INTERRUPT_LEVEL_MODE
                  AtomNotification = NULL_PTR
                AtomChannelOutput:
                  AtomChOutputDisableOnAgcTrig = false
                  AtomChannelOutputControl = DONT_ENABLE_CHANNEL_OUTPUT
                  AtomChannelOutputSignalLevel = LOW
                  AtomChannelPortPinSelect = TOUT15_SELD_PORT0_PIN6
                AtomChannelTimerParameters:
                  AtomChEnableForceUpdate = false
                  AtomChResetCn0OnForceUpdate = false
                  AtomChShadowCompareValSr0 = 0
                  AtomChShadowCompareValSr1 = 0
                  AtomChSomcCompareStrategy = TIMEBASE_GREATER_EQUAL_TO_CMx
                  AtomChSomcTimebaseForComparison = TBU_TS1
                  AtomChUpdateEnableOnCn0Reset = false
                  AtomChannelClockSelect = GTM_CONFIGURABLE_CLOCK_0
                  AtomChannelCompareValueCm0 = 0
                  AtomChannelCompareValueCm1 = 0
                  AtomChannelCounterCn0Reset = ON_COMPARE_MATCH_ON_CHANNEL
                  AtomChannelCounterValCn0 = 0
                  AtomChannelModeSelect = ATOM_SIG_OUTPUT_MODE_IMMEDIATE
                  AtomChannelOneShotMode = false
                  AtomChannelTriggerOutput = TRIG_FROM_PREVIOUS_CHANNEL
                  AtomModeControlBits = 0
                  AtomServeLastAruCommStrategy = false
                AtomChannelUsage: AtomChannelUsage=USED_BY_OTHER_DRIVERS_OR_UNUSED
              AtomChannel_6
                AtomChannelAruConfiguration:
                  AtomChAruBlockingMode = GTM_ABM_DISABLED
                  AtomChAruReadAddress0 = 510
                  AtomChAruReadAddress1 = 510
                  AtomChannelAruEnable = false
                  AtomChannelCpuWriteRequest = false
                AtomChannelEnable: AtomChDisableOnAgcTrigger=false, AtomChannelEnable=AT_START
                AtomChannelInterrupt:
                  AtomCcu0Notification = NULL_PTR
                  AtomCcu1Notification = NULL_PTR
                  AtomGlobalCcuSel = false
                  AtomIntEnableOnCcu0Trigger = false
                  AtomIntEnableOnCcu1Trigger = false
                  AtomInterruptMode = GTM_INTERRUPT_LEVEL_MODE
                  AtomNotification = NULL_PTR
                AtomChannelOutput:
                  AtomChOutputDisableOnAgcTrig = false
                  AtomChannelOutputControl = DONT_ENABLE_CHANNEL_OUTPUT
                  AtomChannelOutputSignalLevel = LOW
                  AtomChannelPortPinSelect = TOUT16_SELD_PORT0_PIN7
                AtomChannelTimerParameters:
                  AtomChEnableForceUpdate = false
                  AtomChResetCn0OnForceUpdate = false
                  AtomChShadowCompareValSr0 = 0
                  AtomChShadowCompareValSr1 = 0
                  AtomChSomcCompareStrategy = TIMEBASE_GREATER_EQUAL_TO_CMx
                  AtomChSomcTimebaseForComparison = TBU_TS1
                  AtomChUpdateEnableOnCn0Reset = false
                  AtomChannelClockSelect = GTM_CONFIGURABLE_CLOCK_0
                  AtomChannelCompareValueCm0 = 0
                  AtomChannelCompareValueCm1 = 0
                  AtomChannelCounterCn0Reset = ON_COMPARE_MATCH_ON_CHANNEL
                  AtomChannelCounterValCn0 = 0
                  AtomChannelModeSelect = ATOM_SIG_OUTPUT_MODE_IMMEDIATE
                  AtomChannelOneShotMode = false
                  AtomChannelTriggerOutput = TRIG_FROM_PREVIOUS_CHANNEL
                  AtomModeControlBits = 0
                  AtomServeLastAruCommStrategy = false
                AtomChannelUsage: AtomChannelUsage=USED_BY_OTHER_DRIVERS_OR_UNUSED
              AtomChannel_7
                AtomChannelAruConfiguration:
                  AtomChAruBlockingMode = GTM_ABM_DISABLED
                  AtomChAruReadAddress0 = 510
                  AtomChAruReadAddress1 = 510
                  AtomChannelAruEnable = false
                  AtomChannelCpuWriteRequest = false
                AtomChannelEnable: AtomChDisableOnAgcTrigger=false, AtomChannelEnable=AT_START
                AtomChannelInterrupt:
                  AtomCcu0Notification = NULL_PTR
                  AtomCcu1Notification = NULL_PTR
                  AtomGlobalCcuSel = false
                  AtomIntEnableOnCcu0Trigger = false
                  AtomIntEnableOnCcu1Trigger = false
                  AtomInterruptMode = GTM_INTERRUPT_LEVEL_MODE
                  AtomNotification = NULL_PTR
                AtomChannelOutput:
                  AtomChOutputDisableOnAgcTrig = false
                  AtomChannelOutputControl = DONT_ENABLE_CHANNEL_OUTPUT
                  AtomChannelOutputSignalLevel = LOW
                  AtomChannelPortPinSelect = TOUT17_SELD_PORT0_PIN8
                AtomChannelTimerParameters:
                  AtomChEnableForceUpdate = false
                  AtomChResetCn0OnForceUpdate = false
                  AtomChShadowCompareValSr0 = 0
                  AtomChShadowCompareValSr1 = 0
                  AtomChSomcCompareStrategy = TIMEBASE_GREATER_EQUAL_TO_CMx
                  AtomChSomcTimebaseForComparison = TBU_TS1
                  AtomChUpdateEnableOnCn0Reset = false
                  AtomChannelClockSelect = GTM_CONFIGURABLE_CLOCK_0
                  AtomChannelCompareValueCm0 = 0
                  AtomChannelCompareValueCm1 = 0
                  AtomChannelCounterCn0Reset = ON_COMPARE_MATCH_ON_CHANNEL
                  AtomChannelCounterValCn0 = 0
                  AtomChannelModeSelect = ATOM_SIG_OUTPUT_MODE_IMMEDIATE
                  AtomChannelOneShotMode = false
                  AtomChannelTriggerOutput = TRIG_FROM_PREVIOUS_CHANNEL
                  AtomModeControlBits = 0
                  AtomServeLastAruCommStrategy = false
                AtomChannelUsage: AtomChannelUsage=USED_BY_OTHER_DRIVERS_OR_UNUSED
            AtomTriggerForAgc
              AtomAgcInternalTriggerSelect:
                AtomAgcIntTriggerFromChannel{0..7} = false
              AtomAgcTriggerByTimebase: AtomAgcTbuTimebaseSelect=TBU_TS0_TIMEBASE, AtomAgcTimeBaseTriggerEnable=false, AtomAgcTimebaseMatchValue=0
          Atom_2
            8 x AtomChannel:
              AtomChannel_0
                AtomChannelAruConfiguration:
                  AtomChAruBlockingMode = GTM_ABM_DISABLED
                  AtomChAruReadAddress0 = 510
                  AtomChAruReadAddress1 = 510
                  AtomChannelAruEnable = false
                  AtomChannelCpuWriteRequest = false
                AtomChannelEnable: AtomChDisableOnAgcTrigger=false, AtomChannelEnable=AT_START
                AtomChannelInterrupt:
                  AtomCcu0Notification = NULL_PTR
                  AtomCcu1Notification = NULL_PTR
                  AtomGlobalCcuSel = false
                  AtomIntEnableOnCcu0Trigger = false
                  AtomIntEnableOnCcu1Trigger = false
                  AtomInterruptMode = GTM_INTERRUPT_LEVEL_MODE
                  AtomNotification = NULL_PTR
                AtomChannelOutput:
                  AtomChOutputDisableOnAgcTrig = false
                  AtomChannelOutputControl = DONT_ENABLE_CHANNEL_OUTPUT
                  AtomChannelOutputSignalLevel = LOW
                  AtomChannelPortPinSelect = TOUT18_SELC_PORT0_PIN9
                AtomChannelTimerParameters:
                  AtomChEnableForceUpdate = false
                  AtomChResetCn0OnForceUpdate = false
                  AtomChShadowCompareValSr0 = 0
                  AtomChShadowCompareValSr1 = 0
                  AtomChSomcCompareStrategy = TIMEBASE_GREATER_EQUAL_TO_CMx
                  AtomChSomcTimebaseForComparison = TBU_TS1
                  AtomChUpdateEnableOnCn0Reset = false
                  AtomChannelClockSelect = GTM_CONFIGURABLE_CLOCK_0
                  AtomChannelCompareValueCm0 = 0
                  AtomChannelCompareValueCm1 = 0
                  AtomChannelCounterCn0Reset = ON_COMPARE_MATCH_ON_CHANNEL
                  AtomChannelCounterValCn0 = 0
                  AtomChannelModeSelect = ATOM_SIG_OUTPUT_MODE_IMMEDIATE
                  AtomChannelOneShotMode = false
                  AtomChannelTriggerOutput = TRIG_FROM_PREVIOUS_CHANNEL
                  AtomModeControlBits = 0
                  AtomServeLastAruCommStrategy = false
                AtomChannelUsage: AtomChannelUsage=USED_BY_OTHER_DRIVERS_OR_UNUSED
              AtomChannel_1
                AtomChannelAruConfiguration:
                  AtomChAruBlockingMode = GTM_ABM_DISABLED
                  AtomChAruReadAddress0 = 510
                  AtomChAruReadAddress1 = 510
                  AtomChannelAruEnable = false
                  AtomChannelCpuWriteRequest = false
                AtomChannelEnable: AtomChDisableOnAgcTrigger=false, AtomChannelEnable=AT_START
                AtomChannelInterrupt:
                  AtomCcu0Notification = NULL_PTR
                  AtomCcu1Notification = NULL_PTR
                  AtomGlobalCcuSel = false
                  AtomIntEnableOnCcu0Trigger = false
                  AtomIntEnableOnCcu1Trigger = false
                  AtomInterruptMode = GTM_INTERRUPT_LEVEL_MODE
                  AtomNotification = NULL_PTR
                AtomChannelOutput:
                  AtomChOutputDisableOnAgcTrig = false
                  AtomChannelOutputControl = DONT_ENABLE_CHANNEL_OUTPUT
                  AtomChannelOutputSignalLevel = LOW
                  AtomChannelPortPinSelect = TOUT19_SELC_PORT0_PIN10
                AtomChannelTimerParameters:
                  AtomChEnableForceUpdate = false
                  AtomChResetCn0OnForceUpdate = false
                  AtomChShadowCompareValSr0 = 0
                  AtomChShadowCompareValSr1 = 0
                  AtomChSomcCompareStrategy = TIMEBASE_GREATER_EQUAL_TO_CMx
                  AtomChSomcTimebaseForComparison = TBU_TS1
                  AtomChUpdateEnableOnCn0Reset = false
                  AtomChannelClockSelect = GTM_CONFIGURABLE_CLOCK_0
                  AtomChannelCompareValueCm0 = 0
                  AtomChannelCompareValueCm1 = 0
                  AtomChannelCounterCn0Reset = ON_COMPARE_MATCH_ON_CHANNEL
                  AtomChannelCounterValCn0 = 0
                  AtomChannelModeSelect = ATOM_SIG_OUTPUT_MODE_IMMEDIATE
                  AtomChannelOneShotMode = false
                  AtomChannelTriggerOutput = TRIG_FROM_PREVIOUS_CHANNEL
                  AtomModeControlBits = 0
                  AtomServeLastAruCommStrategy = false
                AtomChannelUsage: AtomChannelUsage=USED_BY_OTHER_DRIVERS_OR_UNUSED
              AtomChannel_2
                AtomChannelAruConfiguration:
                  AtomChAruBlockingMode = GTM_ABM_DISABLED
                  AtomChAruReadAddress0 = 510
                  AtomChAruReadAddress1 = 510
                  AtomChannelAruEnable = false
                  AtomChannelCpuWriteRequest = false
                AtomChannelEnable: AtomChDisableOnAgcTrigger=false, AtomChannelEnable=AT_START
                AtomChannelInterrupt:
                  AtomCcu0Notification = NULL_PTR
                  AtomCcu1Notification = NULL_PTR
                  AtomGlobalCcuSel = false
                  AtomIntEnableOnCcu0Trigger = false
                  AtomIntEnableOnCcu1Trigger = false
                  AtomInterruptMode = GTM_INTERRUPT_LEVEL_MODE
                  AtomNotification = NULL_PTR
                AtomChannelOutput:
                  AtomChOutputDisableOnAgcTrig = false
                  AtomChannelOutputControl = DONT_ENABLE_CHANNEL_OUTPUT
                  AtomChannelOutputSignalLevel = LOW
                  AtomChannelPortPinSelect = TOUT20_SELC_PORT0_PIN11
                AtomChannelTimerParameters:
                  AtomChEnableForceUpdate = false
                  AtomChResetCn0OnForceUpdate = false
                  AtomChShadowCompareValSr0 = 0
                  AtomChShadowCompareValSr1 = 0
                  AtomChSomcCompareStrategy = TIMEBASE_GREATER_EQUAL_TO_CMx
                  AtomChSomcTimebaseForComparison = TBU_TS1
                  AtomChUpdateEnableOnCn0Reset = false
                  AtomChannelClockSelect = GTM_CONFIGURABLE_CLOCK_0
                  AtomChannelCompareValueCm0 = 0
                  AtomChannelCompareValueCm1 = 0
                  AtomChannelCounterCn0Reset = ON_COMPARE_MATCH_ON_CHANNEL
                  AtomChannelCounterValCn0 = 0
                  AtomChannelModeSelect = ATOM_SIG_OUTPUT_MODE_IMMEDIATE
                  AtomChannelOneShotMode = false
                  AtomChannelTriggerOutput = TRIG_FROM_PREVIOUS_CHANNEL
                  AtomModeControlBits = 0
                  AtomServeLastAruCommStrategy = false
                AtomChannelUsage: AtomChannelUsage=USED_BY_OTHER_DRIVERS_OR_UNUSED
              AtomChannel_3
                AtomChannelAruConfiguration:
                  AtomChAruBlockingMode = GTM_ABM_DISABLED
                  AtomChAruReadAddress0 = 510
                  AtomChAruReadAddress1 = 510
                  AtomChannelAruEnable = false
                  AtomChannelCpuWriteRequest = false
                AtomChannelEnable: AtomChDisableOnAgcTrigger=false, AtomChannelEnable=AT_START
                AtomChannelInterrupt:
                  AtomCcu0Notification = NULL_PTR
                  AtomCcu1Notification = NULL_PTR
                  AtomGlobalCcuSel = false
                  AtomIntEnableOnCcu0Trigger = false
                  AtomIntEnableOnCcu1Trigger = false
                  AtomInterruptMode = GTM_INTERRUPT_LEVEL_MODE
                  AtomNotification = NULL_PTR
                AtomChannelOutput:
                  AtomChOutputDisableOnAgcTrig = false
                  AtomChannelOutputControl = DONT_ENABLE_CHANNEL_OUTPUT
                  AtomChannelOutputSignalLevel = LOW
                  AtomChannelPortPinSelect = TOUT21_SELC_PORT0_PIN12
                AtomChannelTimerParameters:
                  AtomChEnableForceUpdate = false
                  AtomChResetCn0OnForceUpdate = false
                  AtomChShadowCompareValSr0 = 0
                  AtomChShadowCompareValSr1 = 0
                  AtomChSomcCompareStrategy = TIMEBASE_GREATER_EQUAL_TO_CMx
                  AtomChSomcTimebaseForComparison = TBU_TS1
                  AtomChUpdateEnableOnCn0Reset = false
                  AtomChannelClockSelect = GTM_CONFIGURABLE_CLOCK_0
                  AtomChannelCompareValueCm0 = 0
                  AtomChannelCompareValueCm1 = 0
                  AtomChannelCounterCn0Reset = ON_COMPARE_MATCH_ON_CHANNEL
                  AtomChannelCounterValCn0 = 0
                  AtomChannelModeSelect = ATOM_SIG_OUTPUT_MODE_IMMEDIATE
                  AtomChannelOneShotMode = false
                  AtomChannelTriggerOutput = TRIG_FROM_PREVIOUS_CHANNEL
                  AtomModeControlBits = 0
                  AtomServeLastAruCommStrategy = false
                AtomChannelUsage: AtomChannelUsage=USED_BY_OTHER_DRIVERS_OR_UNUSED
              AtomChannel_4
                AtomChannelAruConfiguration:
                  AtomChAruBlockingMode = GTM_ABM_DISABLED
                  AtomChAruReadAddress0 = 510
                  AtomChAruReadAddress1 = 510
                  AtomChannelAruEnable = false
                  AtomChannelCpuWriteRequest = false
                AtomChannelEnable: AtomChDisableOnAgcTrigger=false, AtomChannelEnable=AT_START
                AtomChannelInterrupt:
                  AtomCcu0Notification = NULL_PTR
                  AtomCcu1Notification = NULL_PTR
                  AtomGlobalCcuSel = false
                  AtomIntEnableOnCcu0Trigger = false
                  AtomIntEnableOnCcu1Trigger = false
                  AtomInterruptMode = GTM_INTERRUPT_LEVEL_MODE
                  AtomNotification = NULL_PTR
                AtomChannelOutput:
                  AtomChOutputDisableOnAgcTrig = false
                  AtomChannelOutputControl = DONT_ENABLE_CHANNEL_OUTPUT
                  AtomChannelOutputSignalLevel = LOW
                  AtomChannelPortPinSelect = TOUT98_SELC_PORT11_PIN9
                AtomChannelTimerParameters:
                  AtomChEnableForceUpdate = false
                  AtomChResetCn0OnForceUpdate = false
                  AtomChShadowCompareValSr0 = 0
                  AtomChShadowCompareValSr1 = 0
                  AtomChSomcCompareStrategy = TIMEBASE_GREATER_EQUAL_TO_CMx
                  AtomChSomcTimebaseForComparison = TBU_TS1
                  AtomChUpdateEnableOnCn0Reset = false
                  AtomChannelClockSelect = GTM_CONFIGURABLE_CLOCK_0
                  AtomChannelCompareValueCm0 = 0
                  AtomChannelCompareValueCm1 = 0
                  AtomChannelCounterCn0Reset = ON_COMPARE_MATCH_ON_CHANNEL
                  AtomChannelCounterValCn0 = 0
                  AtomChannelModeSelect = ATOM_SIG_OUTPUT_MODE_IMMEDIATE
                  AtomChannelOneShotMode = false
                  AtomChannelTriggerOutput = TRIG_FROM_PREVIOUS_CHANNEL
                  AtomModeControlBits = 0
                  AtomServeLastAruCommStrategy = false
                AtomChannelUsage: AtomChannelUsage=USED_BY_OTHER_DRIVERS_OR_UNUSED
              AtomChannel_5
                AtomChannelAruConfiguration:
                  AtomChAruBlockingMode = GTM_ABM_DISABLED
                  AtomChAruReadAddress0 = 510
                  AtomChAruReadAddress1 = 510
                  AtomChannelAruEnable = false
                  AtomChannelCpuWriteRequest = false
                AtomChannelEnable: AtomChDisableOnAgcTrigger=false, AtomChannelEnable=AT_START
                AtomChannelInterrupt:
                  AtomCcu0Notification = NULL_PTR
                  AtomCcu1Notification = NULL_PTR
                  AtomGlobalCcuSel = false
                  AtomIntEnableOnCcu0Trigger = false
                  AtomIntEnableOnCcu1Trigger = false
                  AtomInterruptMode = GTM_INTERRUPT_LEVEL_MODE
                  AtomNotification = NULL_PTR
                AtomChannelOutput:
                  AtomChOutputDisableOnAgcTrig = false
                  AtomChannelOutputControl = DONT_ENABLE_CHANNEL_OUTPUT
                  AtomChannelOutputSignalLevel = LOW
                  AtomChannelPortPinSelect = TOUT99_SELC_PORT11_PIN10
                AtomChannelTimerParameters:
                  AtomChEnableForceUpdate = false
                  AtomChResetCn0OnForceUpdate = false
                  AtomChShadowCompareValSr0 = 0
                  AtomChShadowCompareValSr1 = 0
                  AtomChSomcCompareStrategy = TIMEBASE_GREATER_EQUAL_TO_CMx
                  AtomChSomcTimebaseForComparison = TBU_TS1
                  AtomChUpdateEnableOnCn0Reset = false
                  AtomChannelClockSelect = GTM_CONFIGURABLE_CLOCK_0
                  AtomChannelCompareValueCm0 = 0
                  AtomChannelCompareValueCm1 = 0
                  AtomChannelCounterCn0Reset = ON_COMPARE_MATCH_ON_CHANNEL
                  AtomChannelCounterValCn0 = 0
                  AtomChannelModeSelect = ATOM_SIG_OUTPUT_MODE_IMMEDIATE
                  AtomChannelOneShotMode = false
                  AtomChannelTriggerOutput = TRIG_FROM_PREVIOUS_CHANNEL
                  AtomModeControlBits = 0
                  AtomServeLastAruCommStrategy = false
                AtomChannelUsage: AtomChannelUsage=USED_BY_OTHER_DRIVERS_OR_UNUSED
              AtomChannel_6
                AtomChannelAruConfiguration:
                  AtomChAruBlockingMode = GTM_ABM_DISABLED
                  AtomChAruReadAddress0 = 510
                  AtomChAruReadAddress1 = 510
                  AtomChannelAruEnable = false
                  AtomChannelCpuWriteRequest = false
                AtomChannelEnable: AtomChDisableOnAgcTrigger=false, AtomChannelEnable=AT_START
                AtomChannelInterrupt:
                  AtomCcu0Notification = NULL_PTR
                  AtomCcu1Notification = NULL_PTR
                  AtomGlobalCcuSel = false
                  AtomIntEnableOnCcu0Trigger = false
                  AtomIntEnableOnCcu1Trigger = false
                  AtomInterruptMode = GTM_INTERRUPT_LEVEL_MODE
                  AtomNotification = NULL_PTR
                AtomChannelOutput:
                  AtomChOutputDisableOnAgcTrig = false
                  AtomChannelOutputControl = DONT_ENABLE_CHANNEL_OUTPUT
                  AtomChannelOutputSignalLevel = LOW
                  AtomChannelPortPinSelect = TOUT100_SELC_PORT11_PIN11
                AtomChannelTimerParameters:
                  AtomChEnableForceUpdate = false
                  AtomChResetCn0OnForceUpdate = false
                  AtomChShadowCompareValSr0 = 0
                  AtomChShadowCompareValSr1 = 0
                  AtomChSomcCompareStrategy = TIMEBASE_GREATER_EQUAL_TO_CMx
                  AtomChSomcTimebaseForComparison = TBU_TS1
                  AtomChUpdateEnableOnCn0Reset = false
                  AtomChannelClockSelect = GTM_CONFIGURABLE_CLOCK_0
                  AtomChannelCompareValueCm0 = 0
                  AtomChannelCompareValueCm1 = 0
                  AtomChannelCounterCn0Reset = ON_COMPARE_MATCH_ON_CHANNEL
                  AtomChannelCounterValCn0 = 0
                  AtomChannelModeSelect = ATOM_SIG_OUTPUT_MODE_IMMEDIATE
                  AtomChannelOneShotMode = false
                  AtomChannelTriggerOutput = TRIG_FROM_PREVIOUS_CHANNEL
                  AtomModeControlBits = 0
                  AtomServeLastAruCommStrategy = false
                AtomChannelUsage: AtomChannelUsage=USED_BY_OTHER_DRIVERS_OR_UNUSED
              AtomChannel_7
                AtomChannelAruConfiguration:
                  AtomChAruBlockingMode = GTM_ABM_DISABLED
                  AtomChAruReadAddress0 = 510
                  AtomChAruReadAddress1 = 510
                  AtomChannelAruEnable = false
                  AtomChannelCpuWriteRequest = false
                AtomChannelEnable: AtomChDisableOnAgcTrigger=false, AtomChannelEnable=AT_START
                AtomChannelInterrupt:
                  AtomCcu0Notification = NULL_PTR
                  AtomCcu1Notification = NULL_PTR
                  AtomGlobalCcuSel = false
                  AtomIntEnableOnCcu0Trigger = false
                  AtomIntEnableOnCcu1Trigger = false
                  AtomInterruptMode = GTM_INTERRUPT_LEVEL_MODE
                  AtomNotification = NULL_PTR
                AtomChannelOutput:
                  AtomChOutputDisableOnAgcTrig = false
                  AtomChannelOutputControl = DONT_ENABLE_CHANNEL_OUTPUT
                  AtomChannelOutputSignalLevel = LOW
                  AtomChannelPortPinSelect = TOUT101_SELC_PORT11_PIN12
                AtomChannelTimerParameters:
                  AtomChEnableForceUpdate = false
                  AtomChResetCn0OnForceUpdate = false
                  AtomChShadowCompareValSr0 = 0
                  AtomChShadowCompareValSr1 = 0
                  AtomChSomcCompareStrategy = TIMEBASE_GREATER_EQUAL_TO_CMx
                  AtomChSomcTimebaseForComparison = TBU_TS1
                  AtomChUpdateEnableOnCn0Reset = false
                  AtomChannelClockSelect = GTM_CONFIGURABLE_CLOCK_0
                  AtomChannelCompareValueCm0 = 0
                  AtomChannelCompareValueCm1 = 0
                  AtomChannelCounterCn0Reset = ON_COMPARE_MATCH_ON_CHANNEL
                  AtomChannelCounterValCn0 = 0
                  AtomChannelModeSelect = ATOM_SIG_OUTPUT_MODE_IMMEDIATE
                  AtomChannelOneShotMode = false
                  AtomChannelTriggerOutput = TRIG_FROM_PREVIOUS_CHANNEL
                  AtomModeControlBits = 0
                  AtomServeLastAruCommStrategy = false
                AtomChannelUsage: AtomChannelUsage=USED_BY_OTHER_DRIVERS_OR_UNUSED
            AtomTriggerForAgc
              AtomAgcInternalTriggerSelect:
                AtomAgcIntTriggerFromChannel{0..7} = false
              AtomAgcTriggerByTimebase: AtomAgcTbuTimebaseSelect=TBU_TS0_TIMEBASE, AtomAgcTimeBaseTriggerEnable=false, AtomAgcTimebaseMatchValue=0
          Atom_3
            8 x AtomChannel:
              AtomChannel_0
                AtomChannelAruConfiguration:
                  AtomChAruBlockingMode = GTM_ABM_DISABLED
                  AtomChAruReadAddress0 = 510
                  AtomChAruReadAddress1 = 510
                  AtomChannelAruEnable = false
                  AtomChannelCpuWriteRequest = false
                AtomChannelEnable: AtomChDisableOnAgcTrigger=false, AtomChannelEnable=AT_START
                AtomChannelInterrupt:
                  AtomCcu0Notification = NULL_PTR
                  AtomCcu1Notification = NULL_PTR
                  AtomGlobalCcuSel = false
                  AtomIntEnableOnCcu0Trigger = false
                  AtomIntEnableOnCcu1Trigger = false
                  AtomInterruptMode = GTM_INTERRUPT_LEVEL_MODE
                  AtomNotification = NULL_PTR
                AtomChannelOutput:
                  AtomChOutputDisableOnAgcTrig = false
                  AtomChannelOutputControl = DONT_ENABLE_CHANNEL_OUTPUT
                  AtomChannelOutputSignalLevel = LOW
                  AtomChannelPortPinSelect = TOUT18_SELD_PORT0_PIN9
                AtomChannelTimerParameters:
                  AtomChEnableForceUpdate = false
                  AtomChResetCn0OnForceUpdate = false
                  AtomChShadowCompareValSr0 = 0
                  AtomChShadowCompareValSr1 = 0
                  AtomChSomcCompareStrategy = TIMEBASE_GREATER_EQUAL_TO_CMx
                  AtomChSomcTimebaseForComparison = TBU_TS1
                  AtomChUpdateEnableOnCn0Reset = false
                  AtomChannelClockSelect = GTM_CONFIGURABLE_CLOCK_0
                  AtomChannelCompareValueCm0 = 0
                  AtomChannelCompareValueCm1 = 0
                  AtomChannelCounterCn0Reset = ON_COMPARE_MATCH_ON_CHANNEL
                  AtomChannelCounterValCn0 = 0
                  AtomChannelModeSelect = ATOM_SIG_OUTPUT_MODE_IMMEDIATE
                  AtomChannelOneShotMode = false
                  AtomChannelTriggerOutput = TRIG_FROM_PREVIOUS_CHANNEL
                  AtomModeControlBits = 0
                  AtomServeLastAruCommStrategy = false
                AtomChannelUsage: AtomChannelUsage=USED_BY_OTHER_DRIVERS_OR_UNUSED
              AtomChannel_1
                AtomChannelAruConfiguration:
                  AtomChAruBlockingMode = GTM_ABM_DISABLED
                  AtomChAruReadAddress0 = 510
                  AtomChAruReadAddress1 = 510
                  AtomChannelAruEnable = false
                  AtomChannelCpuWriteRequest = false
                AtomChannelEnable: AtomChDisableOnAgcTrigger=false, AtomChannelEnable=AT_START
                AtomChannelInterrupt:
                  AtomCcu0Notification = NULL_PTR
                  AtomCcu1Notification = NULL_PTR
                  AtomGlobalCcuSel = false
                  AtomIntEnableOnCcu0Trigger = false
                  AtomIntEnableOnCcu1Trigger = false
                  AtomInterruptMode = GTM_INTERRUPT_LEVEL_MODE
                  AtomNotification = NULL_PTR
                AtomChannelOutput:
                  AtomChOutputDisableOnAgcTrig = false
                  AtomChannelOutputControl = DONT_ENABLE_CHANNEL_OUTPUT
                  AtomChannelOutputSignalLevel = LOW
                  AtomChannelPortPinSelect = TOUT19_SELD_PORT0_PIN10
                AtomChannelTimerParameters:
                  AtomChEnableForceUpdate = false
                  AtomChResetCn0OnForceUpdate = false
                  AtomChShadowCompareValSr0 = 0
                  AtomChShadowCompareValSr1 = 0
                  AtomChSomcCompareStrategy = TIMEBASE_GREATER_EQUAL_TO_CMx
                  AtomChSomcTimebaseForComparison = TBU_TS1
                  AtomChUpdateEnableOnCn0Reset = false
                  AtomChannelClockSelect = GTM_CONFIGURABLE_CLOCK_0
                  AtomChannelCompareValueCm0 = 0
                  AtomChannelCompareValueCm1 = 0
                  AtomChannelCounterCn0Reset = ON_COMPARE_MATCH_ON_CHANNEL
                  AtomChannelCounterValCn0 = 0
                  AtomChannelModeSelect = ATOM_SIG_OUTPUT_MODE_IMMEDIATE
                  AtomChannelOneShotMode = false
                  AtomChannelTriggerOutput = TRIG_FROM_PREVIOUS_CHANNEL
                  AtomModeControlBits = 0
                  AtomServeLastAruCommStrategy = false
                AtomChannelUsage: AtomChannelUsage=USED_BY_OTHER_DRIVERS_OR_UNUSED
              AtomChannel_2
                AtomChannelAruConfiguration:
                  AtomChAruBlockingMode = GTM_ABM_DISABLED
                  AtomChAruReadAddress0 = 510
                  AtomChAruReadAddress1 = 510
                  AtomChannelAruEnable = false
                  AtomChannelCpuWriteRequest = false
                AtomChannelEnable: AtomChDisableOnAgcTrigger=false, AtomChannelEnable=AT_START
                AtomChannelInterrupt:
                  AtomCcu0Notification = NULL_PTR
                  AtomCcu1Notification = NULL_PTR
                  AtomGlobalCcuSel = false
                  AtomIntEnableOnCcu0Trigger = false
                  AtomIntEnableOnCcu1Trigger = false
                  AtomInterruptMode = GTM_INTERRUPT_LEVEL_MODE
                  AtomNotification = NULL_PTR
                AtomChannelOutput:
                  AtomChOutputDisableOnAgcTrig = false
                  AtomChannelOutputControl = DONT_ENABLE_CHANNEL_OUTPUT
                  AtomChannelOutputSignalLevel = LOW
                  AtomChannelPortPinSelect = TOUT20_SELD_PORT0_PIN11
                AtomChannelTimerParameters:
                  AtomChEnableForceUpdate = false
                  AtomChResetCn0OnForceUpdate = false
                  AtomChShadowCompareValSr0 = 0
                  AtomChShadowCompareValSr1 = 0
                  AtomChSomcCompareStrategy = TIMEBASE_GREATER_EQUAL_TO_CMx
                  AtomChSomcTimebaseForComparison = TBU_TS1
                  AtomChUpdateEnableOnCn0Reset = false
                  AtomChannelClockSelect = GTM_CONFIGURABLE_CLOCK_0
                  AtomChannelCompareValueCm0 = 0
                  AtomChannelCompareValueCm1 = 0
                  AtomChannelCounterCn0Reset = ON_COMPARE_MATCH_ON_CHANNEL
                  AtomChannelCounterValCn0 = 0
                  AtomChannelModeSelect = ATOM_SIG_OUTPUT_MODE_IMMEDIATE
                  AtomChannelOneShotMode = false
                  AtomChannelTriggerOutput = TRIG_FROM_PREVIOUS_CHANNEL
                  AtomModeControlBits = 0
                  AtomServeLastAruCommStrategy = false
                AtomChannelUsage: AtomChannelUsage=USED_BY_OTHER_DRIVERS_OR_UNUSED
              AtomChannel_3
                AtomChannelAruConfiguration:
                  AtomChAruBlockingMode = GTM_ABM_DISABLED
                  AtomChAruReadAddress0 = 510
                  AtomChAruReadAddress1 = 510
                  AtomChannelAruEnable = false
                  AtomChannelCpuWriteRequest = false
                AtomChannelEnable: AtomChDisableOnAgcTrigger=false, AtomChannelEnable=AT_START
                AtomChannelInterrupt:
                  AtomCcu0Notification = NULL_PTR
                  AtomCcu1Notification = NULL_PTR
                  AtomGlobalCcuSel = false
                  AtomIntEnableOnCcu0Trigger = false
                  AtomIntEnableOnCcu1Trigger = false
                  AtomInterruptMode = GTM_INTERRUPT_LEVEL_MODE
                  AtomNotification = NULL_PTR
                AtomChannelOutput:
                  AtomChOutputDisableOnAgcTrig = false
                  AtomChannelOutputControl = DONT_ENABLE_CHANNEL_OUTPUT
                  AtomChannelOutputSignalLevel = LOW
                  AtomChannelPortPinSelect = TOUT21_SELD_PORT0_PIN12
                AtomChannelTimerParameters:
                  AtomChEnableForceUpdate = false
                  AtomChResetCn0OnForceUpdate = false
                  AtomChShadowCompareValSr0 = 0
                  AtomChShadowCompareValSr1 = 0
                  AtomChSomcCompareStrategy = TIMEBASE_GREATER_EQUAL_TO_CMx
                  AtomChSomcTimebaseForComparison = TBU_TS1
                  AtomChUpdateEnableOnCn0Reset = false
                  AtomChannelClockSelect = GTM_CONFIGURABLE_CLOCK_0
                  AtomChannelCompareValueCm0 = 0
                  AtomChannelCompareValueCm1 = 0
                  AtomChannelCounterCn0Reset = ON_COMPARE_MATCH_ON_CHANNEL
                  AtomChannelCounterValCn0 = 0
                  AtomChannelModeSelect = ATOM_SIG_OUTPUT_MODE_IMMEDIATE
                  AtomChannelOneShotMode = false
                  AtomChannelTriggerOutput = TRIG_FROM_PREVIOUS_CHANNEL
                  AtomModeControlBits = 0
                  AtomServeLastAruCommStrategy = false
                AtomChannelUsage: AtomChannelUsage=USED_BY_OTHER_DRIVERS_OR_UNUSED
              AtomChannel_4
                AtomChannelAruConfiguration:
                  AtomChAruBlockingMode = GTM_ABM_DISABLED
                  AtomChAruReadAddress0 = 510
                  AtomChAruReadAddress1 = 510
                  AtomChannelAruEnable = false
                  AtomChannelCpuWriteRequest = false
                AtomChannelEnable: AtomChDisableOnAgcTrigger=false, AtomChannelEnable=AT_START
                AtomChannelInterrupt:
                  AtomCcu0Notification = NULL_PTR
                  AtomCcu1Notification = NULL_PTR
                  AtomGlobalCcuSel = false
                  AtomIntEnableOnCcu0Trigger = false
                  AtomIntEnableOnCcu1Trigger = false
                  AtomInterruptMode = GTM_INTERRUPT_LEVEL_MODE
                  AtomNotification = NULL_PTR
                AtomChannelOutput:
                  AtomChOutputDisableOnAgcTrig = false
                  AtomChannelOutputControl = DONT_ENABLE_CHANNEL_OUTPUT
                  AtomChannelOutputSignalLevel = LOW
                  AtomChannelPortPinSelect = TOUT98_SELD_PORT11_PIN9
                AtomChannelTimerParameters:
                  AtomChEnableForceUpdate = false
                  AtomChResetCn0OnForceUpdate = false
                  AtomChShadowCompareValSr0 = 0
                  AtomChShadowCompareValSr1 = 0
                  AtomChSomcCompareStrategy = TIMEBASE_GREATER_EQUAL_TO_CMx
                  AtomChSomcTimebaseForComparison = TBU_TS1
                  AtomChUpdateEnableOnCn0Reset = false
                  AtomChannelClockSelect = GTM_CONFIGURABLE_CLOCK_0
                  AtomChannelCompareValueCm0 = 0
                  AtomChannelCompareValueCm1 = 0
                  AtomChannelCounterCn0Reset = ON_COMPARE_MATCH_ON_CHANNEL
                  AtomChannelCounterValCn0 = 0
                  AtomChannelModeSelect = ATOM_SIG_OUTPUT_MODE_IMMEDIATE
                  AtomChannelOneShotMode = false
                  AtomChannelTriggerOutput = TRIG_FROM_PREVIOUS_CHANNEL
                  AtomModeControlBits = 0
                  AtomServeLastAruCommStrategy = false
                AtomChannelUsage: AtomChannelUsage=USED_BY_OTHER_DRIVERS_OR_UNUSED
              AtomChannel_5
                AtomChannelAruConfiguration:
                  AtomChAruBlockingMode = GTM_ABM_DISABLED
                  AtomChAruReadAddress0 = 510
                  AtomChAruReadAddress1 = 510
                  AtomChannelAruEnable = false
                  AtomChannelCpuWriteRequest = false
                AtomChannelEnable: AtomChDisableOnAgcTrigger=false, AtomChannelEnable=AT_START
                AtomChannelInterrupt:
                  AtomCcu0Notification = NULL_PTR
                  AtomCcu1Notification = NULL_PTR
                  AtomGlobalCcuSel = false
                  AtomIntEnableOnCcu0Trigger = false
                  AtomIntEnableOnCcu1Trigger = false
                  AtomInterruptMode = GTM_INTERRUPT_LEVEL_MODE
                  AtomNotification = NULL_PTR
                AtomChannelOutput:
                  AtomChOutputDisableOnAgcTrig = false
                  AtomChannelOutputControl = DONT_ENABLE_CHANNEL_OUTPUT
                  AtomChannelOutputSignalLevel = LOW
                  AtomChannelPortPinSelect = TOUT99_SELD_PORT11_PIN10
                AtomChannelTimerParameters:
                  AtomChEnableForceUpdate = false
                  AtomChResetCn0OnForceUpdate = false
                  AtomChShadowCompareValSr0 = 0
                  AtomChShadowCompareValSr1 = 0
                  AtomChSomcCompareStrategy = TIMEBASE_GREATER_EQUAL_TO_CMx
                  AtomChSomcTimebaseForComparison = TBU_TS1
                  AtomChUpdateEnableOnCn0Reset = false
                  AtomChannelClockSelect = GTM_CONFIGURABLE_CLOCK_0
                  AtomChannelCompareValueCm0 = 0
                  AtomChannelCompareValueCm1 = 0
                  AtomChannelCounterCn0Reset = ON_COMPARE_MATCH_ON_CHANNEL
                  AtomChannelCounterValCn0 = 0
                  AtomChannelModeSelect = ATOM_SIG_OUTPUT_MODE_IMMEDIATE
                  AtomChannelOneShotMode = false
                  AtomChannelTriggerOutput = TRIG_FROM_PREVIOUS_CHANNEL
                  AtomModeControlBits = 0
                  AtomServeLastAruCommStrategy = false
                AtomChannelUsage: AtomChannelUsage=USED_BY_OTHER_DRIVERS_OR_UNUSED
              AtomChannel_6
                AtomChannelAruConfiguration:
                  AtomChAruBlockingMode = GTM_ABM_DISABLED
                  AtomChAruReadAddress0 = 510
                  AtomChAruReadAddress1 = 510
                  AtomChannelAruEnable = false
                  AtomChannelCpuWriteRequest = false
                AtomChannelEnable: AtomChDisableOnAgcTrigger=false, AtomChannelEnable=AT_START
                AtomChannelInterrupt:
                  AtomCcu0Notification = NULL_PTR
                  AtomCcu1Notification = NULL_PTR
                  AtomGlobalCcuSel = false
                  AtomIntEnableOnCcu0Trigger = false
                  AtomIntEnableOnCcu1Trigger = false
                  AtomInterruptMode = GTM_INTERRUPT_LEVEL_MODE
                  AtomNotification = NULL_PTR
                AtomChannelOutput:
                  AtomChOutputDisableOnAgcTrig = false
                  AtomChannelOutputControl = DONT_ENABLE_CHANNEL_OUTPUT
                  AtomChannelOutputSignalLevel = LOW
                  AtomChannelPortPinSelect = TOUT100_SELD_PORT11_PIN11
                AtomChannelTimerParameters:
                  AtomChEnableForceUpdate = false
                  AtomChResetCn0OnForceUpdate = false
                  AtomChShadowCompareValSr0 = 0
                  AtomChShadowCompareValSr1 = 0
                  AtomChSomcCompareStrategy = TIMEBASE_GREATER_EQUAL_TO_CMx
                  AtomChSomcTimebaseForComparison = TBU_TS1
                  AtomChUpdateEnableOnCn0Reset = false
                  AtomChannelClockSelect = GTM_CONFIGURABLE_CLOCK_0
                  AtomChannelCompareValueCm0 = 0
                  AtomChannelCompareValueCm1 = 0
                  AtomChannelCounterCn0Reset = ON_COMPARE_MATCH_ON_CHANNEL
                  AtomChannelCounterValCn0 = 0
                  AtomChannelModeSelect = ATOM_SIG_OUTPUT_MODE_IMMEDIATE
                  AtomChannelOneShotMode = false
                  AtomChannelTriggerOutput = TRIG_FROM_PREVIOUS_CHANNEL
                  AtomModeControlBits = 0
                  AtomServeLastAruCommStrategy = false
                AtomChannelUsage: AtomChannelUsage=USED_BY_OTHER_DRIVERS_OR_UNUSED
              AtomChannel_7
                AtomChannelAruConfiguration:
                  AtomChAruBlockingMode = GTM_ABM_DISABLED
                  AtomChAruReadAddress0 = 510
                  AtomChAruReadAddress1 = 510
                  AtomChannelAruEnable = false
                  AtomChannelCpuWriteRequest = false
                AtomChannelEnable: AtomChDisableOnAgcTrigger=false, AtomChannelEnable=AT_START
                AtomChannelInterrupt:
                  AtomCcu0Notification = NULL_PTR
                  AtomCcu1Notification = NULL_PTR
                  AtomGlobalCcuSel = false
                  AtomIntEnableOnCcu0Trigger = false
                  AtomIntEnableOnCcu1Trigger = false
                  AtomInterruptMode = GTM_INTERRUPT_LEVEL_MODE
                  AtomNotification = NULL_PTR
                AtomChannelOutput:
                  AtomChOutputDisableOnAgcTrig = false
                  AtomChannelOutputControl = DONT_ENABLE_CHANNEL_OUTPUT
                  AtomChannelOutputSignalLevel = LOW
                  AtomChannelPortPinSelect = TOUT101_SELD_PORT11_PIN12
                AtomChannelTimerParameters:
                  AtomChEnableForceUpdate = false
                  AtomChResetCn0OnForceUpdate = false
                  AtomChShadowCompareValSr0 = 0
                  AtomChShadowCompareValSr1 = 0
                  AtomChSomcCompareStrategy = TIMEBASE_GREATER_EQUAL_TO_CMx
                  AtomChSomcTimebaseForComparison = TBU_TS1
                  AtomChUpdateEnableOnCn0Reset = false
                  AtomChannelClockSelect = GTM_CONFIGURABLE_CLOCK_0
                  AtomChannelCompareValueCm0 = 0
                  AtomChannelCompareValueCm1 = 0
                  AtomChannelCounterCn0Reset = ON_COMPARE_MATCH_ON_CHANNEL
                  AtomChannelCounterValCn0 = 0
                  AtomChannelModeSelect = ATOM_SIG_OUTPUT_MODE_IMMEDIATE
                  AtomChannelOneShotMode = false
                  AtomChannelTriggerOutput = TRIG_FROM_PREVIOUS_CHANNEL
                  AtomModeControlBits = 0
                  AtomServeLastAruCommStrategy = false
                AtomChannelUsage: AtomChannelUsage=USED_BY_OTHER_DRIVERS_OR_UNUSED
            AtomTriggerForAgc
              AtomAgcInternalTriggerSelect:
                AtomAgcIntTriggerFromChannel{0..7} = false
              AtomAgcTriggerByTimebase: AtomAgcTbuTimebaseSelect=TBU_TS0_TIMEBASE, AtomAgcTimeBaseTriggerEnable=false, AtomAgcTimebaseMatchValue=0
          Atom_4
            8 x AtomChannel:
              AtomChannel_0
                AtomChannelAruConfiguration:
                  AtomChAruBlockingMode = GTM_ABM_DISABLED
                  AtomChAruReadAddress0 = 510
                  AtomChAruReadAddress1 = 510
                  AtomChannelAruEnable = false
                  AtomChannelCpuWriteRequest = false
                AtomChannelEnable: AtomChDisableOnAgcTrigger=false, AtomChannelEnable=AT_START
                AtomChannelInterrupt:
                  AtomCcu0Notification = NULL_PTR
                  AtomCcu1Notification = NULL_PTR
                  AtomGlobalCcuSel = false
                  AtomIntEnableOnCcu0Trigger = false
                  AtomIntEnableOnCcu1Trigger = false
                  AtomInterruptMode = GTM_INTERRUPT_LEVEL_MODE
                  AtomNotification = NULL_PTR
                AtomChannelOutput:
                  AtomChOutputDisableOnAgcTrig = false
                  AtomChannelOutputControl = DONT_ENABLE_CHANNEL_OUTPUT
                  AtomChannelOutputSignalLevel = LOW
                  AtomChannelPortPinSelect = TOUT109_SELD_PORT10_PIN7
                AtomChannelTimerParameters:
                  AtomChEnableForceUpdate = false
                  AtomChResetCn0OnForceUpdate = false
                  AtomChShadowCompareValSr0 = 0
                  AtomChShadowCompareValSr1 = 0
                  AtomChSomcCompareStrategy = TIMEBASE_GREATER_EQUAL_TO_CMx
                  AtomChSomcTimebaseForComparison = TBU_TS1
                  AtomChUpdateEnableOnCn0Reset = false
                  AtomChannelClockSelect = GTM_CONFIGURABLE_CLOCK_0
                  AtomChannelCompareValueCm0 = 0
                  AtomChannelCompareValueCm1 = 0
                  AtomChannelCounterCn0Reset = ON_COMPARE_MATCH_ON_CHANNEL
                  AtomChannelCounterValCn0 = 0
                  AtomChannelModeSelect = ATOM_SIG_OUTPUT_MODE_IMMEDIATE
                  AtomChannelOneShotMode = false
                  AtomChannelTriggerOutput = TRIG_FROM_PREVIOUS_CHANNEL
                  AtomModeControlBits = 0
                  AtomServeLastAruCommStrategy = false
                AtomChannelUsage: AtomChannelUsage=USED_BY_OTHER_DRIVERS_OR_UNUSED
              AtomChannel_1
                AtomChannelAruConfiguration:
                  AtomChAruBlockingMode = GTM_ABM_DISABLED
                  AtomChAruReadAddress0 = 510
                  AtomChAruReadAddress1 = 510
                  AtomChannelAruEnable = false
                  AtomChannelCpuWriteRequest = false
                AtomChannelEnable: AtomChDisableOnAgcTrigger=false, AtomChannelEnable=AT_START
                AtomChannelInterrupt:
                  AtomCcu0Notification = NULL_PTR
                  AtomCcu1Notification = NULL_PTR
                  AtomGlobalCcuSel = false
                  AtomIntEnableOnCcu0Trigger = false
                  AtomIntEnableOnCcu1Trigger = false
                  AtomInterruptMode = GTM_INTERRUPT_LEVEL_MODE
                  AtomNotification = NULL_PTR
                AtomChannelOutput:
                  AtomChOutputDisableOnAgcTrig = false
                  AtomChannelOutputControl = DONT_ENABLE_CHANNEL_OUTPUT
                  AtomChannelOutputSignalLevel = LOW
                  AtomChannelPortPinSelect = TOUT103_SELD_PORT10_PIN1
                AtomChannelTimerParameters:
                  AtomChEnableForceUpdate = false
                  AtomChResetCn0OnForceUpdate = false
                  AtomChShadowCompareValSr0 = 0
                  AtomChShadowCompareValSr1 = 0
                  AtomChSomcCompareStrategy = TIMEBASE_GREATER_EQUAL_TO_CMx
                  AtomChSomcTimebaseForComparison = TBU_TS1
                  AtomChUpdateEnableOnCn0Reset = false
                  AtomChannelClockSelect = GTM_CONFIGURABLE_CLOCK_0
                  AtomChannelCompareValueCm0 = 0
                  AtomChannelCompareValueCm1 = 0
                  AtomChannelCounterCn0Reset = ON_COMPARE_MATCH_ON_CHANNEL
                  AtomChannelCounterValCn0 = 0
                  AtomChannelModeSelect = ATOM_SIG_OUTPUT_MODE_IMMEDIATE
                  AtomChannelOneShotMode = false
                  AtomChannelTriggerOutput = TRIG_FROM_PREVIOUS_CHANNEL
                  AtomModeControlBits = 0
                  AtomServeLastAruCommStrategy = false
                AtomChannelUsage: AtomChannelUsage=USED_BY_OTHER_DRIVERS_OR_UNUSED
              AtomChannel_2
                AtomChannelAruConfiguration:
                  AtomChAruBlockingMode = GTM_ABM_DISABLED
                  AtomChAruReadAddress0 = 510
                  AtomChAruReadAddress1 = 510
                  AtomChannelAruEnable = false
                  AtomChannelCpuWriteRequest = false
                AtomChannelEnable: AtomChDisableOnAgcTrigger=false, AtomChannelEnable=AT_START
                AtomChannelInterrupt:
                  AtomCcu0Notification = NULL_PTR
                  AtomCcu1Notification = NULL_PTR
                  AtomGlobalCcuSel = false
                  AtomIntEnableOnCcu0Trigger = false
                  AtomIntEnableOnCcu1Trigger = false
                  AtomInterruptMode = GTM_INTERRUPT_LEVEL_MODE
                  AtomNotification = NULL_PTR
                AtomChannelOutput:
                  AtomChOutputDisableOnAgcTrig = false
                  AtomChannelOutputControl = DONT_ENABLE_CHANNEL_OUTPUT
                  AtomChannelOutputSignalLevel = LOW
                  AtomChannelPortPinSelect = TOUT104_SELD_PORT10_PIN2
                AtomChannelTimerParameters:
                  AtomChEnableForceUpdate = false
                  AtomChResetCn0OnForceUpdate = false
                  AtomChShadowCompareValSr0 = 0
                  AtomChShadowCompareValSr1 = 0
                  AtomChSomcCompareStrategy = TIMEBASE_GREATER_EQUAL_TO_CMx
                  AtomChSomcTimebaseForComparison = TBU_TS1
                  AtomChUpdateEnableOnCn0Reset = false
                  AtomChannelClockSelect = GTM_CONFIGURABLE_CLOCK_0
                  AtomChannelCompareValueCm0 = 0
                  AtomChannelCompareValueCm1 = 0
                  AtomChannelCounterCn0Reset = ON_COMPARE_MATCH_ON_CHANNEL
                  AtomChannelCounterValCn0 = 0
                  AtomChannelModeSelect = ATOM_SIG_OUTPUT_MODE_IMMEDIATE
                  AtomChannelOneShotMode = false
                  AtomChannelTriggerOutput = TRIG_FROM_PREVIOUS_CHANNEL
                  AtomModeControlBits = 0
                  AtomServeLastAruCommStrategy = false
                AtomChannelUsage: AtomChannelUsage=USED_BY_OTHER_DRIVERS_OR_UNUSED
              AtomChannel_3
                AtomChannelAruConfiguration:
                  AtomChAruBlockingMode = GTM_ABM_DISABLED
                  AtomChAruReadAddress0 = 510
                  AtomChAruReadAddress1 = 510
                  AtomChannelAruEnable = false
                  AtomChannelCpuWriteRequest = false
                AtomChannelEnable: AtomChDisableOnAgcTrigger=false, AtomChannelEnable=AT_START
                AtomChannelInterrupt:
                  AtomCcu0Notification = NULL_PTR
                  AtomCcu1Notification = NULL_PTR
                  AtomGlobalCcuSel = false
                  AtomIntEnableOnCcu0Trigger = false
                  AtomIntEnableOnCcu1Trigger = false
                  AtomInterruptMode = GTM_INTERRUPT_LEVEL_MODE
                  AtomNotification = NULL_PTR
                AtomChannelOutput:
                  AtomChOutputDisableOnAgcTrig = false
                  AtomChannelOutputControl = DONT_ENABLE_CHANNEL_OUTPUT
                  AtomChannelOutputSignalLevel = LOW
                  AtomChannelPortPinSelect = TOUT105_SELD_PORT10_PIN3
                AtomChannelTimerParameters:
                  AtomChEnableForceUpdate = false
                  AtomChResetCn0OnForceUpdate = false
                  AtomChShadowCompareValSr0 = 0
                  AtomChShadowCompareValSr1 = 0
                  AtomChSomcCompareStrategy = TIMEBASE_GREATER_EQUAL_TO_CMx
                  AtomChSomcTimebaseForComparison = TBU_TS1
                  AtomChUpdateEnableOnCn0Reset = false
                  AtomChannelClockSelect = GTM_CONFIGURABLE_CLOCK_0
                  AtomChannelCompareValueCm0 = 0
                  AtomChannelCompareValueCm1 = 0
                  AtomChannelCounterCn0Reset = ON_COMPARE_MATCH_ON_CHANNEL
                  AtomChannelCounterValCn0 = 0
                  AtomChannelModeSelect = ATOM_SIG_OUTPUT_MODE_IMMEDIATE
                  AtomChannelOneShotMode = false
                  AtomChannelTriggerOutput = TRIG_FROM_PREVIOUS_CHANNEL
                  AtomModeControlBits = 0
                  AtomServeLastAruCommStrategy = false
                AtomChannelUsage: AtomChannelUsage=USED_BY_OTHER_DRIVERS_OR_UNUSED
              AtomChannel_4
                AtomChannelAruConfiguration:
                  AtomChAruBlockingMode = GTM_ABM_DISABLED
                  AtomChAruReadAddress0 = 510
                  AtomChAruReadAddress1 = 510
                  AtomChannelAruEnable = false
                  AtomChannelCpuWriteRequest = false
                AtomChannelEnable: AtomChDisableOnAgcTrigger=false, AtomChannelEnable=AT_START
                AtomChannelInterrupt:
                  AtomCcu0Notification = NULL_PTR
                  AtomCcu1Notification = NULL_PTR
                  AtomGlobalCcuSel = false
                  AtomIntEnableOnCcu0Trigger = false
                  AtomIntEnableOnCcu1Trigger = false
                  AtomInterruptMode = GTM_INTERRUPT_LEVEL_MODE
                  AtomNotification = NULL_PTR
                AtomChannelOutput:
                  AtomChOutputDisableOnAgcTrig = false
                  AtomChannelOutputControl = DONT_ENABLE_CHANNEL_OUTPUT
                  AtomChannelOutputSignalLevel = LOW
                  AtomChannelPortPinSelect = TOUT102_SELD_PORT10_PIN0
                AtomChannelTimerParameters:
                  AtomChEnableForceUpdate = false
                  AtomChResetCn0OnForceUpdate = false
                  AtomChShadowCompareValSr0 = 0
                  AtomChShadowCompareValSr1 = 0
                  AtomChSomcCompareStrategy = TIMEBASE_GREATER_EQUAL_TO_CMx
                  AtomChSomcTimebaseForComparison = TBU_TS1
                  AtomChUpdateEnableOnCn0Reset = false
                  AtomChannelClockSelect = GTM_CONFIGURABLE_CLOCK_0
                  AtomChannelCompareValueCm0 = 0
                  AtomChannelCompareValueCm1 = 0
                  AtomChannelCounterCn0Reset = ON_COMPARE_MATCH_ON_CHANNEL
                  AtomChannelCounterValCn0 = 0
                  AtomChannelModeSelect = ATOM_SIG_OUTPUT_MODE_IMMEDIATE
                  AtomChannelOneShotMode = false
                  AtomChannelTriggerOutput = TRIG_FROM_PREVIOUS_CHANNEL
                  AtomModeControlBits = 0
                  AtomServeLastAruCommStrategy = false
                AtomChannelUsage: AtomChannelUsage=USED_BY_OTHER_DRIVERS_OR_UNUSED
              AtomChannel_5
                AtomChannelAruConfiguration:
                  AtomChAruBlockingMode = GTM_ABM_DISABLED
                  AtomChAruReadAddress0 = 510
                  AtomChAruReadAddress1 = 510
                  AtomChannelAruEnable = false
                  AtomChannelCpuWriteRequest = false
                AtomChannelEnable: AtomChDisableOnAgcTrigger=false, AtomChannelEnable=AT_START
                AtomChannelInterrupt:
                  AtomCcu0Notification = NULL_PTR
                  AtomCcu1Notification = NULL_PTR
                  AtomGlobalCcuSel = false
                  AtomIntEnableOnCcu0Trigger = false
                  AtomIntEnableOnCcu1Trigger = false
                  AtomInterruptMode = GTM_INTERRUPT_LEVEL_MODE
                  AtomNotification = NULL_PTR
                AtomChannelOutput:
                  AtomChOutputDisableOnAgcTrig = false
                  AtomChannelOutputControl = DONT_ENABLE_CHANNEL_OUTPUT
                  AtomChannelOutputSignalLevel = LOW
                  AtomChannelPortPinSelect = TOUT110_SELD_PORT10_PIN8
                AtomChannelTimerParameters:
                  AtomChEnableForceUpdate = false
                  AtomChResetCn0OnForceUpdate = false
                  AtomChShadowCompareValSr0 = 0
                  AtomChShadowCompareValSr1 = 0
                  AtomChSomcCompareStrategy = TIMEBASE_GREATER_EQUAL_TO_CMx
                  AtomChSomcTimebaseForComparison = TBU_TS1
                  AtomChUpdateEnableOnCn0Reset = false
                  AtomChannelClockSelect = GTM_CONFIGURABLE_CLOCK_0
                  AtomChannelCompareValueCm0 = 0
                  AtomChannelCompareValueCm1 = 0
                  AtomChannelCounterCn0Reset = ON_COMPARE_MATCH_ON_CHANNEL
                  AtomChannelCounterValCn0 = 0
                  AtomChannelModeSelect = ATOM_SIG_OUTPUT_MODE_IMMEDIATE
                  AtomChannelOneShotMode = false
                  AtomChannelTriggerOutput = TRIG_FROM_PREVIOUS_CHANNEL
                  AtomModeControlBits = 0
                  AtomServeLastAruCommStrategy = false
                AtomChannelUsage: AtomChannelUsage=USED_BY_OTHER_DRIVERS_OR_UNUSED
              AtomChannel_6
                AtomChannelAruConfiguration:
                  AtomChAruBlockingMode = GTM_ABM_DISABLED
                  AtomChAruReadAddress0 = 510
                  AtomChAruReadAddress1 = 510
                  AtomChannelAruEnable = false
                  AtomChannelCpuWriteRequest = false
                AtomChannelEnable: AtomChDisableOnAgcTrigger=false, AtomChannelEnable=AT_START
                AtomChannelInterrupt:
                  AtomCcu0Notification = NULL_PTR
                  AtomCcu1Notification = NULL_PTR
                  AtomGlobalCcuSel = false
                  AtomIntEnableOnCcu0Trigger = false
                  AtomIntEnableOnCcu1Trigger = false
                  AtomInterruptMode = GTM_INTERRUPT_LEVEL_MODE
                  AtomNotification = NULL_PTR
                AtomChannelOutput:
                  AtomChOutputDisableOnAgcTrig = false
                  AtomChannelOutputControl = DONT_ENABLE_CHANNEL_OUTPUT
                  AtomChannelOutputSignalLevel = LOW
                  AtomChannelPortPinSelect = TOUT106_SELD_PORT10_PIN4
                AtomChannelTimerParameters:
                  AtomChEnableForceUpdate = false
                  AtomChResetCn0OnForceUpdate = false
                  AtomChShadowCompareValSr0 = 0
                  AtomChShadowCompareValSr1 = 0
                  AtomChSomcCompareStrategy = TIMEBASE_GREATER_EQUAL_TO_CMx
                  AtomChSomcTimebaseForComparison = TBU_TS1
                  AtomChUpdateEnableOnCn0Reset = false
                  AtomChannelClockSelect = GTM_CONFIGURABLE_CLOCK_0
                  AtomChannelCompareValueCm0 = 0
                  AtomChannelCompareValueCm1 = 0
                  AtomChannelCounterCn0Reset = ON_COMPARE_MATCH_ON_CHANNEL
                  AtomChannelCounterValCn0 = 0
                  AtomChannelModeSelect = ATOM_SIG_OUTPUT_MODE_IMMEDIATE
                  AtomChannelOneShotMode = false
                  AtomChannelTriggerOutput = TRIG_FROM_PREVIOUS_CHANNEL
                  AtomModeControlBits = 0
                  AtomServeLastAruCommStrategy = false
                AtomChannelUsage: AtomChannelUsage=USED_BY_OTHER_DRIVERS_OR_UNUSED
              AtomChannel_7
                AtomChannelAruConfiguration:
                  AtomChAruBlockingMode = GTM_ABM_DISABLED
                  AtomChAruReadAddress0 = 510
                  AtomChAruReadAddress1 = 510
                  AtomChannelAruEnable = false
                  AtomChannelCpuWriteRequest = false
                AtomChannelEnable: AtomChDisableOnAgcTrigger=false, AtomChannelEnable=AT_START
                AtomChannelInterrupt:
                  AtomCcu0Notification = NULL_PTR
                  AtomCcu1Notification = NULL_PTR
                  AtomGlobalCcuSel = false
                  AtomIntEnableOnCcu0Trigger = false
                  AtomIntEnableOnCcu1Trigger = false
                  AtomInterruptMode = GTM_INTERRUPT_LEVEL_MODE
                  AtomNotification = NULL_PTR
                AtomChannelOutput:
                  AtomChOutputDisableOnAgcTrig = false
                  AtomChannelOutputControl = DONT_ENABLE_CHANNEL_OUTPUT
                  AtomChannelOutputSignalLevel = LOW
                  AtomChannelPortPinSelect = TOUT75_SELD_PORT15_PIN4
                AtomChannelTimerParameters:
                  AtomChEnableForceUpdate = false
                  AtomChResetCn0OnForceUpdate = false
                  AtomChShadowCompareValSr0 = 0
                  AtomChShadowCompareValSr1 = 0
                  AtomChSomcCompareStrategy = TIMEBASE_GREATER_EQUAL_TO_CMx
                  AtomChSomcTimebaseForComparison = TBU_TS1
                  AtomChUpdateEnableOnCn0Reset = false
                  AtomChannelClockSelect = GTM_CONFIGURABLE_CLOCK_0
                  AtomChannelCompareValueCm0 = 0
                  AtomChannelCompareValueCm1 = 0
                  AtomChannelCounterCn0Reset = ON_COMPARE_MATCH_ON_CHANNEL
                  AtomChannelCounterValCn0 = 0
                  AtomChannelModeSelect = ATOM_SIG_OUTPUT_MODE_IMMEDIATE
                  AtomChannelOneShotMode = false
                  AtomChannelTriggerOutput = TRIG_FROM_PREVIOUS_CHANNEL
                  AtomModeControlBits = 0
                  AtomServeLastAruCommStrategy = false
                AtomChannelUsage: AtomChannelUsage=USED_BY_OTHER_DRIVERS_OR_UNUSED
            AtomTriggerForAgc
              AtomAgcInternalTriggerSelect:
                AtomAgcIntTriggerFromChannel{0..7} = false
              AtomAgcTriggerByTimebase: AtomAgcTbuTimebaseSelect=TBU_TS0_TIMEBASE, AtomAgcTimeBaseTriggerEnable=false, AtomAgcTimebaseMatchValue=0
        GtmAeiInterface:
          GtmAeiIllegalModuleAddErrIntEn = false
          GtmAeiIllegalModuleAddIntEn = false
          GtmAeiInterruptMode = GTM_INTERRUPT_LEVEL_MODE
          GtmAeiTimeOutMode = OBSERVE
          GtmAeiTimeOutValue = 0
          GtmAeiTimeoutExceptionErrIntEn = false
          GtmAeiTimeoutExceptionIntEn = false
          GtmAeiUnsupportedAddressErrIntEn = false
          GtmAeiUnsupportedAddressIntEn = false
          GtmAeiUnsupportedByteEnErrIntEn = false
          GtmAeiUnsupportedByteEnIntEn = false
        GtmGeneral: GtmEnRstAndForceIntFunctionality=false, GtmGlobalClkDivDenominator=1, GtmGlobalClkDivNumerator=1, GtmSleepMode=GTM_SLEEP_ENABLE
        4 x Mcs:
          Mcs_0
            8 x McsChannel, all with McsChMemoryErrorInterruptEnable=false, McsChMemoryErrorInterruptEnableErr=false, McsChStackErrorInterruptEnable=false, McsChStackErrorInterruptEnableErr=false, McsChannelEnable=false, McsChannelInterruptEnable=false, McsChannelInterruptEnableErr=false, McsChannelInterruptMode=GTM_INTERRUPT_LEVEL_MODE:
              McsChannel_{0..7}
            McsGeneral: McsHaltOnStackPointerOverflow=false, McsSchedulingScheme=ACCELERATED_SCHEDULING_SCHEME, McsUsage=UNUSED
          Mcs_1
            8 x McsChannel, all with McsChMemoryErrorInterruptEnable=false, McsChMemoryErrorInterruptEnableErr=false, McsChStackErrorInterruptEnable=false, McsChStackErrorInterruptEnableErr=false, McsChannelEnable=false, McsChannelInterruptEnable=false, McsChannelInterruptEnableErr=false, McsChannelInterruptMode=GTM_INTERRUPT_LEVEL_MODE:
              McsChannel_{0..7}
            McsGeneral: McsHaltOnStackPointerOverflow=false, McsSchedulingScheme=ACCELERATED_SCHEDULING_SCHEME, McsUsage=UNUSED
          Mcs_2
            8 x McsChannel, all with McsChMemoryErrorInterruptEnable=false, McsChMemoryErrorInterruptEnableErr=false, McsChStackErrorInterruptEnable=false, McsChStackErrorInterruptEnableErr=false, McsChannelEnable=false, McsChannelInterruptEnable=false, McsChannelInterruptEnableErr=false, McsChannelInterruptMode=GTM_INTERRUPT_LEVEL_MODE:
              McsChannel_{0..7}
            McsGeneral: McsHaltOnStackPointerOverflow=false, McsSchedulingScheme=ACCELERATED_SCHEDULING_SCHEME, McsUsage=UNUSED
          Mcs_3
            8 x McsChannel, all with McsChMemoryErrorInterruptEnable=false, McsChMemoryErrorInterruptEnableErr=false, McsChStackErrorInterruptEnable=false, McsChStackErrorInterruptEnableErr=false, McsChannelEnable=false, McsChannelInterruptEnable=false, McsChannelInterruptEnableErr=false, McsChannelInterruptMode=GTM_INTERRUPT_LEVEL_MODE:
              McsChannel_{0..7}
            McsGeneral: McsHaltOnStackPointerOverflow=false, McsSchedulingScheme=ACCELERATED_SCHEDULING_SCHEME, McsUsage=UNUSED
        Spe_0 (Spe)
          SpeErrorInterrupt:
            SpeEnableIntOnBouncingInputErr = false
            SpeEnableIntOnNewPatternDetectErr = false
            SpeEnableIntOnRegCompErr = false
            SpeEnableIntOnSpeDirBitChangeErr = false
            SpeEnableIntOnWrongPatternErr = false
          SpeGeneral:
            SpeEnableFastShutOff = false
            SpeEnableInput{0..2} = false
            SpeEnableModule = false
            SpeInputSigRevCntr = 60
            SpeInputSigRevCntrCmpVal = 60
            SpeTimChannelsSelect = SEL0_TIM0_CH0_TO_2
            SpeTriggerInputSelect = SPE_NIPD
            SpeUsage = UNUSED
          8 x SpeInputPattern, all with SpeInputPattern=0, SpeIsPatternValid=false:
            SpeInputPattern_{0..7}
          SpeInterrupt:
            SpeEnableIntOnBouncingInput = false
            SpeEnableIntOnNewPatternDetect = false
            SpeEnableIntOnRegComp = false
            SpeEnableIntOnSpeDirBitChange = false
            SpeEnableIntOnWrongPattern = false
            SpeInterruptMode = GTM_INTERRUPT_LEVEL_MODE
          8 x SpeOutputConfig, all with SpeFastShutoffLevel=LOW_LEVEL, SpeOutputSelect=TOM_CH0_SOUR:
            SpeOutputConfig_{0..7}
        Spe_1 (Spe)
          SpeErrorInterrupt:
            SpeEnableIntOnBouncingInputErr = false
            SpeEnableIntOnNewPatternDetectErr = false
            SpeEnableIntOnRegCompErr = false
            SpeEnableIntOnSpeDirBitChangeErr = false
            SpeEnableIntOnWrongPatternErr = false
          SpeGeneral:
            SpeEnableFastShutOff = false
            SpeEnableInput{0..2} = false
            SpeEnableModule = false
            SpeInputSigRevCntr = 60
            SpeInputSigRevCntrCmpVal = 60
            SpeTimChannelsSelect = SEL0_TIM0_CH3_TO_5
            SpeTriggerInputSelect = SPE_NIPD
            SpeUsage = UNUSED
          8 x SpeInputPattern, all with SpeInputPattern=0, SpeIsPatternValid=false:
            SpeInputPattern_{0..7}
          SpeInterrupt:
            SpeEnableIntOnBouncingInput = false
            SpeEnableIntOnNewPatternDetect = false
            SpeEnableIntOnRegComp = false
            SpeEnableIntOnSpeDirBitChange = false
            SpeEnableIntOnWrongPattern = false
            SpeInterruptMode = GTM_INTERRUPT_LEVEL_MODE
          8 x SpeOutputConfig, all with SpeFastShutoffLevel=LOW_LEVEL, SpeOutputSelect=TOM_CH0_SOUR:
            SpeOutputConfig_{0..7}
