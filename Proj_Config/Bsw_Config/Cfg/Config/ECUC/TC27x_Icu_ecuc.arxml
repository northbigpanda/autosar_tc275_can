AUTOSAR XML (schema 00046)
package /Icu
  module config Icu: implementation-config-variant=VARIANT-POST-BUILD-LOADABLE, module-description=Icu_Impl
    IcuConfigSet_0 (IcuConfigSet): IcuMaxChannel=1
      IcuChannel_0 (IcuChannel):
        IcuChannelId = 0
        IcuDefaultStartEdge = ICU_FALLING_EDGE
        IcuMeasurementMode = ICU_MODE_SIGNAL_EDGE_DETECT
        IcuSignalType = ICU_QM_SIGNAL
        IcuWakeupCapability = false
        IcuAssignedHwUnit = TimChannel_7
        IcuSignalEdgeDetection_0 (IcuSignalEdgeDetection): IcuSignalNotification=CANRX_15_4_ICU_Notification
    IcuGeneral:
      IcuDebugSupport = false
      IcuDevErrorDetect = false
      IcuIndex = 0
      IcuPBFixedAddress = false
      IcuReportWakeupSource = false
      IcuResetSfrAtInit = false
      IcuRunningInUser0Mode = false
      IcuUserModeDeInitApiEnable = false
      IcuUserModeInitApiEnable = false
      IcuUserModeRuntimeApiEnable = false
    IcuOptionalApis:
      IcuDeInitApi = false
      IcuDisableWakeupApi = false
      IcuEdgeCountApi = false
      IcuEdgeDetectApi = true
      IcuEnableWakeupApi = false
      IcuGetDutyCycleValuesApi = false
      IcuGetInputStateApi = false
      IcuGetTimeElapsedApi = false
      IcuGetVersionInfoApi = false
      IcuSetModeApi = false
      IcuSignalMeasurementApi = false
      IcuTimestampApi = false
      IcuWakeupFunctionalityApi = false
    IcuSafety: IcuGetModeApi=true, IcuInitCheckApi=true, IcuSafetyEnable=false
    CommonPublishedInformation:
      ArMajorVersion = 4
      ArMinorVersion = 2
      ArPatchVersion = 0
      ModuleId = 122
      Release = _TRICORE_TC275
      SwMajorVersion = 4
      SwMinorVersion = 0
      SwPatchVersion = 1
      VendorApiInfix = GtmCcu6
      VendorId = 17
