AUTOSAR XML (schema 00046)
package /ActiveEcuC
  module config CanTrcv: implementation-config-variant=VARIANT-PRE-COMPILE, module-description=CanTrcv_Impl
    CanTrcvConfigSet
      CanTrcvChannel:
        CanTrcvHwPnSupport = false
        CanTrcvInitState = CANTRCV_OP_MODE_NORMAL
        CanTrcvChannelId = 0
        CanTrcvChannelUsed = true
        CanTrcvControlsPowerSupply = false
        CanTrcvMaxBaudrate = 1000
        CanTrcvWakeupByBusUsed = true
        CanTrcvHardwareVariantGroup = TJA1043_REFERENCE_GROUP
        CanTrcvWakeupSourceRef = CN_DBCNetWork_9ed72b09
        CanTrcvAccess
          CanTrcvDioAccess
            4 x CanTrcvDioChannelAccess:
              PinEN: CanTrcvHardwareInterfaceName=PinEN, CanTrcvDioSymNameRef=TJA1043_EN
              PinSTB: CanTrcvHardwareInterfaceName=PinSTB, CanTrcvDioSymNameRef=TJA1043_STB
              PinERR: CanTrcvHardwareInterfaceName=PinERR, CanTrcvDioSymNameRef=TJA1043_ERR
              PinRXD: CanTrcvHardwareInterfaceName=PinRXD, CanTrcvDioSymNameRef=TJA1043_RXD
    CanTrcvGeneral:
      CanTrcvDevErrorDetect = true
      CanTrcvGetVersionInfo = false
      CanTrcvWakeUpSupport = CANTRCV_WAKEUP_BY_POLLING
      CanTrcvIndex = 0
      CanTrcvMainFunctionPeriod = 0.005
      CanTrcvSafeBswChecks = false
