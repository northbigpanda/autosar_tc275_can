AUTOSAR XML (schema 00046)
package /ActiveEcuC
  module config CanIf: implementation-config-variant=VARIANT-PRE-COMPILE, module-description=CanIf_Impl
    CanIfCtrlDrvCfg_7d254554 (CanIfCtrlDrvCfg): CanIfCtrlDrvTxCancellation=false, CanIfCtrlDrvInitHohConfigRef=CanIfInitHohCfg, CanIfCtrlDrvNameRef=CanGeneral
      CT_DBCNetWork_78f82e94 (CanIfCtrlCfg):
        CanIfCtrlId = 0
        CanIfCtrlWakeupSupport = false
        CanIfCtrlJ1939DynAddrSupport = DISABLED
        CanIfCtrlCanCtrlRef = CT_DBCNetWork_78f82e94
        CanIfCtrlTrcvCfgRef = CanIfTrcvCfg
      CT_DBCNetWork_Can0_5928070d (CanIfCtrlCfg): CanIfCtrlId=1, CanIfCtrlWakeupSupport=false, CanIfCtrlJ1939DynAddrSupport=DISABLED, CanIfCtrlCanCtrlRef=CT_DBCNetWork_Can0_5928070d
    CanIfDispatchCfg:
      CanIfDispatchUserCtrlBusOffName = CanSM_ControllerBusOff
      CanIfDispatchUserCtrlBusOffUL = CAN_SM
      CanIfDispatchUserCtrlModeIndicationName = CanSM_ControllerModeIndication
      CanIfDispatchUserCtrlModeIndicationUL = CAN_SM
      CanIfDispatchUserTrcvModeIndicationUL = CAN_SM
      CanIfDispatchUserTrcvModeIndicationName = CanSM_TransceiverModeIndication
      CanIfDispatchUserValidateWakeupEventName = EcuM_ValidateWakeupEvent
      CanIfDispatchUserValidateWakeupEventUL = ECUM
    CanIfInitCfg
      CanIfInitHohCfg: CanIfInitRefCfgSet=CanConfigSet
        CN_DBCNetWork_9ed72b09_Tx (CanIfHthCfg): CanIfHthCanCtrlIdRef=CT_DBCNetWork_78f82e94, CanIfHthIdSymRef=CN_DBCNetWork_9ed72b09_Tx
        8 x CanIfHrhCfg, all with CanIfHrhSoftwareFilter=true:
          CN_DBCNetWork_b9b38c08_Rx_Meg_FunDiag_Tp: CanIfHrhCanCtrlIdRef=CT_DBCNetWork_78f82e94, CanIfHrhIdSymRef=CN_DBCNetWork_b9b38c08_Rx_Meg_FunDiag_Tp
          CN_DBCNetWork_b9b38c08_Rx_NM: CanIfHrhCanCtrlIdRef=CT_DBCNetWork_78f82e94, CanIfHrhIdSymRef=CN_DBCNetWork_b9b38c08_Rx_NM
          CN_DBCNetWork_b9b38c08_Rx_SupC_Function_2x: CanIfHrhCanCtrlIdRef=CT_DBCNetWork_78f82e94, CanIfHrhIdSymRef=CN_DBCNetWork_b9b38c08_Rx_SupC_Function_2
          CN_DBCNetWork_b9b38c08_Rx_SupC_Function_1: CanIfHrhCanCtrlIdRef=CT_DBCNetWork_78f82e94, CanIfHrhIdSymRef=CN_DBCNetWork_b9b38c08_Rx_SupC_Function_1
          CN_DBCNetWork_b9b38c08_Rx_SupB_Led_Control: CanIfHrhCanCtrlIdRef=CT_DBCNetWork_78f82e94, CanIfHrhIdSymRef=CN_DBCNetWork_b9b38c08_Rx_SupB_Led_Control
          CN_DBCNetWork_b9b38c08_Rx_SupB_Button_Control: CanIfHrhCanCtrlIdRef=CT_DBCNetWork_78f82e94, CanIfHrhIdSymRef=CN_DBCNetWork_b9b38c08_Rx_SupB_Button_Control
          CN_DBCNetWork_b9b38c08_Rx_Meg_PhyDiag_Tp: CanIfHrhCanCtrlIdRef=CT_DBCNetWork_78f82e94, CanIfHrhIdSymRef=CN_DBCNetWork_b9b38c08_Rx_Meg_PhyDiag_Tp
          CN_DBCNetWork_Can0_3e6cf38a_Rx: CanIfHrhCanCtrlIdRef=CT_DBCNetWork_Can0_5928070d, CanIfHrhIdSymRef=CN_DBCNetWork_Can0_3e6cf38a_Rx
        CN_DBCNetWork_Can0_7c554129_Tx (CanIfHthCfg): CanIfHthCanCtrlIdRef=CT_DBCNetWork_Can0_5928070d, CanIfHthIdSymRef=CN_DBCNetWork_Can0_7c554129_Tx
        CN_DBCNetWork_b9b38c08_Rx_Route_Can1ToCan0_100ms (CanIfHrhCfg): CanIfHrhSoftwareFilter=true, CanIfHrhCanCtrlIdRef=CT_DBCNetWork_78f82e94, CanIfHrhIdSymRef=CN_DBCNetWork_b9b38c08_Rx_Route_Can1ToCan0_100ms
      Meg_FunDiag_Tp_oDBCNetWork_c3b25a60_Rx (CanIfRxPduCfg):
        CanIfRxPduCanId = 2015
        CanIfRxPduCanIdType = STANDARD_CAN
        CanIfRxPduDlc = 8
        CanIfRxPduUserRxIndicationName = CanTp_RxIndication
        CanIfRxPduUserRxIndicationType = PDUID_PDUINFOPTR
        CanIfRxPduUserRxIndicationUL = CAN_TP
        CanIfRxPduId = 1
        CanIfRxPduReadData = false
        CanIfRxPduReadNotifyStatus = false
        CanIfRxPduDlcCheck = true
        CanIfRxPduHrhIdRef = CN_DBCNetWork_b9b38c08_Rx_Meg_FunDiag_Tp
        CanIfRxPduRef = Meg_FunDiag_Tp_oDBCNetWork_1b821788_Rx
      Meg_PhyDiag_Tp_oDBCNetWork_a8746177_Rx (CanIfRxPduCfg):
        CanIfRxPduCanId = 1793
        CanIfRxPduCanIdType = STANDARD_CAN
        CanIfRxPduDlc = 8
        CanIfRxPduUserRxIndicationName = CanTp_RxIndication
        CanIfRxPduUserRxIndicationType = PDUID_PDUINFOPTR
        CanIfRxPduUserRxIndicationUL = CAN_TP
        CanIfRxPduId = 2
        CanIfRxPduReadData = false
        CanIfRxPduReadNotifyStatus = false
        CanIfRxPduDlcCheck = true
        CanIfRxPduHrhIdRef = CN_DBCNetWork_b9b38c08_Rx_Meg_PhyDiag_Tp
        CanIfRxPduRef = Meg_PhyDiag_Tp_oDBCNetWork_ff3be21a_Rx
      Meg_ResDiag_Tp_oDBCNetWork_d97dd71a_Tx (CanIfTxPduCfg):
        CanIfTxPduCanId = 1873
        CanIfTxPduCanIdType = STANDARD_CAN
        CanIfTxPduDlc = 8
        CanIfTxPduUserTxConfirmationName = CanTp_TxConfirmation
        CanIfTxPduUserTxConfirmationUL = CAN_TP
        CanIfTxPduId = 0
        CanIfTxPduReadNotifyStatus = false
        CanIfTxPduType = STATIC
        CanIfTxPduTruncation = true
        CanIfTxPduBufferRef = CHNL_50204034
        CanIfTxPduRef = Meg_ResDiag_Tp_oDBCNetWork_4a610c1c_Tx
      CHNL_50204034 (CanIfBufferCfg):
        CanIfBufferSize = 8
        CanIfTxBufferHandlingType = PRIO_BY_CANID
        CanIfTxBufferMappedTxPdus = 8
        CanIfTxBufferMaxPduLength = 8
        CanIfBufferHthRef = CN_DBCNetWork_9ed72b09_Tx
      XB_SUP_A_bafba356_Rx (CanIfRxPduCfg):
        CanIfRxPduCanIdType = STANDARD_CAN
        CanIfRxPduDlc = 8
        CanIfRxPduUserRxIndicationName = CanNm_RxIndication
        CanIfRxPduUserRxIndicationUL = CAN_NM
        CanIfRxPduId = 0
        CanIfRxPduReadData = false
        CanIfRxPduReadNotifyStatus = false
        CanIfRxPduDlcCheck = true
        CanIfRxPduHrhIdRef = CN_DBCNetWork_b9b38c08_Rx_NM
        CanIfRxPduRef = XB_SUP_A_17ea32c5_Rx
        CHNL_fe692093 (CanIfRxPduCanIdRange): CanIfRxPduCanIdRangeLowerCanId=1536, CanIfRxPduCanIdRangeUpperCanId=1791
      3 x CanIfTxPduCfg, all with CanIfTxPduCanIdType=STANDARD_CAN, CanIfTxPduDlc=8, CanIfTxPduReadNotifyStatus=false, CanIfTxPduType=STATIC, CanIfTxPduTruncation=true, CanIfTxPduBufferRef=CHNL_50204034:
        Meg_NmTx_oDBCNetWork_c0e25960_Tx: CanIfTxPduCanId=1537, CanIfTxPduUserTxConfirmationName=CanNm_TxConfirmation, CanIfTxPduUserTxConfirmationUL=CAN_NM, CanIfTxPduId=1, CanIfTxPduRef=Meg_NmTx_oDBCNetWork_5d9e34f5_Tx
        SupA_Function_1_oDBCNetWork_7707e452_Tx: CanIfTxPduCanId=276, CanIfTxPduDataChecksumPdu=false, CanIfTxPduUserTxConfirmationName=PduR_CanIfTxConfirmation, CanIfTxPduUserTxConfirmationUL=PDUR, CanIfTxPduId=3, CanIfTxPduRef=SupA_Function_1_oDBCNetWork_10b79eb2_Tx
        SupA_Led_State_oDBCNetWork_f5d8795b_Tx: CanIfTxPduCanId=272, CanIfTxPduDataChecksumPdu=false, CanIfTxPduUserTxConfirmationName=PduR_CanIfTxConfirmation, CanIfTxPduUserTxConfirmationUL=PDUR, CanIfTxPduId=7, CanIfTxPduRef=SupA_Led_State_oDBCNetWork_e7f688d3_Tx
      SupC_Function_2_oDBCNetWork_e1b16d9f_Rx (CanIfRxPduCfg):
        CanIfRxPduCanId = 1027
        CanIfRxPduCanIdType = STANDARD_CAN
        CanIfRxPduDataChecksumPdu = false
        CanIfRxPduDlc = 8
        CanIfRxPduUserRxIndicationName = PduR_CanIfRxIndication
        CanIfRxPduUserRxIndicationUL = PDUR
        CanIfRxPduId = 3
        CanIfRxPduReadData = false
        CanIfRxPduReadNotifyStatus = false
        CanIfRxPduDlcCheck = true
        CanIfRxPduHrhIdRef = CN_DBCNetWork_b9b38c08_Rx_SupC_Function_2x
        CanIfRxPduRef = SupC_Function_2_oDBCNetWork_1ff05f63_Rx
      SupA_Angle_oDBCNetWork_8a58a84d_Tx (CanIfTxPduCfg):
        CanIfTxPduCanId = 275
        CanIfTxPduCanIdType = STANDARD_CAN
        CanIfTxPduDataChecksumPdu = false
        CanIfTxPduDlc = 8
        CanIfTxPduUserTxConfirmationName = PduR_CanIfTxConfirmation
        CanIfTxPduUserTxConfirmationUL = PDUR
        CanIfTxPduId = 4
        CanIfTxPduReadNotifyStatus = false
        CanIfTxPduType = STATIC
        CanIfTxPduTruncation = true
        CanIfTxPduBufferRef = CHNL_50204034
        CanIfTxPduRef = SupA_Angle_oDBCNetWork_418b1596_Tx
      SupB_Led_Control_oDBCNetWork_aacf6ceb_Rx (CanIfRxPduCfg):
        CanIfRxPduCanId = 1024
        CanIfRxPduCanIdType = STANDARD_CAN
        CanIfRxPduDataChecksumPdu = false
        CanIfRxPduDlc = 8
        CanIfRxPduUserRxIndicationName = PduR_CanIfRxIndication
        CanIfRxPduUserRxIndicationUL = PDUR
        CanIfRxPduId = 6
        CanIfRxPduReadData = false
        CanIfRxPduReadNotifyStatus = false
        CanIfRxPduDlcCheck = true
        CanIfRxPduHrhIdRef = CN_DBCNetWork_b9b38c08_Rx_SupB_Led_Control
        CanIfRxPduRef = SupB_Led_Control_oDBCNetWork_496a3ac6_Rx
      SupB_Button_Control_oDBCNetWork_b59ad01b_Rx (CanIfRxPduCfg):
        CanIfRxPduCanId = 1025
        CanIfRxPduCanIdType = STANDARD_CAN
        CanIfRxPduDataChecksumPdu = false
        CanIfRxPduDlc = 8
        CanIfRxPduUserRxIndicationName = PduR_CanIfRxIndication
        CanIfRxPduUserRxIndicationUL = PDUR
        CanIfRxPduId = 5
        CanIfRxPduReadData = false
        CanIfRxPduReadNotifyStatus = false
        CanIfRxPduDlcCheck = true
        CanIfRxPduHrhIdRef = CN_DBCNetWork_b9b38c08_Rx_SupB_Button_Control
        CanIfRxPduRef = SupB_Button_Control_oDBCNetWork_a24295f7_Rx
      SupA_Button_State_oDBCNetWork_cea719eb_Tx (CanIfTxPduCfg):
        CanIfTxPduCanId = 273
        CanIfTxPduCanIdType = STANDARD_CAN
        CanIfTxPduDataChecksumPdu = false
        CanIfTxPduDlc = 8
        CanIfTxPduUserTxConfirmationName = PduR_CanIfTxConfirmation
        CanIfTxPduUserTxConfirmationUL = PDUR
        CanIfTxPduId = 6
        CanIfTxPduReadNotifyStatus = false
        CanIfTxPduType = STATIC
        CanIfTxPduTruncation = true
        CanIfTxPduBufferRef = CHNL_50204034
        CanIfTxPduRef = SupA_Button_State_oDBCNetWork_eea6565b_Tx
      SupC_Function_1_oDBCNetWork_51474a89_Rx (CanIfRxPduCfg):
        CanIfRxPduCanId = 1026
        CanIfRxPduCanIdType = STANDARD_CAN
        CanIfRxPduDataChecksumPdu = false
        CanIfRxPduDlc = 8
        CanIfRxPduUserRxIndicationName = PduR_CanIfRxIndication
        CanIfRxPduUserRxIndicationUL = PDUR
        CanIfRxPduId = 4
        CanIfRxPduReadData = false
        CanIfRxPduReadNotifyStatus = false
        CanIfRxPduDlcCheck = true
        CanIfRxPduHrhIdRef = CN_DBCNetWork_b9b38c08_Rx_SupC_Function_1
        CanIfRxPduRef = SupC_Function_1_oDBCNetWork_44e7ee76_Rx
      SupA_PowerMode_oDBCNetWork_d8135f5e_Tx (CanIfTxPduCfg):
        CanIfTxPduCanId = 274
        CanIfTxPduCanIdType = STANDARD_CAN
        CanIfTxPduDataChecksumPdu = false
        CanIfTxPduDlc = 8
        CanIfTxPduUserTxConfirmationName = PduR_CanIfTxConfirmation
        CanIfTxPduUserTxConfirmationUL = PDUR
        CanIfTxPduId = 5
        CanIfTxPduReadNotifyStatus = false
        CanIfTxPduType = STATIC
        CanIfTxPduTruncation = true
        CanIfTxPduBufferRef = CHNL_50204034
        CanIfTxPduRef = SupA_PowerMode_oDBCNetWork_910ccf57_Tx
      Ecu_Send_Msg_oDBCNetWork_Can0_0cc6104d_Tx (CanIfTxPduCfg):
        CanIfTxPduCanId = 256
        CanIfTxPduCanIdType = STANDARD_CAN
        CanIfTxPduDlc = 8
        CanIfTxPduId = 9
        CanIfTxPduReadNotifyStatus = false
        CanIfTxPduType = STATIC
        CanIfTxPduUserTxConfirmationUL = CDD
        CanIfTxPduTruncation = true
        CanIfTxPduUserTxConfirmationName = Xwxz_Cdd_Can_TxConfirmation
        CanIfTxPduBufferRef = CHNL_8d655e5f
        CanIfTxPduRef = Ecu_Send_Msg_oDBCNetWork_Can0_da1e44e3_Tx
      CHNL_8d655e5f (CanIfBufferCfg):
        CanIfBufferSize = 0
        CanIfTxBufferHandlingType = NONE
        CanIfTxBufferMappedTxPdus = 2
        CanIfTxBufferMaxPduLength = 8
        CanIfBufferHthRef = CN_DBCNetWork_Can0_7c554129_Tx
      3 x CanIfRxPduCfg, all with CanIfRxPduCanIdType=STANDARD_CAN, CanIfRxPduDlc=8, CanIfRxPduReadData=false, CanIfRxPduReadNotifyStatus=false, CanIfRxPduDlcCheck=true:
        Ecu_Receive_Msg_oDBCNetWork_Can0_47317097_Rx: CanIfRxPduCanId=512, CanIfRxPduId=9, CanIfRxPduUserRxIndicationName=Xwxz_Cdd_Can_RxConfirmation, CanIfRxPduUserRxIndicationUL=CDD, CanIfRxPduHrhIdRef=CN_DBCNetWork_Can0_3e6cf38a_Rx, CanIfRxPduRef=Ecu_Receive_Msg_oDBCNetWork_Can0_364979cb_Rx
        Route_Can1ToCan0_100ms_oDBCNetWork_11bc43a8_Rx: CanIfRxPduCanId=941, CanIfRxPduId=7, CanIfRxPduUserRxIndicationName=PduR_CanIfRxIndication, CanIfRxPduUserRxIndicationUL=PDUR, CanIfRxPduHrhIdRef=CN_DBCNetWork_b9b38c08_Rx_Route_Can1ToCan0_100ms, CanIfRxPduRef=Route_Can1ToCan0_100ms_oDBCNetWork_44a2d8cc_Rx
        Rout_Can0ToCan1_100ms_oDBCNetWork_Can0_bbeab158_Rx: CanIfRxPduCanId=1385, CanIfRxPduId=8, CanIfRxPduUserRxIndicationName=PduR_CanIfRxIndication, CanIfRxPduUserRxIndicationUL=PDUR, CanIfRxPduHrhIdRef=CN_DBCNetWork_Can0_3e6cf38a_Rx, CanIfRxPduRef=Rout_Can0ToCan1_100ms_oDBCNetWork_Can0_6e10546a_Rx
      Route_Can0ToCan1_100ms_oDBCNetWork_bd7918cc_Tx (CanIfTxPduCfg):
        CanIfTxPduCanId = 1385
        CanIfTxPduCanIdType = STANDARD_CAN
        CanIfTxPduDlc = 8
        CanIfTxPduId = 2
        CanIfTxPduReadNotifyStatus = false
        CanIfTxPduType = STATIC
        CanIfTxPduUserTxConfirmationUL = NONE
        CanIfTxPduTruncation = true
        CanIfTxPduUserTxConfirmationName = NULL_PTR
        CanIfTxPduBufferRef = CHNL_50204034
        CanIfTxPduRef = Route_Can0ToCan1_100ms_oDBCNetWork_a9bdfb29_Tx
      Rout_Can1ToCan0_100ms_oDBCNetWork_Can0_8073c8b9_Tx (CanIfTxPduCfg):
        CanIfTxPduCanId = 941
        CanIfTxPduCanIdType = STANDARD_CAN
        CanIfTxPduDlc = 8
        CanIfTxPduId = 8
        CanIfTxPduReadNotifyStatus = false
        CanIfTxPduType = STATIC
        CanIfTxPduUserTxConfirmationUL = NONE
        CanIfTxPduTruncation = true
        CanIfTxPduUserTxConfirmationName = NULL_PTR
        CanIfTxPduBufferRef = CHNL_8d655e5f
        CanIfTxPduRef = Rout_Can1ToCan0_100ms_oDBCNetWork_Can0_c34bc869_Tx
    CanIfPrivateCfg:
      CanIfPrivateSoftwareFilterType = LINEAR
      CanIfPrivateDlcCheck = true
      CanIfSupportTTCAN = false
      CanIfTransceiverMapping = false
      CanIfTransceiverHandling = true
      CanIfSupportExtendedIds = false
      CanIfSupportNmOsek = false
      CanIfTxBufferType = BYTE_QUEUE
      CanIfOptimizeOneController = false
      CanIfWakeupSupport = true
      CanIfStaticFdTxBufferSupport = false
      CanIfRxSearchConsiderMsgType = false
      CanIfTxBufferFifoSupport = false
      CanIfSetPduReceptionModeSupport = false
      CanIfCheckWakeupCanRetType = false
      CanIfDataChecksumRxSupport = false
      CanIfDataChecksumTxSupport = false
      CanIfWakeupValidateAllRxMsgs = false
    CanIfPublicCfg:
      CanIfPublicPnSupport = false
      CanIfPublicCancelTransmitSupport = false
      CanIfPublicDevErrorDetect = true
      CanIfPublicHandleTypeEnum = UINT8
      CanIfPublicMultipleDrvSupport = false
      CanIfPublicNumberOfCanHwUnits = 1
      CanIfPublicReadRxPduDataApi = false
      CanIfPublicReadRxPduNotifyStatusApi = false
      CanIfPublicReadTxPduNotifyStatusApi = false
      CanIfPublicSetDynamicTxIdApi = false
      CanIfPublicTxBuffering = true
      CanIfPublicTxConfirmPollingSupport = false
      CanIfPublicVersionInfoApi = false
      CanIfPublicWakeupCheckValidSupport = true
      CanIfPnWakeupTxPduFilterSupport = false
      CanIfPnTrcvHandlingSupport = false
      CanIfJ1939DynAddrSupport = DISABLED
      CanIfSafeBswChecks = false
      CanIfBusMirroringSupport = false
      CanIfSetBaudrateApi = false
      CanIfPublicWakeupCheckValidByNM = true
      CanIfPublicCddHeaderFile = Cdd_Cbk.h
    CanIfTrcvDrvCfg
      CanIfTrcvCfg: CanIfTrcvId=0, CanIfTrcvWakeupSupport=true, CanIfTrcvCanTrcvRef=CanTrcvChannel
