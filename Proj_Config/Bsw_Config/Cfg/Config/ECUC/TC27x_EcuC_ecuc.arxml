AUTOSAR XML (schema 00046)
package /ActiveEcuC
  module config EcuC: implementation-config-variant=VARIANT-PRE-COMPILE, module-description=EcuC_Impl
    EcucPduCollection: PduIdTypeEnum=UINT8, PduLengthTypeEnum=UINT16
      35 x Pdu, all with J1939Requestable=false:
        Meg_ResDiag_oDBCNetWork_5467f8e5_Tx: PduLength=8
        Meg_FunDiag_oDBCNetWork_245e23dc_Rx: PduLength=7
        Meg_PhyDiag_oDBCNetWork_e94a8f4d_Rx: PduLength=8
        Meg_ResDiag_oDBCNetWork_1336e721_Tx: PduLength=8
        Meg_FunDiag_oDBCNetWork_8501a87a_Rx: PduLength=7
        Meg_PhyDiag_Tp_oDBCNetWork_ff3be21a_Rx: PduLength=8, SysTPduToFrameMappingRef=Meg_PhyDiag_Tp
        Meg_FunDiag_Tp_oDBCNetWork_1b821788_Rx: PduLength=8, SysTPduToFrameMappingRef=Meg_FunDiag_Tp
        Meg_NmTx_oDBCNetWork_5d9e34f5_Tx: PduLength=8, SysTPduToFrameMappingRef=Meg_NmTx
        Meg_ResDiag_Tp_oDBCNetWork_4a610c1c_Tx: PduLength=8, SysTPduToFrameMappingRef=Meg_ResDiag_Tp
        Meg_PhyDiag_oDBCNetWork_e154eea6_Rx: PduLength=8
        XB_SUP_A_17ea32c5_Rx: PduLength=8, SysTPduToFrameMappingRef=Meg_NmRx
        SupC_Function_2_oDBCNetWork_55d6a67c_Rx: PduLength=8
        SupB_Led_Control_oDBCNetWork_eb16948d_Rx: PduLength=8
        SupC_Function_1_oDBCNetWork_44e7ee76_Rx: PduLength=8, SysTPduToFrameMappingRef=SupC_Function_1
        SupA_Angle_oDBCNetWork_e5909e4f_Tx: PduLength=8
        SupA_Led_State_oDBCNetWork_43576f7c_Tx: PduLength=8
        SupA_Led_State_oDBCNetWork_e7f688d3_Tx: PduLength=8, SysTPduToFrameMappingRef=SupA_Led_State
        SupA_PowerMode_oDBCNetWork_910ccf57_Tx: PduLength=8, SysTPduToFrameMappingRef=SupA_PowerMode
        SupB_Button_Control_oDBCNetWork_0c40490d_Rx: PduLength=8
        SupA_Button_State_oDBCNetWork_eea6565b_Tx: PduLength=8, SysTPduToFrameMappingRef=SupA_Button_State
        SupA_Angle_oDBCNetWork_418b1596_Tx: PduLength=8, SysTPduToFrameMappingRef=SupA_Angle
        SupA_Function_1_oDBCNetWork_312706bd_Tx: PduLength=8
        SupA_Button_State_oDBCNetWork_390399bb_Tx: PduLength=8
        SupC_Function_1_oDBCNetWork_e81ccab2_Rx: PduLength=8
        SupC_Function_2_oDBCNetWork_1ff05f63_Rx: PduLength=8, SysTPduToFrameMappingRef=SupC_Function_2
        SupA_Function_1_oDBCNetWork_10b79eb2_Tx: PduLength=8, SysTPduToFrameMappingRef=SupA_Function_1
        SupB_Button_Control_oDBCNetWork_a24295f7_Rx: PduLength=8, SysTPduToFrameMappingRef=SupB_Button_Control
        SupA_PowerMode_oDBCNetWork_b77edafa_Tx: PduLength=8
        SupB_Led_Control_oDBCNetWork_496a3ac6_Rx: PduLength=8, SysTPduToFrameMappingRef=SupB_Led_Control
        Ecu_Receive_Msg_oDBCNetWork_Can0_364979cb_Rx: PduLength=8, SysTPduToFrameMappingRef=Ecu_Receive_Msg
        Ecu_Send_Msg_oDBCNetWork_Can0_da1e44e3_Tx: PduLength=8, SysTPduToFrameMappingRef=Ecu_Send_Msg
        Route_Can0ToCan1_100ms_oDBCNetWork_a9bdfb29_Tx: PduLength=8, SysTPduToFrameMappingRef=Route_Can0ToCan1_100ms
        Rout_Can0ToCan1_100ms_oDBCNetWork_Can0_6e10546a_Rx: PduLength=8, SysTPduToFrameMappingRef=Rout_Can0ToCan1_100ms
        Rout_Can1ToCan0_100ms_oDBCNetWork_Can0_c34bc869_Tx: PduLength=8, SysTPduToFrameMappingRef=Rout_Can1ToCan0_100ms
        Route_Can1ToCan0_100ms_oDBCNetWork_44a2d8cc_Rx: PduLength=8, SysTPduToFrameMappingRef=Route_Can1ToCan0_100ms
    EcucGeneral:
      CPUType = CPU32Bit
      SizeOfInt = Size32Bit
      ByteOrder = LITTLE_ENDIAN
      BitOrder = LSB_to_MSB
      AtomicBitAccessInBitfield = false
      AtomicVariableAccess = Atomic32BitAccess
      SizeOfEnum = Size32Bit
      SizeOfROMPointer = Size32Bit
      SizeOfRAMPointer = Size32Bit
      BitFieldDataType = INT
      StructAlignment = Auto
      ArrayAlignment = Align8Bit
      StructInArrayAlignment = Auto
      DummyFunction = false
      EcuCSafeBswChecks = false
      DummyStatement = true
      DummyStatementKind = None
      ConditionalGenerating = true
      EcucBswImplementationCodeType = EcuCSourceCode
      EcuCUseStdReturnTypeForRte = false
      PostbuildLoadable: AlignmentFillPattern=255, PBROMStartAddress=0, PBRAMStartAddress=0, PBROMEndAddress=0, PBRAMEndAddress=0
      BswInitialization
        41 x InitFunction:
          BswM_InitMemory: Header=BswM.h, InitPhase=INIT_MEMORY, ModuleRef=BswM
          BswM_PreInit: Header=BswM.h, InitPhase=INIT_ONE, ConfigType=BswM_ConfigType, ConfigPtrName=BswM_Config_Ptr, ConfigPtrClass=BSWM_INIT_DATA, ModuleRef=BswM
          BswM_Init: Header=BswM.h, InitPhase=NO_INIT, ConfigType=BswM_ConfigType, ConfigPtrName=BswM_Config_Ptr, ConfigPtrClass=BSWM_INIT_DATA, ModuleRef=BswM
          CanIf_InitMemory: Header=CanIf.h, InitPhase=INIT_MEMORY, ModuleRef=CanIf
          CanIf_Init: Header=CanIf.h, InitPhase=INIT_TWO_IF, ConfigType=CanIf_ConfigType, ConfigPtrName=CanIf_Config_Ptr, ConfigPtrClass=CANIF_INIT_DATA, ModuleRef=CanIf
          CanNm_InitMemory: Header=CanNm.h, InitPhase=INIT_MEMORY, ModuleRef=CanNm
          CanNm_Init: Header=CanNm.h, InitPhase=INIT_TWO_NM, ConfigType=CanNm_ConfigType, ConfigPtrName=CanNm_Config_Ptr, ConfigPtrClass=CANNM_INIT_DATA, ModuleRef=CanNm
          CanSM_Init: Header=CanSM_EcuM.h, InitPhase=INIT_TWO_SM, ConfigType=CanSM_ConfigType, ConfigPtrName=CanSM_Config_Ptr, ConfigPtrClass=CANSM_INIT_DATA, ModuleRef=CanSM
          CanSM_InitMemory: Header=CanSM_EcuM.h, InitPhase=INIT_MEMORY, ModuleRef=CanSM
          Can_InitMemory: Header=Can.h, InitPhase=INIT_MEMORY, ModuleRef=Can
          Can_Init: Header=Can.h, InitPhase=INIT_TWO_DRV, ConfigType=Can_ConfigType, ConfigPtrName=Can_Config_Ptr, ConfigPtrClass=CAN_INIT_DATA, ModuleRef=Can
          ComM_Init: Header=ComM.h, InitPhase=INIT_TWO_POST_NVMREADALL, ModuleRef=ComM
          ComM_InitMemory: Header=ComM.h, InitPhase=INIT_MEMORY, ModuleRef=ComM
          Com_Init: Header=Com.h, InitPhase=INIT_TWO_COM, ConfigType=Com_ConfigType, ConfigPtrName=Com_Config_Ptr, ConfigPtrClass=COM_INIT_DATA, ModuleRef=Com
          Com_InitMemory: Header=Com.h, InitPhase=INIT_MEMORY, ModuleRef=Com
          Det_Init: Header=Det.h, InitPhase=INIT_ZERO, ConfigType=Det_ConfigType, ConfigPtrName=Det_Config_Ptr, ConfigPtrClass=DET_INIT_DATA, ModuleRef=Det
          Det_InitMemory: Header=Det.h, InitPhase=INIT_MEMORY, ModuleRef=Det
          EcuM_Init: Header=EcuM.h, InitPhase=NO_INIT, ConfigType=EcuM_PbConfigType, ConfigPtrName=EcuM_Config_Ptr, ConfigPtrClass=ECUM_INIT_DATA, ModuleRef=EcuM
          Nm_Init: Header=Nm.h, InitPhase=INIT_TWO_NM, ModuleRef=Nm
          Nm_InitMemory: Header=Nm.h, InitPhase=INIT_MEMORY, ModuleRef=Nm
          PduR_Init: Header=PduR.h, InitPhase=INIT_TWO_COM, ConfigType=PduR_PBConfigType, ConfigPtrName=PduR_Config_Ptr, ConfigPtrClass=PDUR_INIT_DATA, ModuleRef=PduR
          PduR_InitMemory: Header=PduR.h, InitPhase=INIT_MEMORY, ModuleRef=PduR
          Rte_InitMemory: Header=Rte_Main.h, InitPhase=INIT_MEMORY, ModuleRef=Rte
          Rte_Start: Header=Rte_Main.h, InitPhase=INIT_THREE, ModuleRef=Rte
          Rte_StartTiming: Header=Rte_Main.h, InitPhase=NO_INIT, ModuleRef=Rte
          SchM_Init: Header=Rte_Main.h, InitPhase=NO_INIT, ModuleRef=Rte
          Brs_Init: Header=, InitPhase=NO_INIT, ModuleRef=vBRS
          CanTp_Init: Header=CanTp.h, InitPhase=INIT_TWO_TP, ConfigType=CanTp_ConfigType, ConfigPtrName=CanTp_Config_Ptr, ConfigPtrClass=CANTP_INIT_DATA, ModuleRef=CanTp
          CanTp_InitMemory: Header=CanTp.h, InitPhase=INIT_MEMORY, ModuleRef=CanTp
          Dcm_Init: Header=Dcm.h, InitPhase=INIT_TWO_POST_NVMREADALL, ConfigType=Dcm_ConfigType, ConfigPtrName=NULL_PTR, ConfigPtrClass=DCM_CONST, ModuleRef=Dcm
          Dcm_InitMemory: Header=Dcm.h, InitPhase=INIT_MEMORY, ModuleRef=Dcm
          Dem_Init: Header=Dem.h, InitPhase=INIT_TWO_POST_NVMREADALL, ConfigType=Dem_ConfigType, ConfigPtrName=Dem_Config_Ptr, ConfigPtrClass=DEM_INIT_DATA, ModuleRef=Dem
          Dem_InitMemory: Header=Dem.h, InitPhase=INIT_MEMORY, ModuleRef=Dem
          Dem_PreInit: Header=Dem.h, InitPhase=INIT_ZERO, ConfigType=Dem_ConfigType, ConfigPtrName=Dem_Config_Ptr, ConfigPtrClass=DEM_INIT_DATA, ModuleRef=Dem
          CanTrcv_30_Tja1043_InitMemory: Header=CanTrcv_30_Tja1043.h, InitPhase=INIT_MEMORY, ModuleRef=CanTrcv
          CanTrcv_30_Tja1043_Init: Header=CanTrcv_30_Tja1043.h, InitPhase=INIT_TWO_TRCV, ConfigType=CanTrcv_30_Tja1043_ConfigType, ConfigPtrName=CanTrcv_30_Tja1043_Config_Ptr, ConfigPtrClass=CANTRCV_30_TJA1043_INIT_DATA, ModuleRef=CanTrcv
          Icu_17_GtmCcu6_Init: Header=Icu_17_GtmCcu6.h, InitPhase=INIT_ONE_LATE, ConfigType=Icu_17_GtmCcu6_ConfigType, ConfigPtrName=Icu_ConfigRoot, ConfigPtrClass=const, ModuleRef=Icu
          Mcu_Init: Header=Mcu.h, InitPhase=INIT_ONE_EARLY, ConfigType=Mcu_ConfigType, ConfigPtrName=Mcu_ConfigRoot, ConfigPtrClass=const, AdditionalInitCode=Mcu_InitClock(0); while (MCU_PLL_LOCKED != Mcu_GetPllStatus()); Mcu_DistributePllClock();, ModuleRef=Mcu
          IoHwAb_Init: Header=IoHwAb.h, InitPhase=INIT_TWO_POST_NVMREADALL, ModuleRef=IoHwAb
          Dio_Init: Header=Dio.h, InitPhase=INIT_ONE, ConfigType=Dio_ConfigType, ConfigPtrName=Dio_ConfigRoot, ConfigPtrClass=const, ModuleRef=Dio
          Port_Init: Header=Port.h, InitPhase=INIT_ONE_EARLY, ConfigType=Port_ConfigType, ConfigPtrName=Port_ConfigRoot, ConfigPtrClass=const, ModuleRef=Port
    EcucHardware
      3 x EcucCoreDefinition:
        EcucCoreDefinition_Core{0..2}: EcucCoreId={0..2}
    EcucPartitionCollection
      3 x EcucPartition, all with EcucPartitionBswModuleExecution=false, PartitionCanBeRestarted=false:
        EcucPartition_ASILB_C1: ASIL=QM
        EcucPartition_ASILB_C0: ASIL=B
        EcucPartition_ASILB_C2: ASIL=B
