AUTOSAR XML (schema 00046)
package /InitialEcuC
  ecuc value collection InitialEcuC: ecuc-values=[Can, CanIf, CanNm, CanSM, CanTp, Com, ComM, Dcm, Dem, EcuC, EcuM, Nm, PduR]
  module config Can
    CanConfigSet
      CT_DBCNetWork_78f82e94 (CanController):
        CanControllerActivation = true
        CanControllerDefaultBaudrate = CT_DBCNetWork_78f82e94/CanControllerBaudrateConfig
        CanControllerSystemRef = CT_DBCNetWork
        CanWakeupSourceRef = EcuMCommonConfiguration/CN_DBCNetWork_9ed72b09
        CanControllerBaudrateConfig: CanControllerBaudRate=500
      CT_DBCNetWork_Can0_5928070d (CanController):
        CanControllerActivation = true
        CanControllerDefaultBaudrate = CT_DBCNetWork_Can0_5928070d/CanControllerBaudrateConfig
        CanControllerSystemRef = CT_DBCNetWork_Can0
        CanWakeupSourceRef = EcuMCommonConfiguration/CN_DBCNetWork_Can0_7c554129
        CanControllerBaudrateConfig: CanControllerBaudRate=500
      4 x CanHardwareObject, all with CanHandleType=BASIC, CanIdValue=0:
        CN_DBCNetWork_9ed72b09_Tx: CanObjectType=TRANSMIT, CanControllerRef=CanConfigSet/CT_DBCNetWork_78f82e94
        CN_DBCNetWork_Can0_3e6cf38a_Rx: CanIdType=STANDARD, CanObjectType=RECEIVE, CanControllerRef=CanConfigSet/CT_DBCNetWork_Can0_5928070d
        CN_DBCNetWork_Can0_7c554129_Tx: CanObjectType=TRANSMIT, CanControllerRef=CanConfigSet/CT_DBCNetWork_Can0_5928070d
        CN_DBCNetWork_b9b38c08_Rx: CanIdType=STANDARD, CanObjectType=RECEIVE, CanControllerRef=CanConfigSet/CT_DBCNetWork_78f82e94
    CanGeneral: CanIndex=0
  module config CanIf
    CanIfCtrlDrvCfg_7d254554 (CanIfCtrlDrvCfg): CanIfCtrlDrvInitHohConfigRef=CanIfInitHohCfg, CanIfCtrlDrvNameRef=CanGeneral
      CT_DBCNetWork_78f82e94 (CanIfCtrlCfg): CanIfCtrlCanCtrlRef=CanConfigSet/CT_DBCNetWork_78f82e94
      CT_DBCNetWork_Can0_5928070d (CanIfCtrlCfg): CanIfCtrlCanCtrlRef=CanConfigSet/CT_DBCNetWork_Can0_5928070d
    CanIfInitCfg
      CHNL_50204034 (CanIfBufferCfg): CanIfBufferSize=0, CanIfBufferHthRef=CanIfInitHohCfg/CN_DBCNetWork_9ed72b09_Tx
      CHNL_8d655e5f (CanIfBufferCfg): CanIfBufferSize=0, CanIfBufferHthRef=CanIfInitHohCfg/CN_DBCNetWork_Can0_7c554129_Tx
      CanIfInitHohCfg: CanIfInitRefCfgSet=CanConfigSet
        CN_DBCNetWork_Can0_3e6cf38a_Rx (CanIfHrhCfg): CanIfHrhCanCtrlIdRef=CanIfCtrlDrvCfg_7d254554/CT_DBCNetWork_Can0_5928070d, CanIfHrhIdSymRef=CanConfigSet/CN_DBCNetWork_Can0_3e6cf38a_Rx
        CN_DBCNetWork_b9b38c08_Rx (CanIfHrhCfg): CanIfHrhCanCtrlIdRef=CanIfCtrlDrvCfg_7d254554/CT_DBCNetWork_78f82e94, CanIfHrhIdSymRef=CanConfigSet/CN_DBCNetWork_b9b38c08_Rx
        CN_DBCNetWork_9ed72b09_Tx (CanIfHthCfg): CanIfHthCanCtrlIdRef=CanIfCtrlDrvCfg_7d254554/CT_DBCNetWork_78f82e94, CanIfHthIdSymRef=CanConfigSet/CN_DBCNetWork_9ed72b09_Tx
        CN_DBCNetWork_Can0_7c554129_Tx (CanIfHthCfg): CanIfHthCanCtrlIdRef=CanIfCtrlDrvCfg_7d254554/CT_DBCNetWork_Can0_5928070d, CanIfHthIdSymRef=CanConfigSet/CN_DBCNetWork_Can0_7c554129_Tx
      10 x CanIfRxPduCfg, all with CanIfRxPduCanIdType=STANDARD_CAN, CanIfRxPduDlc=8:
        Ecu_Receive_Msg_oDBCNetWork_Can0_47317097_Rx: CanIfRxPduCanId=512, CanIfRxPduHrhIdRef=CanIfInitHohCfg/CN_DBCNetWork_Can0_3e6cf38a_Rx, CanIfRxPduRef=Ecu_Receive_Msg_oDBCNetWork_Can0_364979cb_Rx
        Meg_FunDiag_Tp_oDBCNetWork_c3b25a60_Rx: CanIfRxPduCanId=2015, CanIfRxPduUserRxIndicationName=CanTp_RxIndication, CanIfRxPduUserRxIndicationType=PDUID_PDUINFOPTR, CanIfRxPduUserRxIndicationUL=CAN_TP, CanIfRxPduHrhIdRef=CanIfInitHohCfg/CN_DBCNetWork_b9b38c08_Rx, CanIfRxPduRef=Meg_FunDiag_Tp_oDBCNetWork_1b821788_Rx
        Meg_PhyDiag_Tp_oDBCNetWork_a8746177_Rx: CanIfRxPduCanId=1793, CanIfRxPduUserRxIndicationName=CanTp_RxIndication, CanIfRxPduUserRxIndicationType=PDUID_PDUINFOPTR, CanIfRxPduUserRxIndicationUL=CAN_TP, CanIfRxPduHrhIdRef=CanIfInitHohCfg/CN_DBCNetWork_b9b38c08_Rx, CanIfRxPduRef=Meg_PhyDiag_Tp_oDBCNetWork_ff3be21a_Rx
        Rout_Can0ToCan1_100ms_oDBCNetWork_Can0_bbeab158_Rx: CanIfRxPduCanId=1385, CanIfRxPduHrhIdRef=CanIfInitHohCfg/CN_DBCNetWork_Can0_3e6cf38a_Rx, CanIfRxPduRef=Rout_Can0ToCan1_100ms_oDBCNetWork_Can0_6e10546a_Rx
        Route_Can1ToCan0_100ms_oDBCNetWork_11bc43a8_Rx: CanIfRxPduCanId=941, CanIfRxPduHrhIdRef=CanIfInitHohCfg/CN_DBCNetWork_b9b38c08_Rx, CanIfRxPduRef=Route_Can1ToCan0_100ms_oDBCNetWork_44a2d8cc_Rx
        SupB_Button_Control_oDBCNetWork_b59ad01b_Rx: CanIfRxPduCanId=1025, CanIfRxPduDataChecksumPdu=false, CanIfRxPduUserRxIndicationName=PduR_CanIfRxIndication, CanIfRxPduUserRxIndicationUL=PDUR, CanIfRxPduHrhIdRef=CanIfInitHohCfg/CN_DBCNetWork_b9b38c08_Rx, CanIfRxPduRef=EcucPduCollection/SupB_Button_Control_oDBCNetWork_a24295f7_Rx
        SupB_Led_Control_oDBCNetWork_aacf6ceb_Rx: CanIfRxPduCanId=1024, CanIfRxPduDataChecksumPdu=false, CanIfRxPduUserRxIndicationName=PduR_CanIfRxIndication, CanIfRxPduUserRxIndicationUL=PDUR, CanIfRxPduHrhIdRef=CanIfInitHohCfg/CN_DBCNetWork_b9b38c08_Rx, CanIfRxPduRef=EcucPduCollection/SupB_Led_Control_oDBCNetWork_496a3ac6_Rx
        SupC_Function_1_oDBCNetWork_51474a89_Rx: CanIfRxPduCanId=1026, CanIfRxPduDataChecksumPdu=false, CanIfRxPduUserRxIndicationName=PduR_CanIfRxIndication, CanIfRxPduUserRxIndicationUL=PDUR, CanIfRxPduHrhIdRef=CanIfInitHohCfg/CN_DBCNetWork_b9b38c08_Rx, CanIfRxPduRef=EcucPduCollection/SupC_Function_1_oDBCNetWork_44e7ee76_Rx
        SupC_Function_2_oDBCNetWork_e1b16d9f_Rx: CanIfRxPduCanId=1027, CanIfRxPduDataChecksumPdu=false, CanIfRxPduUserRxIndicationName=PduR_CanIfRxIndication, CanIfRxPduUserRxIndicationUL=PDUR, CanIfRxPduHrhIdRef=CanIfInitHohCfg/CN_DBCNetWork_b9b38c08_Rx, CanIfRxPduRef=EcucPduCollection/SupC_Function_2_oDBCNetWork_1ff05f63_Rx
        XB_SUP_A_bafba356_Rx: CanIfRxPduUserRxIndicationName=CanNm_RxIndication, CanIfRxPduUserRxIndicationUL=CAN_NM, CanIfRxPduHrhIdRef=CanIfInitHohCfg/CN_DBCNetWork_b9b38c08_Rx, CanIfRxPduRef=XB_SUP_A_17ea32c5_Rx
          CHNL_fe692093 (CanIfRxPduCanIdRange): CanIfRxPduCanIdRangeLowerCanId=1536, CanIfRxPduCanIdRangeUpperCanId=1791
      10 x CanIfTxPduCfg, all with CanIfTxPduCanIdType=STANDARD_CAN, CanIfTxPduDlc=8:
        Ecu_Send_Msg_oDBCNetWork_Can0_0cc6104d_Tx: CanIfTxPduCanId=256, CanIfTxPduBufferRef=CanIfInitCfg/CHNL_8d655e5f, CanIfTxPduRef=Ecu_Send_Msg_oDBCNetWork_Can0_da1e44e3_Tx
        Meg_NmTx_oDBCNetWork_c0e25960_Tx: CanIfTxPduCanId=1537, CanIfTxPduUserTxConfirmationName=CanNm_TxConfirmation, CanIfTxPduUserTxConfirmationUL=CAN_NM, CanIfTxPduBufferRef=CanIfInitCfg/CHNL_50204034, CanIfTxPduRef=EcucPduCollection/Meg_NmTx_oDBCNetWork_5d9e34f5_Tx
        Meg_ResDiag_Tp_oDBCNetWork_d97dd71a_Tx: CanIfTxPduCanId=1873, CanIfTxPduUserTxConfirmationName=CanTp_TxConfirmation, CanIfTxPduUserTxConfirmationUL=CAN_TP, CanIfTxPduBufferRef=CanIfInitCfg/CHNL_50204034, CanIfTxPduRef=Meg_ResDiag_Tp_oDBCNetWork_4a610c1c_Tx
        Rout_Can1ToCan0_100ms_oDBCNetWork_Can0_8073c8b9_Tx: CanIfTxPduCanId=941, CanIfTxPduBufferRef=CanIfInitCfg/CHNL_8d655e5f, CanIfTxPduRef=Rout_Can1ToCan0_100ms_oDBCNetWork_Can0_c34bc869_Tx
        Route_Can0ToCan1_100ms_oDBCNetWork_bd7918cc_Tx: CanIfTxPduCanId=1385, CanIfTxPduBufferRef=CanIfInitCfg/CHNL_50204034, CanIfTxPduRef=Route_Can0ToCan1_100ms_oDBCNetWork_a9bdfb29_Tx
        SupA_Angle_oDBCNetWork_8a58a84d_Tx: CanIfTxPduCanId=275, CanIfTxPduDataChecksumPdu=false, CanIfTxPduUserTxConfirmationName=PduR_CanIfTxConfirmation, CanIfTxPduUserTxConfirmationUL=PDUR, CanIfTxPduBufferRef=CanIfInitCfg/CHNL_50204034, CanIfTxPduRef=EcucPduCollection/SupA_Angle_oDBCNetWork_418b1596_Tx
        SupA_Button_State_oDBCNetWork_cea719eb_Tx: CanIfTxPduCanId=273, CanIfTxPduDataChecksumPdu=false, CanIfTxPduUserTxConfirmationName=PduR_CanIfTxConfirmation, CanIfTxPduUserTxConfirmationUL=PDUR, CanIfTxPduBufferRef=CanIfInitCfg/CHNL_50204034, CanIfTxPduRef=EcucPduCollection/SupA_Button_State_oDBCNetWork_eea6565b_Tx
        SupA_Function_1_oDBCNetWork_7707e452_Tx: CanIfTxPduCanId=276, CanIfTxPduDataChecksumPdu=false, CanIfTxPduUserTxConfirmationName=PduR_CanIfTxConfirmation, CanIfTxPduUserTxConfirmationUL=PDUR, CanIfTxPduBufferRef=CanIfInitCfg/CHNL_50204034, CanIfTxPduRef=EcucPduCollection/SupA_Function_1_oDBCNetWork_10b79eb2_Tx
        SupA_Led_State_oDBCNetWork_f5d8795b_Tx: CanIfTxPduCanId=272, CanIfTxPduDataChecksumPdu=false, CanIfTxPduUserTxConfirmationName=PduR_CanIfTxConfirmation, CanIfTxPduUserTxConfirmationUL=PDUR, CanIfTxPduBufferRef=CanIfInitCfg/CHNL_50204034, CanIfTxPduRef=EcucPduCollection/SupA_Led_State_oDBCNetWork_e7f688d3_Tx
        SupA_PowerMode_oDBCNetWork_d8135f5e_Tx: CanIfTxPduCanId=274, CanIfTxPduDataChecksumPdu=false, CanIfTxPduUserTxConfirmationName=PduR_CanIfTxConfirmation, CanIfTxPduUserTxConfirmationUL=PDUR, CanIfTxPduBufferRef=CanIfInitCfg/CHNL_50204034, CanIfTxPduRef=EcucPduCollection/SupA_PowerMode_oDBCNetWork_910ccf57_Tx
    CanIfPrivateCfg: CanIfPrivateSoftwareFilterType=LINEAR
    CanIfPublicCfg: CanIfPublicPnSupport=false
  module config CanNm
    CanNmGlobalConfig:
      CanNmBusSynchronizationEnabled = false
      CanNmPassiveModeEnabled = true
      CanNmPnEiraCalcEnabled = false
      CanNmRemoteSleepIndEnabled = false
      CanNmUserDataEnabled = true
      DBCNetWork_CAN_9b3bc41d (CanNmChannelConfig): CanNmNodeId=1, CanNmTimeoutTime=2, CanNmUserDataLength=6, CanNmWaitBusSleepTime=2, CanNmComMNetworkHandleRef=ComMConfigSet/CN_DBCNetWork_9ed72b09
        DBCNetWork_CAN_9b3bc41d_Rx (CanNmRxPdu): CanNmRxPduRef=XB_SUP_A_17ea32c5_Rx
        Meg_NmTx_oDBCNetWork_5d9e34f5_Tx (CanNmTxPdu): CanNmTxPduRef=EcucPduCollection/Meg_NmTx_oDBCNetWork_5d9e34f5_Tx
      DBCNetWork_Can0_CAN_ed723e4d (CanNmChannelConfig):
        CanNmNodeId = 1
        CanNmTimeoutTime = 2
        CanNmUserDataLength = 6
        CanNmWaitBusSleepTime = 2
        CanNmComMNetworkHandleRef = ComMConfigSet/CN_DBCNetWork_Can0_7c554129
        DBCNetWork_Can0_CAN_ed723e4d_Rx (CanNmRxPdu)
  module config CanSM
    CanSMConfiguration
      CHNL_50204034 (CanSMManagerNetwork): CanSMComMNetworkHandleRef=ComMConfigSet/CN_DBCNetWork_9ed72b09
        CT_DBCNetWork_d63ca446 (CanSMController): CanSMControllerId=CanIfCtrlDrvCfg_7d254554/CT_DBCNetWork_78f82e94
      CHNL_8d655e5f (CanSMManagerNetwork): CanSMComMNetworkHandleRef=ComMConfigSet/CN_DBCNetWork_Can0_7c554129
        CT_DBCNetWork_Can0_0f7626e9 (CanSMController): CanSMControllerId=CanIfCtrlDrvCfg_7d254554/CT_DBCNetWork_Can0_5928070d
  module config CanTp
    CanTpConfig: CanTpMainFunctionPeriod=0.005
      TPCH_6f1a700a (CanTpChannel): CanTpChannelMode=CANTP_MODE_FULL_DUPLEX
        CanTpRxNSdu_ee3c4bd1 (CanTpRxNSdu):
          CanTpRxAddressingFormat = CANTP_STANDARD
          CanTpRxDl = 8
          CanTpRxTaType = CANTP_FUNCTIONAL
          CanTpRxNSduRef = EcucPduCollection/Meg_FunDiag_oDBCNetWork_245e23dc_Rx
          CanTpRxNPdu_e39092f8 (CanTpRxNPdu): CanTpRxNPduRef=Meg_FunDiag_Tp_oDBCNetWork_1b821788_Rx
      TPCH_ce641bee (CanTpChannel): CanTpChannelMode=CANTP_MODE_FULL_DUPLEX
        CanTpRxNSdu_a51614e7 (CanTpRxNSdu):
          CanTpRxAddressingFormat = CANTP_STANDARD
          CanTpRxDl = 8
          CanTpRxTaType = CANTP_PHYSICAL
          CanTpRxNSduRef = EcucPduCollection/Meg_PhyDiag_oDBCNetWork_e94a8f4d_Rx
          CanTpRxNPdu_c9d885cf (CanTpRxNPdu): CanTpRxNPduRef=Meg_PhyDiag_Tp_oDBCNetWork_ff3be21a_Rx
          CanTpTxFcNPdu_c9d885cf (CanTpTxFcNPdu): CanTpTxFcNPduRef=Meg_ResDiag_Tp_oDBCNetWork_4a610c1c_Tx
        CanTpTxNSdu_a51614e7 (CanTpTxNSdu):
          CanTpTxAddressingFormat = CANTP_STANDARD
          CanTpTxDl = 8
          CanTpTxTaType = CANTP_PHYSICAL
          CanTpTxNSduRef = EcucPduCollection/Meg_ResDiag_oDBCNetWork_1336e721_Tx
          CanTpRxFcNPdu_eb22513d (CanTpRxFcNPdu): CanTpRxFcNPduRef=Meg_PhyDiag_Tp_oDBCNetWork_ff3be21a_Rx
          CanTpTxNPdu_eb22513d (CanTpTxNPdu): CanTpTxNPduRef=Meg_ResDiag_Tp_oDBCNetWork_4a610c1c_Tx
  module config Com
    ComConfig
      9 x ComIPdu, all with ComIPduType=NORMAL:
        SupA_Angle_oDBCNetWork_e5909e4f_Tx: ComIPduDirection=SEND, ComIPduGroupRef=XB_SUP_A_oDBCNetWork_Tx_859ab3c9, ComIPduSignalGroupRef=SG_Sig_Grp_0x113_oSupA_Angle_oDBCNetWork_c5c2558a_Tx, ComPduIdRef=EcucPduCollection/SupA_Angle_oDBCNetWork_e5909e4f_Tx
          ComTxIPdu: ComMinimumDelayTime=0, ComTxIPduUnusedAreasDefault=0
            ComTxModeFalse
              ComTxMode: ComTxModeMode=PERIODIC, ComTxModeTimeOffset=0, ComTxModeTimePeriod=0.01
            ComTxModeTrue
              ComTxMode: ComTxModeMode=PERIODIC, ComTxModeTimeOffset=0, ComTxModeTimePeriod=0.01
        SupA_Button_State_oDBCNetWork_390399bb_Tx: ComIPduDirection=SEND, ComIPduGroupRef=XB_SUP_A_oDBCNetWork_Tx_859ab3c9, ComIPduSignalGroupRef=SG_Sig_Grp_0x111_oSupA_Button_State_oDBCNetWork_062df960_Tx, ComPduIdRef=EcucPduCollection/SupA_Button_State_oDBCNetWork_390399bb_Tx
          ComTxIPdu: ComMinimumDelayTime=0, ComTxIPduUnusedAreasDefault=0
            ComTxModeFalse
              ComTxMode: ComTxModeMode=PERIODIC, ComTxModeTimeOffset=0, ComTxModeTimePeriod=0.01
            ComTxModeTrue
              ComTxMode: ComTxModeMode=PERIODIC, ComTxModeTimeOffset=0, ComTxModeTimePeriod=0.01
        SupA_Function_1_oDBCNetWork_312706bd_Tx: ComIPduDirection=SEND, ComIPduGroupRef=XB_SUP_A_oDBCNetWork_Tx_859ab3c9, ComIPduSignalGroupRef=SG_Sig_Grp_0x114_oSupA_Function_1_oDBCNetWork_fe007f55_Tx, ComIPduSignalRef=Sig_0x114_Used_6_oSupA_Function_1_oDBCNetWork_d918db4b_Tx, ComPduIdRef=EcucPduCollection/SupA_Function_1_oDBCNetWork_312706bd_Tx
          ComTxIPdu: ComMinimumDelayTime=0, ComTxIPduUnusedAreasDefault=0
            ComTxModeFalse
              ComTxMode: ComTxModeMode=MIXED, ComTxModeNumberOfRepetitions=4, ComTxModeRepetitionPeriod=0.02, ComTxModeTimeOffset=0, ComTxModeTimePeriod=0
            ComTxModeTrue
              ComTxMode: ComTxModeMode=MIXED, ComTxModeNumberOfRepetitions=4, ComTxModeRepetitionPeriod=0.02, ComTxModeTimeOffset=0, ComTxModeTimePeriod=0
        SupA_Led_State_oDBCNetWork_43576f7c_Tx: ComIPduDirection=SEND, ComIPduGroupRef=XB_SUP_A_oDBCNetWork_Tx_859ab3c9, ComIPduSignalGroupRef=SG_Sig_Grp_0x110_oSupA_Led_State_oDBCNetWork_89d57c9b_Tx, ComPduIdRef=EcucPduCollection/SupA_Led_State_oDBCNetWork_43576f7c_Tx
          ComTxIPdu: ComMinimumDelayTime=0, ComTxIPduUnusedAreasDefault=0
            ComTxModeFalse
              ComTxMode: ComTxModeMode=PERIODIC, ComTxModeTimeOffset=0, ComTxModeTimePeriod=0.01
            ComTxModeTrue
              ComTxMode: ComTxModeMode=PERIODIC, ComTxModeTimeOffset=0, ComTxModeTimePeriod=0.01
        SupA_PowerMode_oDBCNetWork_b77edafa_Tx: ComIPduDirection=SEND, ComIPduGroupRef=XB_SUP_A_oDBCNetWork_Tx_859ab3c9, ComIPduSignalGroupRef=SG_Sig_Grp_0x112_oSupA_PowerMode_oDBCNetWork_bbf37b55_Tx, ComPduIdRef=EcucPduCollection/SupA_PowerMode_oDBCNetWork_b77edafa_Tx
          ComTxIPdu: ComMinimumDelayTime=0, ComTxIPduUnusedAreasDefault=0
            ComTxModeFalse
              ComTxMode: ComTxModeMode=PERIODIC, ComTxModeTimeOffset=0, ComTxModeTimePeriod=0.2
            ComTxModeTrue
              ComTxMode: ComTxModeMode=PERIODIC, ComTxModeTimeOffset=0, ComTxModeTimePeriod=0.2
        SupB_Button_Control_oDBCNetWork_0c40490d_Rx: ComIPduDirection=RECEIVE, ComIPduGroupRef=XB_SUP_A_oDBCNetWork_Rx_d3c0144f, ComIPduSignalGroupRef=SG_Sig_Grp_0x401_oSupB_Button_Control_oDBCNetWork_41809065_Rx, ComPduIdRef=EcucPduCollection/SupB_Button_Control_oDBCNetWork_0c40490d_Rx
        SupB_Led_Control_oDBCNetWork_eb16948d_Rx: ComIPduDirection=RECEIVE, ComIPduGroupRef=XB_SUP_A_oDBCNetWork_Rx_d3c0144f, ComIPduSignalGroupRef=SG_Sig_Grp_0x400_oSupB_Led_Control_oDBCNetWork_6275ac6f_Rx, ComPduIdRef=EcucPduCollection/SupB_Led_Control_oDBCNetWork_eb16948d_Rx
        SupC_Function_1_oDBCNetWork_e81ccab2_Rx: ComIPduDirection=RECEIVE, ComIPduGroupRef=XB_SUP_A_oDBCNetWork_Rx_d3c0144f, ComIPduSignalGroupRef=SG_Sig_Grp_0x402_oSupC_Function_1_oDBCNetWork_20ce0e3b_Rx, ComPduIdRef=EcucPduCollection/SupC_Function_1_oDBCNetWork_e81ccab2_Rx
        SupC_Function_2_oDBCNetWork_55d6a67c_Rx: ComIPduDirection=RECEIVE, ComIPduGroupRef=XB_SUP_A_oDBCNetWork_Rx_d3c0144f, ComIPduSignalGroupRef=SG_Sig_Grp_0x403_oSupC_Function_2_oDBCNetWork_a16481fd_Rx, ComPduIdRef=EcucPduCollection/SupC_Function_2_oDBCNetWork_55d6a67c_Rx
      XB_SUP_A_oDBCNetWork_Rx_d3c0144f (ComIPduGroup)
      XB_SUP_A_oDBCNetWork_Tx_859ab3c9 (ComIPduGroup)
      Sig_0x114_Used_6_oSupA_Function_1_oDBCNetWork_d918db4b_Tx (ComSignal):
        ComBitPosition = 63
        ComBitSize = 8
        ComSignalEndianness = BIG_ENDIAN
        ComSignalInitValue = 0
        ComSignalType = UINT8
        ComTransferProperty = TRIGGERED
        ComSystemTemplateSystemSignalRef = Sig_0x114_Used_6
      9 x ComSignalGroup, all with ComTransferProperty=PENDING:
        SG_Sig_Grp_0x110_oSupA_Led_State_oDBCNetWork_89d57c9b_Tx: ComSystemTemplateSignalGroupRef=SG_Sig_Grp_0x110
          4 x ComGroupSignal, all with ComBitSize=1, ComSignalEndianness=BIG_ENDIAN, ComSignalInitValue=0, ComSignalType=BOOLEAN, ComTransferProperty=PENDING:
            Led1_State_oSupA_Led_State_oDBCNetWork_987486a5_Tx: ComBitPosition=0, ComSystemTemplateSystemSignalRef=Led1_State
            Led2_State_oSupA_Led_State_oDBCNetWork_13a7b8bc_Tx: ComBitPosition=1, ComSystemTemplateSystemSignalRef=Led2_State
            Led3_State_oSupA_Led_State_oDBCNetWork_dc39af74_Tx: ComBitPosition=2, ComSystemTemplateSystemSignalRef=Led3_State
            Led4_State_oSupA_Led_State_oDBCNetWork_df70c2cf_Tx: ComBitPosition=3, ComSystemTemplateSystemSignalRef=Led4_State
        SG_Sig_Grp_0x111_oSupA_Button_State_oDBCNetWork_062df960_Tx: ComSystemTemplateSignalGroupRef=SG_Sig_Grp_0x111
          4 x ComGroupSignal, all with ComBitSize=1, ComSignalEndianness=BIG_ENDIAN, ComSignalInitValue=0, ComSignalType=BOOLEAN, ComTransferProperty=PENDING:
            Button1_State_oSupA_Button_State_oDBCNetWork_f13c0622_Tx: ComBitPosition=32, ComSystemTemplateSystemSignalRef=Button1_State
            Button2_State_oSupA_Button_State_oDBCNetWork_bcd40645_Tx: ComBitPosition=33, ComSystemTemplateSystemSignalRef=Button2_State
            Button3_State_oSupA_Button_State_oDBCNetWork_315cfba7_Tx: ComBitPosition=34, ComSystemTemplateSystemSignalRef=Button3_State
            Button4_State_oSupA_Button_State_oDBCNetWork_2704068b_Tx: ComBitPosition=35, ComSystemTemplateSystemSignalRef=Button4_State
        SG_Sig_Grp_0x112_oSupA_PowerMode_oDBCNetWork_bbf37b55_Tx: ComSystemTemplateSignalGroupRef=SG_Sig_Grp_0x112
          3 x ComGroupSignal, all with ComSignalEndianness=BIG_ENDIAN, ComSignalInitValue=0, ComSignalType=UINT8, ComTransferProperty=PENDING:
            PowerMode_oSupA_PowerMode_oDBCNetWork_c3b722c7_Tx: ComBitPosition=10, ComBitSize=3, ComSystemTemplateSystemSignalRef=PowerMode
            SupA_Checksum_0x112_oSupA_PowerMode_oDBCNetWork_3f776c50_Tx: ComBitPosition=7, ComBitSize=8, ComSystemTemplateSystemSignalRef=SupA_Checksum_0x112
            SupA_Counter_0x112_oSupA_PowerMode_oDBCNetWork_5e5c6751_Tx: ComBitPosition=59, ComBitSize=4, ComSystemTemplateSystemSignalRef=SupA_Counter_0x112
        SG_Sig_Grp_0x113_oSupA_Angle_oDBCNetWork_c5c2558a_Tx: ComSystemTemplateSignalGroupRef=SG_Sig_Grp_0x113
          AAA_Angle_oSupA_Angle_oDBCNetWork_1adb3bf0_Tx (ComGroupSignal):
            ComBitPosition = 5
            ComBitSize = 6
            ComSignalEndianness = BIG_ENDIAN
            ComSignalInitValue = 20
            ComSignalType = UINT8
            ComTransferProperty = PENDING
            ComSystemTemplateSystemSignalRef = AAA_Angle
        SG_Sig_Grp_0x114_oSupA_Function_1_oDBCNetWork_fe007f55_Tx: ComSystemTemplateSignalGroupRef=SG_Sig_Grp_0x114
          5 x ComGroupSignal, all with ComSignalEndianness=BIG_ENDIAN, ComSignalInitValue=0, ComTransferProperty=PENDING:
            Sig_0x114_Used_1_oSupA_Function_1_oDBCNetWork_6c3a7273_Tx: ComBitPosition=7, ComBitSize=4, ComSignalType=UINT8, ComSystemTemplateSystemSignalRef=Sig_0x114_Used_1
            Sig_0x114_Used_2_oSupA_Function_1_oDBCNetWork_289b576b_Tx: ComBitPosition=3, ComBitSize=12, ComSignalType=UINT16, ComSystemTemplateSystemSignalRef=Sig_0x114_Used_2
            Sig_0x114_Used_3_oSupA_Function_1_oDBCNetWork_14fbb463_Tx: ComBitPosition=23, ComBitSize=16, ComSignalType=UINT16, ComSystemTemplateSystemSignalRef=Sig_0x114_Used_3
            Sig_0x114_Used_4_oSupA_Function_1_oDBCNetWork_a1d91d5b_Tx: ComBitPosition=39, ComBitSize=16, ComSignalType=UINT16, ComSystemTemplateSystemSignalRef=Sig_0x114_Used_4
            Sig_0x114_Used_5_oSupA_Function_1_oDBCNetWork_9db9fe53_Tx: ComBitPosition=55, ComBitSize=8, ComSignalType=UINT8, ComSystemTemplateSystemSignalRef=Sig_0x114_Used_5
        SG_Sig_Grp_0x400_oSupB_Led_Control_oDBCNetWork_6275ac6f_Rx: ComTimeout=0, ComSystemTemplateSignalGroupRef=SG_Sig_Grp_0x400
          9 x ComGroupSignal, all with ComSignalEndianness=BIG_ENDIAN:
            CrcSig_Pack_0_oSupB_Led_Control_oDBCNetWork_ecfc9a83_Rx: ComBitPosition=15, ComBitSize=4, ComSignalInitValue=0, ComSignalType=UINT8, ComSystemTemplateSystemSignalRef=CrcSig_Pack_0
            CrcSig_Pack_1_oSupB_Led_Control_oDBCNetWork_e21b7252_Rx: ComBitPosition=23, ComBitSize=24, ComSignalInitValue=0, ComSignalType=UINT32, ComSystemTemplateSystemSignalRef=CrcSig_Pack_1
            CrcSig_Pack_2_oSupB_Led_Control_oDBCNetWork_f1334b21_Rx: ComBitPosition=47, ComBitSize=20, ComSignalInitValue=0, ComSignalType=UINT32, ComSystemTemplateSystemSignalRef=CrcSig_Pack_2
            Led1_Control_oSupB_Led_Control_oDBCNetWork_48297120_Rx: ComBitPosition=8, ComBitSize=1, ComSignalInitValue=1, ComSignalType=BOOLEAN, ComSystemTemplateSystemSignalRef=Led1_Control
            Led2_Control_oSupB_Led_Control_oDBCNetWork_9bb26ddb_Rx: ComBitPosition=9, ComBitSize=1, ComSignalInitValue=1, ComSignalType=BOOLEAN, ComSystemTemplateSystemSignalRef=Led2_Control
            Led3_Control_oSupB_Led_Control_oDBCNetWork_d53b6672_Rx: ComBitPosition=10, ComBitSize=1, ComSignalInitValue=1, ComSignalType=BOOLEAN, ComSystemTemplateSystemSignalRef=Led3_Control
            Led4_Control_oSupB_Led_Control_oDBCNetWork_e7f5526c_Rx: ComBitPosition=11, ComBitSize=1, ComSignalInitValue=1, ComSignalType=BOOLEAN, ComSystemTemplateSystemSignalRef=Led4_Control
            SupB_Checksum_0x400_oSupB_Led_Control_oDBCNetWork_1c8bf5dc_Rx: ComBitPosition=7, ComBitSize=8, ComSignalInitValue=0, ComSignalType=UINT8, ComSystemTemplateSystemSignalRef=SupB_Checksum_0x400
            SupB_Counter_0x400_oSupB_Led_Control_oDBCNetWork_2dd3ae1e_Rx: ComBitPosition=59, ComBitSize=4, ComSignalInitValue=0, ComSignalType=UINT8, ComSystemTemplateSystemSignalRef=SupB_Counter_0x400
        SG_Sig_Grp_0x401_oSupB_Button_Control_oDBCNetWork_41809065_Rx: ComTimeout=0, ComSystemTemplateSignalGroupRef=SG_Sig_Grp_0x401
          4 x ComGroupSignal, all with ComBitSize=1, ComSignalEndianness=BIG_ENDIAN, ComSignalInitValue=0, ComSignalType=BOOLEAN:
            Button1_Control_oSupB_Button_Control_oDBCNetWork_cbcdfbc4_Rx: ComBitPosition=48, ComSystemTemplateSystemSignalRef=Button1_Control
            Button2_Control_oSupB_Button_Control_oDBCNetWork_f3f670b7_Rx: ComBitPosition=49, ComSystemTemplateSystemSignalRef=Button2_Control
            Button3_Control_oSupB_Button_Control_oDBCNetWork_52cff459_Rx: ComBitPosition=50, ComSystemTemplateSystemSignalRef=Button3_Control
            Button4_Control_oSupB_Button_Control_oDBCNetWork_83816651_Rx: ComBitPosition=51, ComSystemTemplateSystemSignalRef=Button4_Control
        SG_Sig_Grp_0x402_oSupC_Function_1_oDBCNetWork_20ce0e3b_Rx: ComTimeout=0, ComSystemTemplateSignalGroupRef=SG_Sig_Grp_0x402
          5 x ComGroupSignal, all with ComSignalEndianness=BIG_ENDIAN, ComSignalInitValue=0:
            Sig_0x402_Used_1_oSupC_Function_1_oDBCNetWork_23971e12_Rx: ComBitPosition=7, ComBitSize=4, ComSignalType=UINT8, ComSystemTemplateSystemSignalRef=Sig_0x402_Used_1
            Sig_0x402_Used_2_oSupC_Function_1_oDBCNetWork_67363b0a_Rx: ComBitPosition=3, ComBitSize=12, ComSignalType=UINT16, ComSystemTemplateSystemSignalRef=Sig_0x402_Used_2
            Sig_0x402_Used_3_oSupC_Function_1_oDBCNetWork_5b56d802_Rx: ComBitPosition=23, ComBitSize=16, ComSignalType=UINT16, ComSystemTemplateSystemSignalRef=Sig_0x402_Used_3
            Sig_0x402_Used_4_oSupC_Function_1_oDBCNetWork_ee74713a_Rx: ComBitPosition=39, ComBitSize=16, ComSignalType=UINT16, ComSystemTemplateSystemSignalRef=Sig_0x402_Used_4
            Sig_0x402_Used_5_oSupC_Function_1_oDBCNetWork_d2149232_Rx: ComBitPosition=55, ComBitSize=16, ComSignalType=UINT16, ComSystemTemplateSystemSignalRef=Sig_0x402_Used_5
        SG_Sig_Grp_0x403_oSupC_Function_2_oDBCNetWork_a16481fd_Rx: ComTimeout=0, ComSystemTemplateSignalGroupRef=SG_Sig_Grp_0x403
          5 x ComGroupSignal, all with ComSignalEndianness=BIG_ENDIAN, ComSignalInitValue=0:
            Sig_0x403_Used_1_oSupC_Function_2_oDBCNetWork_1ead65c3_Rx: ComBitPosition=7, ComBitSize=4, ComSignalType=UINT8, ComSystemTemplateSystemSignalRef=Sig_0x403_Used_1
            Sig_0x403_Used_2_oSupC_Function_2_oDBCNetWork_5a0c40db_Rx: ComBitPosition=3, ComBitSize=12, ComSignalType=UINT16, ComSystemTemplateSystemSignalRef=Sig_0x403_Used_2
            Sig_0x403_Used_3_oSupC_Function_2_oDBCNetWork_666ca3d3_Rx: ComBitPosition=23, ComBitSize=16, ComSignalType=UINT16, ComSystemTemplateSystemSignalRef=Sig_0x403_Used_3
            Sig_0x403_Used_4_oSupC_Function_2_oDBCNetWork_d34e0aeb_Rx: ComBitPosition=39, ComBitSize=16, ComSignalType=UINT16, ComSystemTemplateSystemSignalRef=Sig_0x403_Used_4
            Sig_0x403_Used_5_oSupC_Function_2_oDBCNetWork_ef2ee9e3_Rx: ComBitPosition=55, ComBitSize=16, ComSignalType=UINT16, ComSystemTemplateSystemSignalRef=Sig_0x403_Used_5
    ComGeneral
  module config ComM
    ComMConfigSet: ComMPncEnabled=false
      CN_DBCNetWork_9ed72b09 (ComMChannel): ComMBusType=COMM_BUS_TYPE_CAN, ComMChannelId=0
        ComMNetworkManagement: ComMNmVariant=PASSIVE
        CN_DBCNetWork_135846e6 (ComMUserPerChannel): ComMUserChannel=CN_DBCNetWork_c855c7bf
      CN_DBCNetWork_Can0_7c554129 (ComMChannel): ComMBusType=COMM_BUS_TYPE_CAN, ComMChannelId=1
        ComMNetworkManagement: ComMNmVariant=PASSIVE
        CN_DBCNetWork_Can0_4c3e2312 (ComMUserPerChannel): ComMUserChannel=CN_DBCNetWork_Can0_4f8ab83d
      CN_DBCNetWork_Can0_4f8ab83d (ComMUser): ComMUserIdentifier=1
      CN_DBCNetWork_c855c7bf (ComMUser): ComMUserIdentifier=0
    ComMGeneral: ComMPncIdCounting=COMM_PNC_ID_COUNT_FROM_NM_MESSAGE, ComMPncSupport=false
  module config Dcm
    DcmConfigSet  # Diagnostics Data Import
      DcmDsl
        DcmDslProtocol
          DcmDslProtocolRow_29812fbf (DcmDslProtocolRow)
            DcmDslConnection_531a7f3e (DcmDslConnection)
              DcmDslMainConnection
                Meg_FunDiag_oDBCNetWork_8501a87a_Rx_bf5f7bb7 (DcmDslProtocolRx):
                  DcmDslProtocolRxAddrType = DCM_FUNCTIONAL_TYPE
                  DcmDslProtocolRxPduId = 1
                  DcmDslProtocolRxComMChannelRef = ComMConfigSet/CN_DBCNetWork_9ed72b09
                  DcmDslProtocolRxPduRef = Meg_FunDiag_oDBCNetWork_8501a87a_Rx
                Meg_PhyDiag_oDBCNetWork_e154eea6_Rx_9bc604ea (DcmDslProtocolRx):
                  DcmDslProtocolRxAddrType = DCM_PHYSICAL_TYPE
                  DcmDslProtocolRxPduId = 2
                  DcmDslProtocolRxComMChannelRef = ComMConfigSet/CN_DBCNetWork_9ed72b09
                  DcmDslProtocolRxPduRef = Meg_PhyDiag_oDBCNetWork_e154eea6_Rx
                Meg_ResDiag_oDBCNetWork_5467f8e5_Tx_024d51d1 (DcmDslProtocolTx): DcmDslTxConfirmationPduId=0, DcmDslProtocolTxPduRef=EcucPduCollection/Meg_ResDiag_oDBCNetWork_5467f8e5_Tx
      DcmDsp: DcmDspMaxDidToRead=1  # Diagnostics Data Import
        ComControl (DcmDspComControl)  # Diagnostics Data Import
          DspComContolAllChannel (DcmDspComControlAllChannel)  # Diagnostics Data Import
        RoutineInfo_ECU_Check (DcmDspRoutineInfo)  # Diagnostics Data Import
          DcmDspRoutineRequestResOut  # Diagnostics Data Import
            Out_ECU_Check_status (DcmDspRoutineRequestResOutSignal): DcmDspRoutineSignalLength=8, DcmDspRoutineSignalType=UINT8, DcmDspRoutineSignalPos=0  # Diagnostics Data Import
          DcmDspStartRoutineOut  # Diagnostics Data Import
            Out_ECU_Check_is_in_progress (DcmDspStartRoutineOutSignal): DcmDspRoutineSignalLength=8, DcmDspRoutineSignalType=UINT8, DcmDspRoutineSignalPos=0  # Diagnostics Data Import
          DcmDspStartRoutineIn  # Diagnostics Data Import
            In_Start_ECU_Check (DcmDspStartRoutineInSignal): DcmDspRoutineSignalLength=8, DcmDspRoutineSignalType=UINT8, DcmDspRoutineSignalPos=0  # Diagnostics Data Import
          DcmDspRoutineAuthorization  # Diagnostics Data Import
        ECU_Check (DcmDspRoutine):  # Diagnostics Data Import
          DcmDspRequestResultsRoutineSupported = true
          DcmDspStopRoutineSupported = false
          DcmDspRoutineIdentifier = 256
          DcmDspRoutineInfoRef = RoutineInfo_ECU_Check
        DidInfo_Braking (DcmDspDidInfo)  # Diagnostics Data Import
          DcmDspDidAccess  # Diagnostics Data Import
            DcmDspDidRead  # Diagnostics Data Import
        Braking (DcmDspDid): DcmDspDidIdentifier=256, DcmDspDidInfoRef=DidInfo_Braking  # Diagnostics Data Import
          Brake_Pedal (DcmDspDidSignal): DcmDspDidDataPos=0, DcmDspDidDataRef=Braking_Brake_Pedal  # Diagnostics Data Import
        DataInfo_Braking_Brake_Pedal (DcmDspDataInfo): DcmDspDataFixedLength=true  # Diagnostics Data Import
        Braking_Brake_Pedal (DcmDspData): DcmDspDataSize=8, DcmDspDataType=UINT8, DcmDspDataInfoRef=DataInfo_Braking_Brake_Pedal  # Diagnostics Data Import
      DcmDsd  # Diagnostics Data Import
        DcmDsdServiceTable  # Diagnostics Data Import
          8 x DcmDsdService:
            ControlDtcSetting: DcmDsdSidTabServiceId=133, DcmDsdSidTabSubfuncAvail=true  # Diagnostics Data Import
              Disable (DcmDsdSubService): DcmDsdSubServiceId=2  # Diagnostics Data Import
              Enable (DcmDsdSubService): DcmDsdSubServiceId=1  # Diagnostics Data Import
            TesterPresent: DcmDsdSidTabServiceId=62, DcmDsdSidTabSubfuncAvail=true  # Diagnostics Data Import
              TesterPresent (DcmDsdSubService): DcmDsdSubServiceId=0  # Diagnostics Data Import
            RoutineControl: DcmDsdSidTabServiceId=49, DcmDsdSidTabSubfuncAvail=true  # Diagnostics Data Import
            CommunicationControl: DcmDsdSidTabServiceId=40, DcmDsdSidTabSubfuncAvail=true  # Diagnostics Data Import
              EnableRxAndDisableTx (DcmDsdSubService): DcmDsdSubServiceId=1  # Diagnostics Data Import
              EnableRxAndTx (DcmDsdSubService): DcmDsdSubServiceId=0  # Diagnostics Data Import
            ReadDataById: DcmDsdSidTabServiceId=34, DcmDsdSidTabSubfuncAvail=false  # Diagnostics Data Import
            ReadDtcInfo: DcmDsdSidTabServiceId=25, DcmDsdSidTabSubfuncAvail=true  # Diagnostics Data Import
              RNODTCBSM (DcmDsdSubService): DcmDsdSubServiceId=1  # Diagnostics Data Import
              RDTCBSM (DcmDsdSubService): DcmDsdSubServiceId=2  # Diagnostics Data Import
            ClearDiagInfo: DcmDsdSidTabServiceId=20, DcmDsdSidTabSubfuncAvail=false  # Diagnostics Data Import
            EcuReset: DcmDsdSidTabServiceId=17, DcmDsdSidTabSubfuncAvail=true  # Diagnostics Data Import
              Soft (DcmDsdSubService): DcmDsdSubServiceId=3  # Diagnostics Data Import
              Hard (DcmDsdSubService): DcmDsdSubServiceId=1  # Diagnostics Data Import
  module config Dem
    DemGeneral:  # Diagnostics Data Import
      DemAgingCycleCounterProcessing = DEM_PROCESS_AGINGCTR_INTERN
      DemDtcStatusAvailabilityMask = 127
      DemMaxNumberEventEntryMirror = 0
      DemPTOSupport = false
      DemTypeOfFreezeFrameRecordNumeration = DEM_FF_RECNUM_CALCULATED
      PowerCycle (DemOperationCycle): DemOperationCycleType=DEM_OPCYC_POWER  # Diagnostics Data Import
    DemConfigSet  # Diagnostics Data Import
      DTC_0x402011 (DemEventParameter): DemEventKind=DEM_EVENT_KIND_SWC, DemDTCClassRef=DTCClass_DTC_0x402011  # Diagnostics Data Import
        DemEventClass:  # Diagnostics Data Import
          DemEventDestination = DEM_DTC_ORIGIN_PRIMARY_MEMORY
          DemEventSignificance = DEM_EVENT_SIGNIFICANCE_FAULT
          DemAgingCycleRef = PowerCycle
          DemOperationCycleRef = PowerCycle
          DemDebounceAlgorithmClass  # Diagnostics Data Import
            DemDebounceMonitorInternal  # Diagnostics Data Import
              DemCallbackGetFDC  # Diagnostics Data Import
      DTCClass_DTC_0x402011 (DemDTCClass): DemUdsDTC=4202513  # Diagnostics Data Import
  module config EcuC
    EcucPduCollection: PduIdTypeEnum=UINT8, PduLengthTypeEnum=UINT8
      35 x Pdu:
        Ecu_Receive_Msg_oDBCNetWork_Can0_364979cb_Rx: PduLength=8, SysTPduToFrameMappingRef=Ecu_Receive_Msg
        Ecu_Send_Msg_oDBCNetWork_Can0_da1e44e3_Tx: PduLength=8, SysTPduToFrameMappingRef=Ecu_Send_Msg
        Meg_FunDiag_Tp_oDBCNetWork_1b821788_Rx: PduLength=8, SysTPduToFrameMappingRef=Meg_FunDiag_Tp
        Meg_FunDiag_oDBCNetWork_245e23dc_Rx: PduLength=7
        Meg_FunDiag_oDBCNetWork_8501a87a_Rx: PduLength=7
        Meg_NmTx_oDBCNetWork_5d9e34f5_Tx: PduLength=8, SysTPduToFrameMappingRef=Meg_NmTx
        Meg_PhyDiag_Tp_oDBCNetWork_ff3be21a_Rx: PduLength=8, SysTPduToFrameMappingRef=Meg_PhyDiag_Tp
        Meg_PhyDiag_oDBCNetWork_e154eea6_Rx: PduLength=8
        Meg_PhyDiag_oDBCNetWork_e94a8f4d_Rx: PduLength=8
        Meg_ResDiag_Tp_oDBCNetWork_4a610c1c_Tx: PduLength=8, SysTPduToFrameMappingRef=Meg_ResDiag_Tp
        Meg_ResDiag_oDBCNetWork_1336e721_Tx: PduLength=8
        Meg_ResDiag_oDBCNetWork_5467f8e5_Tx: PduLength=8
        Rout_Can0ToCan1_100ms_oDBCNetWork_Can0_6e10546a_Rx: PduLength=8, SysTPduToFrameMappingRef=Rout_Can0ToCan1_100ms
        Rout_Can1ToCan0_100ms_oDBCNetWork_Can0_c34bc869_Tx: PduLength=8, SysTPduToFrameMappingRef=Rout_Can1ToCan0_100ms
        Route_Can0ToCan1_100ms_oDBCNetWork_a9bdfb29_Tx: PduLength=8, SysTPduToFrameMappingRef=Route_Can0ToCan1_100ms
        Route_Can1ToCan0_100ms_oDBCNetWork_44a2d8cc_Rx: PduLength=8, SysTPduToFrameMappingRef=Route_Can1ToCan0_100ms
        SupA_Angle_oDBCNetWork_418b1596_Tx: PduLength=8, SysTPduToFrameMappingRef=SupA_Angle
        SupA_Angle_oDBCNetWork_e5909e4f_Tx: PduLength=8
        SupA_Button_State_oDBCNetWork_390399bb_Tx: PduLength=8
        SupA_Button_State_oDBCNetWork_eea6565b_Tx: PduLength=8, SysTPduToFrameMappingRef=SupA_Button_State
        SupA_Function_1_oDBCNetWork_10b79eb2_Tx: PduLength=8, SysTPduToFrameMappingRef=SupA_Function_1
        SupA_Function_1_oDBCNetWork_312706bd_Tx: PduLength=8
        SupA_Led_State_oDBCNetWork_43576f7c_Tx: PduLength=8
        SupA_Led_State_oDBCNetWork_e7f688d3_Tx: PduLength=8, SysTPduToFrameMappingRef=SupA_Led_State
        SupA_PowerMode_oDBCNetWork_910ccf57_Tx: PduLength=8, SysTPduToFrameMappingRef=SupA_PowerMode
        SupA_PowerMode_oDBCNetWork_b77edafa_Tx: PduLength=8
        SupB_Button_Control_oDBCNetWork_0c40490d_Rx: PduLength=8
        SupB_Button_Control_oDBCNetWork_a24295f7_Rx: PduLength=8, SysTPduToFrameMappingRef=SupB_Button_Control
        SupB_Led_Control_oDBCNetWork_496a3ac6_Rx: PduLength=8, SysTPduToFrameMappingRef=SupB_Led_Control
        SupB_Led_Control_oDBCNetWork_eb16948d_Rx: PduLength=8
        SupC_Function_1_oDBCNetWork_44e7ee76_Rx: PduLength=8, SysTPduToFrameMappingRef=SupC_Function_1
        SupC_Function_1_oDBCNetWork_e81ccab2_Rx: PduLength=8
        SupC_Function_2_oDBCNetWork_1ff05f63_Rx: PduLength=8, SysTPduToFrameMappingRef=SupC_Function_2
        SupC_Function_2_oDBCNetWork_55d6a67c_Rx: PduLength=8
        XB_SUP_A_17ea32c5_Rx: PduLength=8, SysTPduToFrameMappingRef=Meg_NmRx
  module config EcuM
    EcuMConfiguration
      EcuMCommonConfiguration
        EcuMDriverInitListOne
        EcuMDriverRestartList
        CN_DBCNetWork_9ed72b09 (EcuMWakeupSource): EcuMWakeupSourceId=5, EcuMComMChannelRef=ComMConfigSet/CN_DBCNetWork_9ed72b09
        CN_DBCNetWork_Can0_7c554129 (EcuMWakeupSource): EcuMWakeupSourceId=6, EcuMComMChannelRef=ComMConfigSet/CN_DBCNetWork_Can0_7c554129
      EcuMFlexConfiguration: EcuMFlexModuleConfigurationRef=CanConfigSet
  module config Nm
    CN_DBCNetWork_9ed72b09 (NmChannelConfig): NmPassiveModeEnabled=true, NmComMChannelRef=ComMConfigSet/CN_DBCNetWork_9ed72b09
      DBCNetWork_CAN_9b3bc41d (NmBusType)
        NmStandardBusNmConfig: NmStandardBusType=NM_BUSNM_CANNM  # DBCNetWork_CAN
    CN_DBCNetWork_Can0_7c554129 (NmChannelConfig): NmPassiveModeEnabled=true, NmComMChannelRef=ComMConfigSet/CN_DBCNetWork_Can0_7c554129
      DBCNetWork_Can0_CAN_ed723e4d (NmBusType)
        NmStandardBusNmConfig: NmStandardBusType=NM_BUSNM_CANNM  # DBCNetWork_Can0_CAN
    NmGlobalConfig
      NmGlobalFeatures: NmBusSynchronizationEnabled=false, NmNodeIdEnabled=true, NmUserDataEnabled=true
      NmGlobalProperties
  module config PduR
    PduRGeneral
    PduRRoutingTables
      PduRRoutingTable
        12 x PduRRoutingPath:
          Meg_FunDiag_oDBCNetWork_245e23dc_Rx
            Meg_FunDiag_oDBCNetWork_245e23dc_Rx_1af6dabd_Rx (PduRDestPdu): PduRDestPduRef=Meg_FunDiag_oDBCNetWork_8501a87a_Rx
            PduRSrcPdu_1af6dabd (PduRSrcPdu): PduRSrcPduRef=EcucPduCollection/Meg_FunDiag_oDBCNetWork_245e23dc_Rx
          Meg_PhyDiag_oDBCNetWork_e94a8f4d_Rx
            Meg_PhyDiag_oDBCNetWork_e94a8f4d_Rx_49b2840e_Rx (PduRDestPdu): PduRDestPduRef=Meg_PhyDiag_oDBCNetWork_e154eea6_Rx
            PduRSrcPdu_49b2840e (PduRSrcPdu): PduRSrcPduRef=EcucPduCollection/Meg_PhyDiag_oDBCNetWork_e94a8f4d_Rx
          Meg_ResDiag_oDBCNetWork_5467f8e5_Tx
            Meg_ResDiag_oDBCNetWork_1336e721_Tx (PduRDestPdu): PduRDestPduRef=EcucPduCollection/Meg_ResDiag_oDBCNetWork_1336e721_Tx
            PduRSrcPdu_9c32056b (PduRSrcPdu): PduRSrcPduRef=EcucPduCollection/Meg_ResDiag_oDBCNetWork_5467f8e5_Tx
          SupA_Angle_oDBCNetWork_e5909e4f_Tx
            SupA_Angle_oDBCNetWork_418b1596_Tx (PduRDestPdu): PduRDestPduRef=EcucPduCollection/SupA_Angle_oDBCNetWork_418b1596_Tx
            PduRSrcPdu_c6b821a9 (PduRSrcPdu): PduRSrcPduRef=EcucPduCollection/SupA_Angle_oDBCNetWork_e5909e4f_Tx
          SupA_Button_State_oDBCNetWork_390399bb_Tx
            SupA_Button_State_oDBCNetWork_eea6565b_Tx (PduRDestPdu): PduRDestPduRef=EcucPduCollection/SupA_Button_State_oDBCNetWork_eea6565b_Tx
            PduRSrcPdu_ed18513b (PduRSrcPdu): PduRSrcPduRef=EcucPduCollection/SupA_Button_State_oDBCNetWork_390399bb_Tx
          SupA_Function_1_oDBCNetWork_312706bd_Tx
            SupA_Function_1_oDBCNetWork_10b79eb2_Tx (PduRDestPdu): PduRDestPduRef=EcucPduCollection/SupA_Function_1_oDBCNetWork_10b79eb2_Tx
            PduRSrcPdu_045a4163 (PduRSrcPdu): PduRSrcPduRef=EcucPduCollection/SupA_Function_1_oDBCNetWork_312706bd_Tx
          SupA_Led_State_oDBCNetWork_43576f7c_Tx
            SupA_Led_State_oDBCNetWork_e7f688d3_Tx (PduRDestPdu): PduRDestPduRef=EcucPduCollection/SupA_Led_State_oDBCNetWork_e7f688d3_Tx
            PduRSrcPdu_de6a18d2 (PduRSrcPdu): PduRSrcPduRef=EcucPduCollection/SupA_Led_State_oDBCNetWork_43576f7c_Tx
          SupA_PowerMode_oDBCNetWork_b77edafa_Tx
            SupA_PowerMode_oDBCNetWork_910ccf57_Tx (PduRDestPdu): PduRDestPduRef=EcucPduCollection/SupA_PowerMode_oDBCNetWork_910ccf57_Tx
            PduRSrcPdu_a13e3769 (PduRSrcPdu): PduRSrcPduRef=EcucPduCollection/SupA_PowerMode_oDBCNetWork_b77edafa_Tx
          SupB_Button_Control_oDBCNetWork_a24295f7_Rx
            SupB_Button_Control_oDBCNetWork_a24295f7_Rx_f8af96ce_Rx (PduRDestPdu): PduRDestPduRef=EcucPduCollection/SupB_Button_Control_oDBCNetWork_0c40490d_Rx
            PduRSrcPdu_f8af96ce (PduRSrcPdu): PduRSrcPduRef=EcucPduCollection/SupB_Button_Control_oDBCNetWork_a24295f7_Rx
          SupB_Led_Control_oDBCNetWork_496a3ac6_Rx
            SupB_Led_Control_oDBCNetWork_496a3ac6_Rx_495de942_Rx (PduRDestPdu): PduRDestPduRef=EcucPduCollection/SupB_Led_Control_oDBCNetWork_eb16948d_Rx
            PduRSrcPdu_495de942 (PduRSrcPdu): PduRSrcPduRef=EcucPduCollection/SupB_Led_Control_oDBCNetWork_496a3ac6_Rx
          SupC_Function_1_oDBCNetWork_44e7ee76_Rx
            SupC_Function_1_oDBCNetWork_44e7ee76_Rx_10b1802d_Rx (PduRDestPdu): PduRDestPduRef=EcucPduCollection/SupC_Function_1_oDBCNetWork_e81ccab2_Rx
            PduRSrcPdu_10b1802d (PduRSrcPdu): PduRSrcPduRef=EcucPduCollection/SupC_Function_1_oDBCNetWork_44e7ee76_Rx
          SupC_Function_2_oDBCNetWork_1ff05f63_Rx
            SupC_Function_2_oDBCNetWork_1ff05f63_Rx_755dbb0e_Rx (PduRDestPdu): PduRDestPduRef=EcucPduCollection/SupC_Function_2_oDBCNetWork_55d6a67c_Rx
            PduRSrcPdu_755dbb0e (PduRSrcPdu): PduRSrcPduRef=EcucPduCollection/SupC_Function_2_oDBCNetWork_1ff05f63_Rx
