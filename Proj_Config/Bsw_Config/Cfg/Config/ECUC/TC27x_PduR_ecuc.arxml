AUTOSAR XML (schema 00046)
package /ActiveEcuC
  module config PduR: implementation-config-variant=VARIANT-PRE-COMPILE, module-description=PduR_Impl
    PduRGeneral:
      PduRDevErrorDetect = true
      PduRVersionInfoApi = false
      PduRMetaDataSupport = false
      PduRPduCallback = false
      PduRSwitching = false
      PduRSafeBswChecks = false
      PduREnableDeferredTransmission = false
      PduREnableDeferredReception = false
      PduRSupportMulticore = false
      PduRRoutingTypeGateway = true
      PduRGeneration:
        PduROutOfBoundsWriteProtectionStrategy = NONE
        PduROutOfBoundsWriteSanitizer = false
        PduROutOfBoundsReadSanitizer = false
        PduRNumericalDataTypeMinimizationStrategy = WITH_CAST
        PduRReduceConstantData2Define = false
        PduRBoolDataInArrayOfStructStrategy = BITMASKING
        PduRDeduplicateIndirectedData = true
        PduRDataDeduplicationStrategy = WITH_CAST
        PduRReduceBoolDataByNegationThreshold = 2
        PduRReduceBoolDataByNumericalComparisonThreshold = 2
        PduRReduceBoolDataByNumericalRelationThreshold = 2
        PduRReduceBoolDataByNumericalOperandStrategy = WITH_ANY_VALUE
        PduRReduceNumericalDataByOffsetThreshold = 2
        PduRReduceNumericalDataByArraySubtractionThreshold = 2
        PduRReduceDataByStreaming = false
        PduRShortSymbols = false
        PduRInterfacesForDeactivatedData = false
        PduRReferringKeysInComments = false
    PduRRoutingTables: PduRConfigurationId=0
      PduRRoutingTable
        14 x PduRRoutingPath, all with PduRMulticoreRoutingPath=false, PduRLockRef=PduRLock_PduRExclusiveArea:
          Meg_ResDiag_oDBCNetWork_5467f8e5_Tx: PduRRoutingPathCommunicationType=TRANSPORT_PROTOCOL
            Meg_ResDiag_oDBCNetWork_1336e721_Tx (PduRDestPdu):
              PduRDestPduHandleId = 0
              PduRDestPduDirection = TRANSMIT
              PduRDestPduRoutingType = API_FORWARDING
              PduRDestPduDataProcessing = IMMEDIATE
              PduRPduLengthHandlingStrategy = UNUSED
              PduRDestPduRef = Meg_ResDiag_oDBCNetWork_1336e721_Tx
              PduRDestPduPduRBswModulesRef = CanTp
            PduRSrcPdu_9c32056b (PduRSrcPdu): PduRSourcePduHandleId=0, PduRSrcPduDirection=TRANSMIT, PduRSrcPduRef=Meg_ResDiag_oDBCNetWork_5467f8e5_Tx, PduRSrcPduPduRBswModulesRef=Dcm
          Meg_FunDiag_oDBCNetWork_245e23dc_Rx: PduRRoutingPathCommunicationType=TRANSPORT_PROTOCOL
            Meg_FunDiag_oDBCNetWork_245e23dc_Rx_1af6dabd_Rx (PduRDestPdu):
              PduRDestPduHandleId = 0
              PduRDestPduDirection = RECEIVE
              PduRDestPduRoutingType = API_FORWARDING
              PduRDestPduDataProcessing = IMMEDIATE
              PduRPduLengthHandlingStrategy = UNUSED
              PduRDestPduRef = Meg_FunDiag_oDBCNetWork_8501a87a_Rx
              PduRDestPduPduRBswModulesRef = Dcm
            PduRSrcPdu_1af6dabd (PduRSrcPdu): PduRSourcePduHandleId=0, PduRSrcPduDirection=RECEIVE, PduRSrcPduRef=Meg_FunDiag_oDBCNetWork_245e23dc_Rx, PduRSrcPduPduRBswModulesRef=CanTp
          Meg_PhyDiag_oDBCNetWork_e94a8f4d_Rx: PduRRoutingPathCommunicationType=TRANSPORT_PROTOCOL
            Meg_PhyDiag_oDBCNetWork_e94a8f4d_Rx_49b2840e_Rx (PduRDestPdu):
              PduRDestPduHandleId = 1
              PduRDestPduDirection = RECEIVE
              PduRDestPduRoutingType = API_FORWARDING
              PduRDestPduDataProcessing = IMMEDIATE
              PduRPduLengthHandlingStrategy = UNUSED
              PduRDestPduRef = Meg_PhyDiag_oDBCNetWork_e154eea6_Rx
              PduRDestPduPduRBswModulesRef = Dcm
            PduRSrcPdu_49b2840e (PduRSrcPdu): PduRSourcePduHandleId=1, PduRSrcPduDirection=RECEIVE, PduRSrcPduRef=Meg_PhyDiag_oDBCNetWork_e94a8f4d_Rx, PduRSrcPduPduRBswModulesRef=CanTp
          SupB_Button_Control_oDBCNetWork_a24295f7_Rx: PduRRoutingPathCommunicationType=COMMUNICATION_INTERFACE
            PduRSrcPdu_f8af96ce (PduRSrcPdu): PduRSourcePduHandleId=2, PduRSrcPduDirection=RECEIVE, PduRSrcPduRef=SupB_Button_Control_oDBCNetWork_a24295f7_Rx, PduRSrcPduPduRBswModulesRef=CanIf
            SupB_Button_Control_oDBCNetWork_a24295f7_Rx_f8af96ce_Rx (PduRDestPdu):
              PduRDestPduHandleId = 0
              PduRDestPduDirection = RECEIVE
              PduRDestPduRoutingType = API_FORWARDING
              PduRDestPduDataProcessing = IMMEDIATE
              PduRPduLengthHandlingStrategy = UNUSED
              PduRTransmissionConfirmation = false
              PduRDestPduRef = SupB_Button_Control_oDBCNetWork_0c40490d_Rx
              PduRDestPduPduRBswModulesRef = Com
          SupA_Button_State_oDBCNetWork_390399bb_Tx: PduRRoutingPathCommunicationType=COMMUNICATION_INTERFACE
            SupA_Button_State_oDBCNetWork_eea6565b_Tx (PduRDestPdu):
              PduRDestPduHandleId = 3
              PduRDestPduDirection = TRANSMIT
              PduRDestPduRoutingType = API_FORWARDING
              PduRDestPduDataProcessing = IMMEDIATE
              PduRPduLengthHandlingStrategy = UNUSED
              PduRDestPduDataProvision = PDUR_DIRECT
              PduRTransmissionConfirmation = true
              PduRDestPduRef = SupA_Button_State_oDBCNetWork_eea6565b_Tx
              PduRDestPduPduRBswModulesRef = CanIf
            PduRSrcPdu_ed18513b (PduRSrcPdu): PduRSourcePduHandleId=2, PduRSrcPduDirection=TRANSMIT, PduRSrcPduRef=SupA_Button_State_oDBCNetWork_390399bb_Tx, PduRSrcPduPduRBswModulesRef=Com
          SupA_Angle_oDBCNetWork_e5909e4f_Tx: PduRRoutingPathCommunicationType=COMMUNICATION_INTERFACE
            SupA_Angle_oDBCNetWork_418b1596_Tx (PduRDestPdu):
              PduRDestPduHandleId = 2
              PduRDestPduDirection = TRANSMIT
              PduRDestPduRoutingType = API_FORWARDING
              PduRDestPduDataProcessing = IMMEDIATE
              PduRPduLengthHandlingStrategy = UNUSED
              PduRDestPduDataProvision = PDUR_DIRECT
              PduRTransmissionConfirmation = true
              PduRDestPduRef = SupA_Angle_oDBCNetWork_418b1596_Tx
              PduRDestPduPduRBswModulesRef = CanIf
            PduRSrcPdu_c6b821a9 (PduRSrcPdu): PduRSourcePduHandleId=1, PduRSrcPduDirection=TRANSMIT, PduRSrcPduRef=SupA_Angle_oDBCNetWork_e5909e4f_Tx, PduRSrcPduPduRBswModulesRef=Com
          SupC_Function_2_oDBCNetWork_1ff05f63_Rx: PduRRoutingPathCommunicationType=COMMUNICATION_INTERFACE
            SupC_Function_2_oDBCNetWork_1ff05f63_Rx_755dbb0e_Rx (PduRDestPdu):
              PduRDestPduHandleId = 3
              PduRDestPduDirection = RECEIVE
              PduRDestPduRoutingType = API_FORWARDING
              PduRDestPduDataProcessing = IMMEDIATE
              PduRPduLengthHandlingStrategy = UNUSED
              PduRTransmissionConfirmation = false
              PduRDestPduRef = SupC_Function_2_oDBCNetWork_55d6a67c_Rx
              PduRDestPduPduRBswModulesRef = Com
            PduRSrcPdu_755dbb0e (PduRSrcPdu): PduRSourcePduHandleId=5, PduRSrcPduDirection=RECEIVE, PduRSrcPduRef=SupC_Function_2_oDBCNetWork_1ff05f63_Rx, PduRSrcPduPduRBswModulesRef=CanIf
          SupA_PowerMode_oDBCNetWork_b77edafa_Tx: PduRRoutingPathCommunicationType=COMMUNICATION_INTERFACE
            SupA_PowerMode_oDBCNetWork_910ccf57_Tx (PduRDestPdu):
              PduRDestPduHandleId = 6
              PduRDestPduDirection = TRANSMIT
              PduRDestPduRoutingType = API_FORWARDING
              PduRDestPduDataProcessing = IMMEDIATE
              PduRPduLengthHandlingStrategy = UNUSED
              PduRDestPduDataProvision = PDUR_DIRECT
              PduRTransmissionConfirmation = true
              PduRDestPduRef = SupA_PowerMode_oDBCNetWork_910ccf57_Tx
              PduRDestPduPduRBswModulesRef = CanIf
            PduRSrcPdu_a13e3769 (PduRSrcPdu): PduRSourcePduHandleId=5, PduRSrcPduDirection=TRANSMIT, PduRSrcPduRef=SupA_PowerMode_oDBCNetWork_b77edafa_Tx, PduRSrcPduPduRBswModulesRef=Com
          SupC_Function_1_oDBCNetWork_44e7ee76_Rx: PduRRoutingPathCommunicationType=COMMUNICATION_INTERFACE
            PduRSrcPdu_10b1802d (PduRSrcPdu): PduRSourcePduHandleId=4, PduRSrcPduDirection=RECEIVE, PduRSrcPduRef=SupC_Function_1_oDBCNetWork_44e7ee76_Rx, PduRSrcPduPduRBswModulesRef=CanIf
            SupC_Function_1_oDBCNetWork_44e7ee76_Rx_10b1802d_Rx (PduRDestPdu):
              PduRDestPduHandleId = 2
              PduRDestPduDirection = RECEIVE
              PduRDestPduRoutingType = API_FORWARDING
              PduRDestPduDataProcessing = IMMEDIATE
              PduRPduLengthHandlingStrategy = UNUSED
              PduRTransmissionConfirmation = false
              PduRDestPduRef = SupC_Function_1_oDBCNetWork_e81ccab2_Rx
              PduRDestPduPduRBswModulesRef = Com
          SupA_Function_1_oDBCNetWork_312706bd_Tx: PduRRoutingPathCommunicationType=COMMUNICATION_INTERFACE
            PduRSrcPdu_045a4163 (PduRSrcPdu): PduRSourcePduHandleId=3, PduRSrcPduDirection=TRANSMIT, PduRSrcPduRef=SupA_Function_1_oDBCNetWork_312706bd_Tx, PduRSrcPduPduRBswModulesRef=Com
            SupA_Function_1_oDBCNetWork_10b79eb2_Tx (PduRDestPdu):
              PduRDestPduHandleId = 4
              PduRDestPduDirection = TRANSMIT
              PduRDestPduRoutingType = API_FORWARDING
              PduRDestPduDataProcessing = IMMEDIATE
              PduRPduLengthHandlingStrategy = UNUSED
              PduRDestPduDataProvision = PDUR_DIRECT
              PduRTransmissionConfirmation = true
              PduRDestPduRef = SupA_Function_1_oDBCNetWork_10b79eb2_Tx
              PduRDestPduPduRBswModulesRef = CanIf
          SupB_Led_Control_oDBCNetWork_496a3ac6_Rx: PduRRoutingPathCommunicationType=COMMUNICATION_INTERFACE
            SupB_Led_Control_oDBCNetWork_496a3ac6_Rx_495de942_Rx (PduRDestPdu):
              PduRDestPduHandleId = 1
              PduRDestPduDirection = RECEIVE
              PduRDestPduRoutingType = API_FORWARDING
              PduRDestPduDataProcessing = IMMEDIATE
              PduRPduLengthHandlingStrategy = UNUSED
              PduRTransmissionConfirmation = false
              PduRDestPduRef = SupB_Led_Control_oDBCNetWork_eb16948d_Rx
              PduRDestPduPduRBswModulesRef = Com
            PduRSrcPdu_495de942 (PduRSrcPdu): PduRSourcePduHandleId=3, PduRSrcPduDirection=RECEIVE, PduRSrcPduRef=SupB_Led_Control_oDBCNetWork_496a3ac6_Rx, PduRSrcPduPduRBswModulesRef=CanIf
          SupA_Led_State_oDBCNetWork_43576f7c_Tx: PduRRoutingPathCommunicationType=COMMUNICATION_INTERFACE
            PduRSrcPdu_de6a18d2 (PduRSrcPdu): PduRSourcePduHandleId=4, PduRSrcPduDirection=TRANSMIT, PduRSrcPduRef=SupA_Led_State_oDBCNetWork_43576f7c_Tx, PduRSrcPduPduRBswModulesRef=Com
            SupA_Led_State_oDBCNetWork_e7f688d3_Tx (PduRDestPdu):
              PduRDestPduHandleId = 5
              PduRDestPduDirection = TRANSMIT
              PduRDestPduRoutingType = API_FORWARDING
              PduRDestPduDataProcessing = IMMEDIATE
              PduRPduLengthHandlingStrategy = UNUSED
              PduRDestPduDataProvision = PDUR_DIRECT
              PduRTransmissionConfirmation = true
              PduRDestPduRef = SupA_Led_State_oDBCNetWork_e7f688d3_Tx
              PduRDestPduPduRBswModulesRef = CanIf
          Can1ToCan0_PduR: PduRRoutingPathCommunicationType=COMMUNICATION_INTERFACE
            PduRDestPdu:
              PduRDestPduHandleId = 0
              PduRDestPduDirection = TRANSMIT
              PduRDestPduRoutingType = GATEWAY_ROUTING
              PduRDestPduDataProcessing = IMMEDIATE
              PduRPduLengthHandlingStrategy = UNUSED
              PduRDestPduDataProvision = PDUR_DIRECT
              PduRTransmissionConfirmation = false
              PduRDestPduRef = Rout_Can1ToCan0_100ms_oDBCNetWork_Can0_c34bc869_Tx
              PduRDestPduPduRBswModulesRef = CanIf
            PduRSrcPdu:
              PduRSourcePduHandleId = 1
              PduRSrcPduDirection = RECEIVE
              PduRSrcPduRef = Route_Can1ToCan0_100ms_oDBCNetWork_44a2d8cc_Rx
              PduRSrcPduPduRBswModulesRef = CanIf
          Can0ToCan1_PduR: PduRRoutingPathCommunicationType=COMMUNICATION_INTERFACE
            PduRDestPdu_1 (PduRDestPdu):
              PduRDestPduHandleId = 1
              PduRDestPduDirection = TRANSMIT
              PduRDestPduRoutingType = GATEWAY_ROUTING
              PduRDestPduDataProcessing = IMMEDIATE
              PduRPduLengthHandlingStrategy = UNUSED
              PduRDestPduDataProvision = PDUR_DIRECT
              PduRTransmissionConfirmation = false
              PduRDestPduRef = Route_Can0ToCan1_100ms_oDBCNetWork_a9bdfb29_Tx
              PduRDestPduPduRBswModulesRef = CanIf
            PduRSrcPdu_1 (PduRSrcPdu):
              PduRSourcePduHandleId = 0
              PduRSrcPduDirection = RECEIVE
              PduRSrcPduRef = Rout_Can0ToCan1_100ms_oDBCNetWork_Can0_6e10546a_Rx
              PduRSrcPduPduRBswModulesRef = CanIf
      PduRLock_PduRExclusiveArea (PduRLock)
        PduRExclusiveArea: PduRExclusiveAreaId=0
    4 x PduRBswModules, all with PduRCancelReceive=false, PduRCancelTransmit=false, PduRChangeParameterRequestApi=false, PduRTriggertransmit=false:
      CanIf: PduRCommunicationInterface=true, PduRLowerModule=true, PduRTransportProtocol=false, PduRTxConfirmation=true, PduRUpperModule=false, PduRUseTag=false, PduRBswModuleRef=CanIf
      CanTp: PduRCommunicationInterface=false, PduRLowerModule=true, PduRTransportProtocol=true, PduRTxConfirmation=false, PduRUpperModule=false, PduRUseTag=false, PduRBswModuleRef=CanTp
      Com: PduRCommunicationInterface=true, PduRLowerModule=false, PduRTransportProtocol=false, PduRTxConfirmation=true, PduRUpperModule=true, PduRUseTag=false, PduRBswModuleRef=Com
      Dcm: PduRCommunicationInterface=false, PduRLowerModule=false, PduRTransportProtocol=true, PduRTxConfirmation=false, PduRUpperModule=true, PduRUseTag=true, PduRBswModuleRef=Dcm
