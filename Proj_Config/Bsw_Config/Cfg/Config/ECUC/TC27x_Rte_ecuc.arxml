AUTOSAR XML (schema 00046)
package /ActiveEcuC
  module config Rte: implementation-config-variant=VARIANT-PRE-COMPILE, module-description=Rte_Impl
    RteInitializationBehavior: RteInitializationStrategy=RTE_INITIALIZATION_STRATEGY_AT_DATA_DECLARATION, RteSectionInitializationPolicy=INIT
    RteGeneration:
      RteGenerationMode = COMPATIBILITY_MODE
      RteIocInteractionReturnValue = RTE_IOC
      RteValueRangeCheckEnabled = false
      RteCalibrationSupport = NONE
      RteCodeVendorId = 30
      RteDevErrorDetect = false
      RteDevErrorDetectUninit = false
      RteMeasurementSupport = false
      RteOptimizationMode = MEMORY
      RteVfbTraceEnabled = false
    RteBswGeneral: RteSchMVersionInfoApi=false, RteUseComShadowSignalApi=false
    RteOsInteraction
      8 x RteUsedOsActivation, all with RteExpectedActivationOffset=0, RteExpectedTickDuration=0:
        Rte_Al_TE2_EcuM_EcuM_MainFunction: RteActivationOsAlarmRef=Rte_Al_TE2_EcuM_EcuM_MainFunction, RteActivationOsTaskRef=OsTask_App10ms_Core1
        Rte_Al_TE_OsTask_App10ms_Core0_0_10ms: RteActivationOsAlarmRef=Rte_Al_TE_OsTask_App10ms_Core0_0_10ms, RteActivationOsTaskRef=OsTask_App10ms_Core0
        Rte_Al_TE2_OsTask_App10ms_Core2_0_5ms: RteActivationOsAlarmRef=Rte_Al_TE2_OsTask_App10ms_Core2_0_5ms, RteActivationOsTaskRef=OsTask_App10ms_Core2
        Rte_Al_TE2_OsTask_Bsw5ms_Core0_0_5ms: RteActivationOsAlarmRef=Rte_Al_TE2_OsTask_Bsw5ms_Core0_0_5ms, RteActivationOsTaskRef=OsTask_Bsw5ms_Core0
        Rte_Al_TE_AppCtrl1_AppCtrl1_MainFuntion: RteActivationOsAlarmRef=Rte_Al_TE_AppCtrl1_AppCtrl1_MainFuntion, RteActivationOsTaskRef=OsTask_App10ms_Core1
        Rte_Al_TE_AppCtrl2_AppCtrl2_MainFunction: RteActivationOsAlarmRef=Rte_Al_TE_AppCtrl2_AppCtrl2_MainFunction, RteActivationOsTaskRef=OsTask_App10ms_Core2
        Rte_Al_TE_IoHwAb_IoHwAb_IoHwAbRunnable: RteActivationOsAlarmRef=Rte_Al_TE_IoHwAb_IoHwAb_IoHwAbRunnable, RteActivationOsTaskRef=OsTask_Bsw5ms_Core0
        Rte_Al_TE2_OsTask_Bsw5ms_Core0_0_20ms: RteActivationOsAlarmRef=Rte_Al_TE2_OsTask_Bsw5ms_Core0_0_20ms, RteActivationOsTaskRef=OsTask_Bsw5ms_Core0
    12 x RteBswModuleInstance:
      BswM: RteBswImplementationRef=BswM_Impl, RteBswModuleConfigurationRef=BswM
        BSWM_EXCLUSIVE_AREA_0 (RteBswExclusiveAreaImpl): RteExclusiveAreaImplMechanism=ALL_INTERRUPT_BLOCKING, RteBswExclusiveAreaRef=BSWM_EXCLUSIVE_AREA_0
        BswM_MainFunctionTimingEvent0 (RteBswEventToTaskMapping):
          RteBswImmediateRestart = false
          RteBswPositionInTask = 0
          RteBswEventRef = BswM_MainFunctionTimingEvent0
          RteBswMappedToTaskRef = OsTask_Bsw5ms_Core0
          RteBswUsedOsAlarmRef = Rte_Al_TE2_OsTask_Bsw5ms_Core0_0_5ms
          RteBswUsedOsEventRef = Rte_Ev_Cyclic2_OsTask_Bsw5ms_Core0_0_5ms
      Can: RteBswImplementationRef=Can_Impl, RteBswModuleConfigurationRef=Can
        Can_MainFunction_WakeupTimingEvent0 (RteBswEventToTaskMapping):
          RteBswImmediateRestart = false
          RteBswPositionInTask = 6
          RteBswEventRef = Can_MainFunction_WakeupTimingEvent0
          RteBswMappedToTaskRef = OsTask_Bsw5ms_Core0
          RteBswUsedOsAlarmRef = Rte_Al_TE2_OsTask_Bsw5ms_Core0_0_5ms
          RteBswUsedOsEventRef = Rte_Ev_Cyclic2_OsTask_Bsw5ms_Core0_0_5ms
        Can_MainFunction_ModeTimingEvent0 (RteBswEventToTaskMapping):
          RteBswImmediateRestart = false
          RteBswPositionInTask = 5
          RteBswEventRef = Can_MainFunction_ModeTimingEvent0
          RteBswMappedToTaskRef = OsTask_Bsw5ms_Core0
          RteBswUsedOsAlarmRef = Rte_Al_TE2_OsTask_Bsw5ms_Core0_0_5ms
          RteBswUsedOsEventRef = Rte_Ev_Cyclic2_OsTask_Bsw5ms_Core0_0_5ms
        8 x RteBswExclusiveAreaImpl, all with RteExclusiveAreaImplMechanism=ALL_INTERRUPT_BLOCKING:
          CAN_EXCLUSIVE_AREA_{0..7}: RteBswExclusiveAreaRef=CAN_EXCLUSIVE_AREA_{0..7}
        Can_MainFunction_BusOffTimingEvent0 (RteBswEventToTaskMapping): RteBswImmediateRestart=false, RteBswEventRef=Can_MainFunction_BusOffTimingEvent0
      CanIf: RteBswImplementationRef=CanIf_Impl, RteBswModuleConfigurationRef=CanIf
        8 x RteBswExclusiveAreaImpl, all with RteExclusiveAreaImplMechanism=ALL_INTERRUPT_BLOCKING:
          CANIF_EXCLUSIVE_AREA_{0..7}: RteBswExclusiveAreaRef=CANIF_EXCLUSIVE_AREA_{0..7}
      CanNm: RteBswImplementationRef=CanNm_Impl, RteBswModuleConfigurationRef=CanNm
        CanNm_MainFunctionTimingEvent0 (RteBswEventToTaskMapping):
          RteBswImmediateRestart = false
          RteBswPositionInTask = 7
          RteBswEventRef = CanNm_MainFunctionTimingEvent0
          RteBswMappedToTaskRef = OsTask_Bsw5ms_Core0
          RteBswUsedOsAlarmRef = Rte_Al_TE2_OsTask_Bsw5ms_Core0_0_5ms
          RteBswUsedOsEventRef = Rte_Ev_Cyclic2_OsTask_Bsw5ms_Core0_0_5ms
        7 x RteBswExclusiveAreaImpl, all with RteExclusiveAreaImplMechanism=ALL_INTERRUPT_BLOCKING:
          CANNM_EXCLUSIVE_AREA_{0..6}: RteBswExclusiveAreaRef=CANNM_EXCLUSIVE_AREA_{0..6}
      CanSM: RteBswImplementationRef=CanSM_Impl, RteBswModuleConfigurationRef=CanSM
        CanSM_MainFunctionTimingEvent0 (RteBswEventToTaskMapping):
          RteBswImmediateRestart = false
          RteBswPositionInTask = 8
          RteBswEventRef = CanSM_MainFunctionTimingEvent0
          RteBswMappedToTaskRef = OsTask_Bsw5ms_Core0
          RteBswUsedOsAlarmRef = Rte_Al_TE2_OsTask_Bsw5ms_Core0_0_5ms
          RteBswUsedOsEventRef = Rte_Ev_Cyclic2_OsTask_Bsw5ms_Core0_0_5ms
        6 x RteBswExclusiveAreaImpl, all with RteExclusiveAreaImplMechanism=ALL_INTERRUPT_BLOCKING:
          CANSM_EXCLUSIVE_AREA_{1..6}: RteBswExclusiveAreaRef=CANSM_EXCLUSIVE_AREA_{1..6}
      Com: RteBswImplementationRef=Com_Impl, RteBswModuleConfigurationRef=Com
        Com_MainFunctionTxTimingEvent0 (RteBswEventToTaskMapping):
          RteBswImmediateRestart = false
          RteBswPositionInTask = 11
          RteBswEventRef = Com_MainFunctionTxTimingEvent0
          RteBswMappedToTaskRef = OsTask_Bsw5ms_Core0
          RteBswUsedOsAlarmRef = Rte_Al_TE2_OsTask_Bsw5ms_Core0_0_5ms
          RteBswUsedOsEventRef = Rte_Ev_Cyclic2_OsTask_Bsw5ms_Core0_0_5ms
        Com_MainFunctionRxTimingEvent0 (RteBswEventToTaskMapping):
          RteBswImmediateRestart = false
          RteBswPositionInTask = 10
          RteBswEventRef = Com_MainFunctionRxTimingEvent0
          RteBswMappedToTaskRef = OsTask_Bsw5ms_Core0
          RteBswUsedOsAlarmRef = Rte_Al_TE2_OsTask_Bsw5ms_Core0_0_5ms
          RteBswUsedOsEventRef = Rte_Ev_Cyclic2_OsTask_Bsw5ms_Core0_0_5ms
        3 x RteBswExclusiveAreaImpl, all with RteExclusiveAreaImplMechanism=ALL_INTERRUPT_BLOCKING:
          COM_EXCLUSIVE_AREA_TX: RteBswExclusiveAreaRef=COM_EXCLUSIVE_AREA_TX
          COM_EXCLUSIVE_AREA_RX: RteBswExclusiveAreaRef=COM_EXCLUSIVE_AREA_RX
          COM_EXCLUSIVE_AREA_BOTH: RteBswExclusiveAreaRef=COM_EXCLUSIVE_AREA_BOTH
      ComM: RteBswImplementationRef=ComM_Impl, RteBswModuleConfigurationRef=ComM
        ComM_MainFunction_0TimingEvent0 (RteBswEventToTaskMapping):
          RteBswImmediateRestart = false
          RteBswPositionInTask = 3
          RteBswEventRef = ComM_MainFunction_0TimingEvent0
          RteBswMappedToTaskRef = OsTask_Bsw5ms_Core0
          RteBswUsedOsAlarmRef = Rte_Al_TE2_OsTask_Bsw5ms_Core0_0_5ms
          RteBswUsedOsEventRef = Rte_Ev_Cyclic2_OsTask_Bsw5ms_Core0_0_5ms
        COMM_EXCLUSIVE_AREA_0 (RteBswExclusiveAreaImpl): RteExclusiveAreaImplMechanism=ALL_INTERRUPT_BLOCKING, RteBswExclusiveAreaRef=COMM_EXCLUSIVE_AREA_0
        COMM_EXCLUSIVE_AREA_1 (RteBswExclusiveAreaImpl): RteExclusiveAreaImplMechanism=ALL_INTERRUPT_BLOCKING, RteBswExclusiveAreaRef=COMM_EXCLUSIVE_AREA_1
        ComM_MainFunction_1TimingEvent0 (RteBswEventToTaskMapping):
          RteBswImmediateRestart = false
          RteBswPositionInTask = 4
          RteBswEventRef = ComM_MainFunction_1TimingEvent0
          RteBswMappedToTaskRef = OsTask_Bsw5ms_Core0
          RteBswUsedOsEventRef = Rte_Ev_Cyclic2_OsTask_Bsw5ms_Core0_0_20ms
          RteBswUsedOsAlarmRef = Rte_Al_TE2_OsTask_Bsw5ms_Core0_0_20ms
      Det: RteBswImplementationRef=Det_Impl, RteBswModuleConfigurationRef=Det
        DET_EXCLUSIVE_AREA_0 (RteBswExclusiveAreaImpl): RteExclusiveAreaImplMechanism=ALL_INTERRUPT_BLOCKING, RteBswExclusiveAreaRef=DET_EXCLUSIVE_AREA_0
      EcuM: RteBswImplementationRef=EcuM_Impl, RteBswModuleConfigurationRef=EcuM
        EcuM_MainFunctionTimingEvent0 (RteBswEventToTaskMapping):
          RteBswImmediateRestart = false
          RteBswPositionInTask = 1
          RteBswEventRef = EcuM_MainFunctionTimingEvent0
          RteBswMappedToTaskRef = OsTask_Bsw5ms_Core0
          RteBswUsedOsAlarmRef = Rte_Al_TE2_OsTask_Bsw5ms_Core0_0_5ms
          RteBswUsedOsEventRef = Rte_Ev_Cyclic2_OsTask_Bsw5ms_Core0_0_5ms
        3 x RteBswExclusiveAreaImpl, all with RteExclusiveAreaImplMechanism=ALL_INTERRUPT_BLOCKING:
          ECUM_EXCLUSIVE_AREA_{0..2}: RteBswExclusiveAreaRef=ECUM_EXCLUSIVE_AREA_{0..2}
        EcuM_MainFunctionTimingEvent1 (RteBswEventToTaskMapping):
          RteBswImmediateRestart = false
          RteBswPositionInTask = 1
          RteBswEventRef = EcuM_MainFunctionTimingEvent1
          RteBswMappedToTaskRef = OsTask_App10ms_Core1
          RteBswUsedOsEventRef = Rte_Ev_RunS2_EcuM_EcuM_MainFunction
          RteBswUsedOsAlarmRef = Rte_Al_TE2_EcuM_EcuM_MainFunction
        EcuM_MainFunctionTimingEvent2 (RteBswEventToTaskMapping):
          RteBswImmediateRestart = false
          RteBswPositionInTask = 1
          RteBswEventRef = EcuM_MainFunctionTimingEvent2
          RteBswMappedToTaskRef = OsTask_App10ms_Core2
          RteBswUsedOsEventRef = Rte_Ev_Cyclic2_OsTask_App10ms_Core2_0_5ms
          RteBswUsedOsAlarmRef = Rte_Al_TE2_OsTask_App10ms_Core2_0_5ms
      Nm: RteBswImplementationRef=Nm_Impl, RteBswModuleConfigurationRef=Nm
        NM_EXCLUSIVE_AREA_0 (RteBswExclusiveAreaImpl): RteExclusiveAreaImplMechanism=ALL_INTERRUPT_BLOCKING, RteBswExclusiveAreaRef=NM_EXCLUSIVE_AREA_0
        NM_EXCLUSIVE_AREA_1 (RteBswExclusiveAreaImpl): RteExclusiveAreaImplMechanism=ALL_INTERRUPT_BLOCKING, RteBswExclusiveAreaRef=NM_EXCLUSIVE_AREA_1
      PduR: RteBswImplementationRef=PduR_Impl, RteBswModuleConfigurationRef=PduR
        PDUR_EXCLUSIVE_AREA_0 (RteBswExclusiveAreaImpl): RteExclusiveAreaImplMechanism=ALL_INTERRUPT_BLOCKING, RteBswExclusiveAreaRef=PDUR_EXCLUSIVE_AREA_0
      Rte: RteBswImplementationRef=Rte_Impl, RteBswModuleConfigurationRef=Rte
        Rte_ComSendSignalProxyPeriodicTimingEvent0 (RteBswEventToTaskMapping): RteBswImmediateRestart=false, RteBswEventRef=Rte_ComSendSignalProxyPeriodicTimingEvent0
    8 x RteSwComponentInstance:
      EcuM_EcuSwComposition: RteSoftwareComponentInstanceRef=EcuM
        8 x RteEventToTaskMapping, all with RteImmediateRestart=false:
          Timer_EcuM_MainFunction: RtePositionInTask=1, RteEventRef=Timer_EcuM_MainFunction, RteMappedToTaskRef=OsTask_App10ms_Core2, RteUsedOsEventRef=Rte_Ev_Cyclic2_OsTask_App10ms_Core2_0_5ms, RteUsedOsAlarmRef=Rte_Al_TE2_OsTask_App10ms_Core2_0_5ms
          OpEventSelectShutdownTarget_SelectShutdownTarget_EcuM_ShutdownTarget: RteEventRef=OpEventSelectShutdownTarget_SelectShutdownTarget_EcuM_ShutdownTarget
          OpEventGetShutdownTarget_GetShutdownTarget_EcuM_ShutdownTarget: RteEventRef=OpEventGetShutdownTarget_GetShutdownTarget_EcuM_ShutdownTarget
          OpEventGetLastShutdownTarget_GetLastShutdownTarget_EcuM_ShutdownTarget: RteEventRef=OpEventGetLastShutdownTarget_GetLastShutdownTarget_EcuM_ShutdownTarget
          OpEventSelectShutdownCause_SelectShutdownCause_EcuM_ShutdownTarget: RteEventRef=OpEventSelectShutdownCause_SelectShutdownCause_EcuM_ShutdownTarget
          OpEventGetShutdownCause_GetShutdownCause_EcuM_ShutdownTarget: RteEventRef=OpEventGetShutdownCause_GetShutdownCause_EcuM_ShutdownTarget
          OpEventSelectBootTarget_SelectBootTarget_EcuM_BootTarget: RteEventRef=OpEventSelectBootTarget_SelectBootTarget_EcuM_BootTarget
          OpEventGetBootTarget_GetBootTarget_EcuM_BootTarget: RteEventRef=OpEventGetBootTarget_GetBootTarget_EcuM_BootTarget
      Det_EcuSwComposition: RteSoftwareComponentInstanceRef=Det
        OpEventReportError_ReportError_DetModule (RteEventToTaskMapping): RteImmediateRestart=false, RtePositionInTask=16, RteEventRef=OpEventReportError_ReportError_DetModule, RteMappedToTaskRef=OsTask_Bsw5ms_Core0
      ComM_EcuSwComposition: RteSoftwareComponentInstanceRef=ComM
        22 x RteEventToTaskMapping, all with RteImmediateRestart=false:
          Timer_ComM_MainFunction_0: RtePositionInTask=3, RteEventRef=Timer_ComM_MainFunction_0, RteMappedToTaskRef=OsTask_Bsw5ms_Core0, RteUsedOsAlarmRef=Rte_Al_TE2_OsTask_Bsw5ms_Core0_0_5ms, RteUsedOsEventRef=Rte_Ev_Cyclic2_OsTask_Bsw5ms_Core0_0_5ms
          OpEventLimitECUToNoComMode_LimitECUToNoComMode_modeLimitation: RteEventRef=OpEventLimitECUToNoComMode_LimitECUToNoComMode_modeLimitation
          OpEventReadInhibitCounter_ReadInhibitCounter_modeLimitation: RteEventRef=OpEventReadInhibitCounter_ReadInhibitCounter_modeLimitation
          OpEventResetInhibitCounter_ResetInhibitCounter_modeLimitation: RteEventRef=OpEventResetInhibitCounter_ResetInhibitCounter_modeLimitation
          OpEventSetECUGroupClassification_SetECUGroupClassification_modeLimitation: RteEventRef=OpEventSetECUGroupClassification_SetECUGroupClassification_modeLimitation
          OpEventGetInhibitionStatus_GetInhibitionStatus_CL_CN_DBCNetWork_9ed72b09: RteEventRef=OpEventGetInhibitionStatus_GetInhibitionStatus_CL_CN_DBCNetWork_9ed72b09
          OpEventPreventWakeUp_PreventWakeUp_CW_CN_DBCNetWork_9ed72b09: RteEventRef=OpEventPreventWakeUp_PreventWakeUp_CW_CN_DBCNetWork_9ed72b09
          OpEventGetCurrentComMode_GetCurrentComMode_UR_CN_DBCNetWork_c855c7bf: RteEventRef=OpEventGetCurrentComMode_GetCurrentComMode_UR_CN_DBCNetWork_c855c7bf
          OpEventGetRequestedComMode_GetRequestedComMode_UR_CN_DBCNetWork_c855c7bf: RteEventRef=OpEventGetRequestedComMode_GetRequestedComMode_UR_CN_DBCNetWork_c855c7bf
          OpEventGetMaxComMode_GetMaxComMode_UR_CN_DBCNetWork_c855c7bf: RteEventRef=OpEventGetMaxComMode_GetMaxComMode_UR_CN_DBCNetWork_c855c7bf
          OpEventGetInhibitionStatus_GetInhibitionStatus_CW_CN_DBCNetWork_9ed72b09: RteEventRef=OpEventGetInhibitionStatus_GetInhibitionStatus_CW_CN_DBCNetWork_9ed72b09
          OpEventLimitChannelToNoComMode_LimitChannelToNoComMode_CL_CN_DBCNetWork_9ed72b09: RteEventRef=OpEventLimitChannelToNoComMode_LimitChannelToNoComMode_CL_CN_DBCNetWork_9ed72b09
          OpEventRequestComMode_RequestComMode_UR_CN_DBCNetWork_c855c7bf: RteEventRef=OpEventRequestComMode_RequestComMode_UR_CN_DBCNetWork_c855c7bf
          OpEventGetRequestedComMode_GetRequestedComMode_UR_CN_DBCNetWork_Can0_4f8ab83d: RteEventRef=OpEventGetRequestedComMode_GetRequestedComMode_UR_CN_DBCNetWork_Can0_4f8ab83d
          OpEventGetMaxComMode_GetMaxComMode_UR_CN_DBCNetWork_Can0_4f8ab83d: RteEventRef=OpEventGetMaxComMode_GetMaxComMode_UR_CN_DBCNetWork_Can0_4f8ab83d
          Timer_ComM_MainFunction_1: RtePositionInTask=4, RteEventRef=Timer_ComM_MainFunction_1, RteMappedToTaskRef=OsTask_Bsw5ms_Core0, RteUsedOsEventRef=Rte_Ev_Cyclic2_OsTask_Bsw5ms_Core0_0_20ms, RteUsedOsAlarmRef=Rte_Al_TE2_OsTask_Bsw5ms_Core0_0_20ms
          OpEventPreventWakeUp_PreventWakeUp_CW_CN_DBCNetWork_Can0_7c554129: RteEventRef=OpEventPreventWakeUp_PreventWakeUp_CW_CN_DBCNetWork_Can0_7c554129
          OpEventLimitChannelToNoComMode_LimitChannelToNoComMode_CL_CN_DBCNetWork_Can0_7c554129: RteEventRef=OpEventLimitChannelToNoComMode_LimitChannelToNoComMode_CL_CN_DBCNetWork_Can0_7c554129
          OpEventGetInhibitionStatus_GetInhibitionStatus_CL_CN_DBCNetWork_Can0_7c554129: RteEventRef=OpEventGetInhibitionStatus_GetInhibitionStatus_CL_CN_DBCNetWork_Can0_7c554129
          OpEventRequestComMode_RequestComMode_UR_CN_DBCNetWork_Can0_4f8ab83d: RteEventRef=OpEventRequestComMode_RequestComMode_UR_CN_DBCNetWork_Can0_4f8ab83d
          OpEventGetInhibitionStatus_GetInhibitionStatus_CW_CN_DBCNetWork_Can0_7c554129: RteEventRef=OpEventGetInhibitionStatus_GetInhibitionStatus_CW_CN_DBCNetWork_Can0_7c554129
          OpEventGetCurrentComMode_GetCurrentComMode_UR_CN_DBCNetWork_Can0_4f8ab83d: RteEventRef=OpEventGetCurrentComMode_GetCurrentComMode_UR_CN_DBCNetWork_Can0_4f8ab83d
      Os_OsCore0_swc_EcuSwComposition: RteSoftwareComponentInstanceRef=Os_OsCore0_swc
        OpEventGetCounterValue_GetCounterValue_OsService_SystemTimer_Core0 (RteEventToTaskMapping):
          RteImmediateRestart = false
          RtePositionInTask = 14
          RteEventRef = OpEventGetCounterValue_GetCounterValue_OsService_SystemTimer_Core0
          RteMappedToTaskRef = OsTask_Bsw5ms_Core0
        OpEventGetElapsedValue_GetElapsedValue_OsService_SystemTimer_Core0 (RteEventToTaskMapping):
          RteImmediateRestart = false
          RtePositionInTask = 15
          RteEventRef = OpEventGetElapsedValue_GetElapsedValue_OsService_SystemTimer_Core0
          RteMappedToTaskRef = OsTask_Bsw5ms_Core0
      Os_OsCore2_swc_EcuSwComposition: RteSoftwareComponentInstanceRef=Os_OsCore2_swc
        OpEventGetCounterValue_GetCounterValue_OsService_SystemTimer_Core2 (RteEventToTaskMapping):
          RteImmediateRestart = false
          RtePositionInTask = 4
          RteEventRef = OpEventGetCounterValue_GetCounterValue_OsService_SystemTimer_Core2
          RteMappedToTaskRef = OsTask_App10ms_Core2
        OpEventGetElapsedValue_GetElapsedValue_OsService_SystemTimer_Core2 (RteEventToTaskMapping):
          RteImmediateRestart = false
          RtePositionInTask = 5
          RteEventRef = OpEventGetElapsedValue_GetElapsedValue_OsService_SystemTimer_Core2
          RteMappedToTaskRef = OsTask_App10ms_Core2
      Os_OsCore1_swc_EcuSwComposition: RteSoftwareComponentInstanceRef=Os_OsCore1_swc
        OpEventGetCounterValue_GetCounterValue_OsService_SystemTimer_Core1 (RteEventToTaskMapping):
          RteImmediateRestart = false
          RtePositionInTask = 2
          RteEventRef = OpEventGetCounterValue_GetCounterValue_OsService_SystemTimer_Core1
          RteMappedToTaskRef = OsTask_App10ms_Core1
        OpEventGetElapsedValue_GetElapsedValue_OsService_SystemTimer_Core1 (RteEventToTaskMapping):
          RteImmediateRestart = false
          RtePositionInTask = 3
          RteEventRef = OpEventGetElapsedValue_GetElapsedValue_OsService_SystemTimer_Core1
          RteMappedToTaskRef = OsTask_App10ms_Core1
      BswM_EcuSwComposition: RteSoftwareComponentInstanceRef=BswM
        Timer_BswM_MainFunction (RteEventToTaskMapping):
          RteImmediateRestart = false
          RtePositionInTask = 0
          RteEventRef = Timer_BswM_MainFunction
          RteMappedToTaskRef = OsTask_Bsw5ms_Core0
          RteUsedOsAlarmRef = Rte_Al_TE2_OsTask_Bsw5ms_Core0_0_5ms
          RteUsedOsEventRef = Rte_Ev_Cyclic2_OsTask_Bsw5ms_Core0_0_5ms
      AppCtrl_EcuSwComposition: RteSoftwareComponentInstanceRef=AppCtrl
        TMT_AppCtrl_MainFunction (RteEventToTaskMapping):
          RteImmediateRestart = false
          RtePositionInTask = 0
          RteEventRef = TMT_AppCtrl_MainFunction
          RteMappedToTaskRef = OsTask_App10ms_Core0
          RteUsedOsEventRef = Rte_Ev_Cyclic_OsTask_App10ms_Core0_0_10ms
          RteUsedOsAlarmRef = Rte_Al_TE_OsTask_App10ms_Core0_0_10ms
        AppCtrl_InitEvent (RteEventToTaskMapping): RteImmediateRestart=false, RtePositionInTask=2, RteEventRef=AppCtrl_InitEvent, RteMappedToTaskRef=OsTask_App_Init_Task
    AppCtrl (RteSwComponentType): RteComponentTypeRef=AppCtrl, RteImplementationRef=AppCtrl_Implementation
      ComponentTypeCalibration (RteComponentTypeCalibration): RteCalibrationSupportEnabled=false
    3 x RteBswModuleInstance:
      CanTp: RteBswImplementationRef=CanTp_Impl, RteBswModuleConfigurationRef=CanTp
        CanTp_MainFunctionTimingEvent0 (RteBswEventToTaskMapping):
          RteBswImmediateRestart = false
          RteBswPositionInTask = 9
          RteBswEventRef = CanTp_MainFunctionTimingEvent0
          RteBswMappedToTaskRef = OsTask_Bsw5ms_Core0
          RteBswUsedOsAlarmRef = Rte_Al_TE2_OsTask_Bsw5ms_Core0_0_5ms
          RteBswUsedOsEventRef = Rte_Ev_Cyclic2_OsTask_Bsw5ms_Core0_0_5ms
        CANTP_EXCLUSIVE_AREA_0 (RteBswExclusiveAreaImpl): RteExclusiveAreaImplMechanism=ALL_INTERRUPT_BLOCKING, RteBswExclusiveAreaRef=CANTP_EXCLUSIVE_AREA_0
      Dcm: RteBswImplementationRef=Dcm_Impl, RteBswModuleConfigurationRef=Dcm
        Dcm_MainFunctionTimingEvent0 (RteBswEventToTaskMapping):
          RteBswImmediateRestart = false
          RteBswPositionInTask = 12
          RteBswEventRef = Dcm_MainFunctionTimingEvent0
          RteBswMappedToTaskRef = OsTask_Bsw5ms_Core0
          RteBswUsedOsAlarmRef = Rte_Al_TE2_OsTask_Bsw5ms_Core0_0_5ms
          RteBswUsedOsEventRef = Rte_Ev_Cyclic2_OsTask_Bsw5ms_Core0_0_5ms
        DCM_EXCLUSIVE_AREA_0 (RteBswExclusiveAreaImpl): RteExclusiveAreaImplMechanism=ALL_INTERRUPT_BLOCKING, RteBswExclusiveAreaRef=DCM_EXCLUSIVE_AREA_0
      Dem: RteBswImplementationRef=Dem_Impl, RteBswModuleConfigurationRef=Dem
        5 x RteBswExclusiveAreaImpl, all with RteExclusiveAreaImplMechanism=ALL_INTERRUPT_BLOCKING:
          DEM_EXCLUSIVE_AREA_{0..4}: RteBswExclusiveAreaRef=DEM_EXCLUSIVE_AREA_{0..4}
        Dem_MasterMainFunctionTimingEvent0 (RteBswEventToTaskMapping):
          RteBswImmediateRestart = false
          RteBswPositionInTask = 17
          RteBswEventRef = Dem_MasterMainFunctionTimingEvent0
          RteBswMappedToTaskRef = OsTask_Bsw5ms_Core0
          RteBswUsedOsAlarmRef = Rte_Al_TE2_OsTask_Bsw5ms_Core0_0_5ms
          RteBswUsedOsEventRef = Rte_Ev_Cyclic2_OsTask_Bsw5ms_Core0_0_5ms
        Dem_SatelliteMainFunctionTimingEvent0 (RteBswEventToTaskMapping):
          RteBswImmediateRestart = false
          RteBswPositionInTask = 18
          RteBswEventRef = Dem_SatelliteMainFunctionTimingEvent0
          RteBswMappedToTaskRef = OsTask_Bsw5ms_Core0
          RteBswUsedOsAlarmRef = Rte_Al_TE2_OsTask_Bsw5ms_Core0_0_5ms
          RteBswUsedOsEventRef = Rte_Ev_Cyclic2_OsTask_Bsw5ms_Core0_0_5ms
    3 x RteSwComponentInstance:
      DemSatellite_0_EcuSwComposition: RteSoftwareComponentInstanceRef=DemSatellite_0
        34 x RteEventToTaskMapping, all with RteImmediateRestart=false:
          Timer_Dem_SatelliteMainFunction: RtePositionInTask=18, RteEventRef=Timer_Dem_SatelliteMainFunction, RteMappedToTaskRef=OsTask_Bsw5ms_Core0, RteUsedOsAlarmRef=Rte_Al_TE2_OsTask_Bsw5ms_Core0_0_5ms, RteUsedOsEventRef=Rte_Ev_Cyclic2_OsTask_Bsw5ms_Core0_0_5ms
          OpEventGetEventUdsStatus_GetEventUdsStatus_EvtInfo_DTC_0x402011: RteEventRef=OpEventGetEventUdsStatus_GetEventUdsStatus_EvtInfo_DTC_0x402011
          OpEventGetEventUdsStatus_GetEventUdsStatus_Event_DTC_0x402011: RteEventRef=OpEventGetEventUdsStatus_GetEventUdsStatus_Event_DTC_0x402011
          OpEventGetEventUdsStatus_GetEventUdsStatus_GeneralEvtInfo: RteEventRef=OpEventGetEventUdsStatus_GetEventUdsStatus_GeneralEvtInfo
          OpEventGetEventStatus_GetEventStatus_EvtInfo_DTC_0x402011: RteEventRef=OpEventGetEventStatus_GetEventStatus_EvtInfo_DTC_0x402011
          OpEventGetEventStatus_GetEventStatus_Event_DTC_0x402011: RteEventRef=OpEventGetEventStatus_GetEventStatus_Event_DTC_0x402011
          OpEventGetEventStatus_GetEventStatus_GeneralEvtInfo: RteEventRef=OpEventGetEventStatus_GetEventStatus_GeneralEvtInfo
          OpEventGetEventFailed_GetEventFailed_EvtInfo_DTC_0x402011: RteEventRef=OpEventGetEventFailed_GetEventFailed_EvtInfo_DTC_0x402011
          OpEventGetEventFailed_GetEventFailed_Event_DTC_0x402011: RteEventRef=OpEventGetEventFailed_GetEventFailed_Event_DTC_0x402011
          OpEventGetEventFailed_GetEventFailed_GeneralEvtInfo: RteEventRef=OpEventGetEventFailed_GetEventFailed_GeneralEvtInfo
          OpEventGetEventTested_GetEventTested_EvtInfo_DTC_0x402011: RteEventRef=OpEventGetEventTested_GetEventTested_EvtInfo_DTC_0x402011
          OpEventGetEventTested_GetEventTested_Event_DTC_0x402011: RteEventRef=OpEventGetEventTested_GetEventTested_Event_DTC_0x402011
          OpEventGetEventTested_GetEventTested_GeneralEvtInfo: RteEventRef=OpEventGetEventTested_GetEventTested_GeneralEvtInfo
          OpEventGetDTCOfEvent_GetDTCOfEvent_EvtInfo_DTC_0x402011: RteEventRef=OpEventGetDTCOfEvent_GetDTCOfEvent_EvtInfo_DTC_0x402011
          OpEventGetDTCOfEvent_GetDTCOfEvent_Event_DTC_0x402011: RteEventRef=OpEventGetDTCOfEvent_GetDTCOfEvent_Event_DTC_0x402011
          OpEventGetDTCOfEvent_GetDTCOfEvent_GeneralEvtInfo: RteEventRef=OpEventGetDTCOfEvent_GetDTCOfEvent_GeneralEvtInfo
          OpEventGetFaultDetectionCounter_GetFaultDetectionCounter_EvtInfo_DTC_0x402011: RteEventRef=OpEventGetFaultDetectionCounter_GetFaultDetectionCounter_EvtInfo_DTC_0x402011
          OpEventGetFaultDetectionCounter_GetFaultDetectionCounter_Event_DTC_0x402011: RteEventRef=OpEventGetFaultDetectionCounter_GetFaultDetectionCounter_Event_DTC_0x402011
          OpEventGetFaultDetectionCounter_GetFaultDetectionCounter_GeneralEvtInfo: RteEventRef=OpEventGetFaultDetectionCounter_GetFaultDetectionCounter_GeneralEvtInfo
          OpEventGetEventFreezeFrameDataEx_GetEventFreezeFrameDataEx_EvtInfo_DTC_0x402011: RteEventRef=OpEventGetEventFreezeFrameDataEx_GetEventFreezeFrameDataEx_EvtInfo_DTC_0x402011
          OpEventGetEventFreezeFrameDataEx_GetEventFreezeFrameDataEx_Event_DTC_0x402011: RteEventRef=OpEventGetEventFreezeFrameDataEx_GetEventFreezeFrameDataEx_Event_DTC_0x402011
          OpEventGetEventFreezeFrameDataEx_GetEventFreezeFrameDataEx_GeneralEvtInfo: RteEventRef=OpEventGetEventFreezeFrameDataEx_GetEventFreezeFrameDataEx_GeneralEvtInfo
          OpEventGetEventExtendedDataRecordEx_GetEventExtendedDataRecordEx_EvtInfo_DTC_0x402011: RteEventRef=OpEventGetEventExtendedDataRecordEx_GetEventExtendedDataRecordEx_EvtInfo_DTC_0x402011
          OpEventGetEventExtendedDataRecordEx_GetEventExtendedDataRecordEx_Event_DTC_0x402011: RteEventRef=OpEventGetEventExtendedDataRecordEx_GetEventExtendedDataRecordEx_Event_DTC_0x402011
          OpEventGetEventExtendedDataRecordEx_GetEventExtendedDataRecordEx_GeneralEvtInfo: RteEventRef=OpEventGetEventExtendedDataRecordEx_GetEventExtendedDataRecordEx_GeneralEvtInfo
          OpEventGetEventEnableCondition_GetEventEnableCondition_EvtInfo_DTC_0x402011: RteEventRef=OpEventGetEventEnableCondition_GetEventEnableCondition_EvtInfo_DTC_0x402011
          OpEventGetEventEnableCondition_GetEventEnableCondition_GeneralEvtInfo: RteEventRef=OpEventGetEventEnableCondition_GetEventEnableCondition_GeneralEvtInfo
          OpEventGetDebouncingOfEvent_GetDebouncingOfEvent_EvtInfo_DTC_0x402011: RteEventRef=OpEventGetDebouncingOfEvent_GetDebouncingOfEvent_EvtInfo_DTC_0x402011
          OpEventGetDebouncingOfEvent_GetDebouncingOfEvent_GeneralEvtInfo: RteEventRef=OpEventGetDebouncingOfEvent_GetDebouncingOfEvent_GeneralEvtInfo
          OpEventGetMonitorStatus_GetMonitorStatus_EvtInfo_DTC_0x402011: RteEventRef=OpEventGetMonitorStatus_GetMonitorStatus_EvtInfo_DTC_0x402011
          OpEventGetMonitorStatus_GetMonitorStatus_GeneralEvtInfo: RteEventRef=OpEventGetMonitorStatus_GetMonitorStatus_GeneralEvtInfo
          OpEventSetEventStatus_SetEventStatus_Event_DTC_0x402011: RteEventRef=OpEventSetEventStatus_SetEventStatus_Event_DTC_0x402011
          OpEventResetEventStatus_ResetEventStatus_Event_DTC_0x402011: RteEventRef=OpEventResetEventStatus_ResetEventStatus_Event_DTC_0x402011
          OpEventResetEventDebounceStatus_ResetEventDebounceStatus_Event_DTC_0x402011: RteEventRef=OpEventResetEventDebounceStatus_ResetEventDebounceStatus_Event_DTC_0x402011
      DemMaster_0_EcuSwComposition: RteSoftwareComponentInstanceRef=DemMaster_0
        20 x RteEventToTaskMapping, all with RteImmediateRestart=false:
          Timer_Dem_MasterMainFunction: RtePositionInTask=17, RteEventRef=Timer_Dem_MasterMainFunction, RteMappedToTaskRef=OsTask_Bsw5ms_Core0, RteUsedOsAlarmRef=Rte_Al_TE2_OsTask_Bsw5ms_Core0_0_5ms, RteUsedOsEventRef=Rte_Ev_Cyclic2_OsTask_Bsw5ms_Core0_0_5ms
          OpEventPostRunRequested_GetPostRunRequested_DemServices: RteEventRef=OpEventPostRunRequested_GetPostRunRequested_DemServices
          OpEventGetDTCStatusAvailabilityMask_GetDTCStatusAvailabilityMask_DemServices: RteEventRef=OpEventGetDTCStatusAvailabilityMask_GetDTCStatusAvailabilityMask_DemServices
          OpEventGetEventUdsStatus_GetEventUdsStatus_GeneralEvtInfo: RteEventRef=OpEventGetEventUdsStatus_GetEventUdsStatus_GeneralEvtInfo
          OpEventGetEventStatus_GetEventStatus_GeneralEvtInfo: RteEventRef=OpEventGetEventStatus_GetEventStatus_GeneralEvtInfo
          OpEventGetEventFailed_GetEventFailed_GeneralEvtInfo: RteEventRef=OpEventGetEventFailed_GetEventFailed_GeneralEvtInfo
          OpEventGetEventTested_GetEventTested_GeneralEvtInfo: RteEventRef=OpEventGetEventTested_GetEventTested_GeneralEvtInfo
          OpEventGetDTCOfEvent_GetDTCOfEvent_GeneralEvtInfo: RteEventRef=OpEventGetDTCOfEvent_GetDTCOfEvent_GeneralEvtInfo
          OpEventGetFaultDetectionCounter_GetFaultDetectionCounter_GeneralEvtInfo: RteEventRef=OpEventGetFaultDetectionCounter_GetFaultDetectionCounter_GeneralEvtInfo
          OpEventGetEventFreezeFrameDataEx_GetEventFreezeFrameDataEx_GeneralEvtInfo: RteEventRef=OpEventGetEventFreezeFrameDataEx_GetEventFreezeFrameDataEx_GeneralEvtInfo
          OpEventGetEventExtendedDataRecordEx_GetEventExtendedDataRecordEx_GeneralEvtInfo: RteEventRef=OpEventGetEventExtendedDataRecordEx_GetEventExtendedDataRecordEx_GeneralEvtInfo
          OpEventGetEventEnableCondition_GetEventEnableCondition_GeneralEvtInfo: RteEventRef=OpEventGetEventEnableCondition_GetEventEnableCondition_GeneralEvtInfo
          OpEventGetDebouncingOfEvent_GetDebouncingOfEvent_GeneralEvtInfo: RteEventRef=OpEventGetDebouncingOfEvent_GetDebouncingOfEvent_GeneralEvtInfo
          OpEventGetMonitorStatus_GetMonitorStatus_GeneralEvtInfo: RteEventRef=OpEventGetMonitorStatus_GetMonitorStatus_GeneralEvtInfo
          OpEventGetOperationCycleState_GetOperationCycleState_OpCycle_PowerCycle: RteEventRef=OpEventGetOperationCycleState_GetOperationCycleState_OpCycle_PowerCycle
          OpEventSetOperationCycleState_SetOperationCycleState_OpCycle_PowerCycle: RteEventRef=OpEventSetOperationCycleState_SetOperationCycleState_OpCycle_PowerCycle
          OpEventClearDTC_ClearDTC_ClearDTC_DemClient: RteEventRef=OpEventClearDTC_ClearDTC_ClearDTC_DemClient
          OpEventSelectDTC_SelectDTC_ClearDTC_DemClient: RteEventRef=OpEventSelectDTC_SelectDTC_ClearDTC_DemClient
          OpEventGetEventMemoryOverflow_GetEventMemoryOverflow_OverflowIndPrimaryMemory_DemClient: RteEventRef=OpEventGetEventMemoryOverflow_GetEventMemoryOverflow_OverflowIndPrimaryMemory_DemClient
          OpEventGetNumberOfEventMemoryEntries_GetNumberOfEventMemoryEntries_OverflowIndPrimaryMemory_DemClient: RteEventRef=OpEventGetNumberOfEventMemoryEntries_GetNumberOfEventMemoryEntries_OverflowIndPrimaryMemory_DemClient
      Dcm_EcuSwComposition: RteSoftwareComponentInstanceRef=Dcm
        6 x RteEventToTaskMapping, all with RteImmediateRestart=false:
          Timer_Dcm_MainFunction: RtePositionInTask=12, RteEventRef=Timer_Dcm_MainFunction, RteMappedToTaskRef=OsTask_Bsw5ms_Core0, RteUsedOsAlarmRef=Rte_Al_TE2_OsTask_Bsw5ms_Core0_0_5ms, RteUsedOsEventRef=Rte_Ev_Cyclic2_OsTask_Bsw5ms_Core0_0_5ms
          OpEventGetActiveProtocol_GetActiveProtocol_DCMServices: RteEventRef=OpEventGetActiveProtocol_GetActiveProtocol_DCMServices
          OpEventGetSesCtrlType_GetSesCtrlType_DCMServices: RteEventRef=OpEventGetSesCtrlType_GetSesCtrlType_DCMServices
          OpEventResetToDefaultSession_ResetToDefaultSession_DCMServices: RteEventRef=OpEventResetToDefaultSession_ResetToDefaultSession_DCMServices
          OpEventSetActiveDiagnostic_SetActiveDiagnostic_DCMServices: RteEventRef=OpEventSetActiveDiagnostic_SetActiveDiagnostic_DCMServices
          OpEventGetRequestKind_GetRequestKind_DCMServices: RteEventRef=OpEventGetRequestKind_GetRequestKind_DCMServices
    CanTrcv (RteBswModuleInstance): RteBswImplementationRef=CanTrcv_Impl, RteBswModuleConfigurationRef=CanTrcv
      CanTrcv_30_Tja1043_MainFunctionTimingEvent0 (RteBswEventToTaskMapping):
        RteBswImmediateRestart = false
        RteBswPositionInTask = 2
        RteBswEventRef = CanTrcv_30_Tja1043_MainFunctionTimingEvent0
        RteBswMappedToTaskRef = OsTask_Bsw5ms_Core0
        RteBswUsedOsAlarmRef = Rte_Al_TE2_OsTask_Bsw5ms_Core0_0_5ms
        RteBswUsedOsEventRef = Rte_Ev_Cyclic2_OsTask_Bsw5ms_Core0_0_5ms
      CANTRCV_30_TJA1043_EXCLUSIVE_AREA_0 (RteBswExclusiveAreaImpl): RteExclusiveAreaImplMechanism=ALL_INTERRUPT_BLOCKING, RteBswExclusiveAreaRef=CANTRCV_30_TJA1043_EXCLUSIVE_AREA_0
    AppComTx_EcuSwComposition (RteSwComponentInstance): RteSoftwareComponentInstanceRef=AppComTx
      AppComTx_InitEvent (RteEventToTaskMapping): RteImmediateRestart=false, RtePositionInTask=1, RteEventRef=AppComTx_InitEvent, RteMappedToTaskRef=OsTask_App_Init_Task
      TMT_AppComTx_MainFunction (RteEventToTaskMapping):
        RteImmediateRestart = false
        RtePositionInTask = 1
        RteEventRef = TMT_AppComTx_MainFunction
        RteMappedToTaskRef = OsTask_App10ms_Core0
        RteUsedOsEventRef = Rte_Ev_Cyclic_OsTask_App10ms_Core0_0_10ms
        RteUsedOsAlarmRef = Rte_Al_TE_OsTask_App10ms_Core0_0_10ms
    AppComRx_EcuSwComposition (RteSwComponentInstance): RteSoftwareComponentInstanceRef=AppComRx
      AppComRx_InitEvent (RteEventToTaskMapping): RteImmediateRestart=false, RtePositionInTask=0, RteEventRef=AppComRx_InitEvent, RteMappedToTaskRef=OsTask_App_Init_Task
      TMT_AppComRx_MainFunction (RteEventToTaskMapping):
        RteImmediateRestart = false
        RtePositionInTask = 2
        RteEventRef = TMT_AppComRx_MainFunction
        RteMappedToTaskRef = OsTask_App10ms_Core0
        RteUsedOsEventRef = Rte_Ev_Cyclic_OsTask_App10ms_Core0_0_10ms
        RteUsedOsAlarmRef = Rte_Al_TE_OsTask_App10ms_Core0_0_10ms
    AppComTx (RteSwComponentType): RteComponentTypeRef=AppComTx, RteImplementationRef=AppComTx_Implementation
      ComponentTypeCalibration (RteComponentTypeCalibration): RteCalibrationSupportEnabled=false
    AppComRx (RteSwComponentType): RteComponentTypeRef=AppComRx, RteImplementationRef=AppComRx_Implementation
      ComponentTypeCalibration (RteComponentTypeCalibration): RteCalibrationSupportEnabled=false
    3 x RteBswModuleInstance:
      Icu: RteBswImplementationRef=Icu_Impl, RteBswModuleConfigurationRef=Icu
        6 x RteBswExclusiveAreaImpl, all with RteExclusiveAreaImplMechanism=ALL_INTERRUPT_BLOCKING:
          EnableWakeup: RteBswExclusiveAreaRef=EnableWakeup
          Ccu6IenUpdate: RteBswExclusiveAreaRef=Ccu6IenUpdate
          EnableNotification: RteBswExclusiveAreaRef=EnableNotification
          ResetEdgeCount: RteBswExclusiveAreaRef=ResetEdgeCount
          CcuInterruptHandle: RteBswExclusiveAreaRef=CcuInterruptHandle
          CcuVariableupdate: RteBswExclusiveAreaRef=CcuVariableupdate
      Irq: RteBswImplementationRef=Irq_Impl, RteBswModuleConfigurationRef=Irq
      Mcu: RteBswImplementationRef=Mcu_Impl, RteBswModuleConfigurationRef=Mcu
    AppWakeUpCtrl_EcuSwComposition (RteSwComponentInstance): RteSoftwareComponentInstanceRef=AppWakeUpCtrl
      TMT_AppWakeUpCtrl_MainFunction (RteEventToTaskMapping):
        RteImmediateRestart = false
        RtePositionInTask = 3
        RteEventRef = TMT_AppWakeUpCtrl_MainFunction
        RteMappedToTaskRef = OsTask_App10ms_Core0
        RteUsedOsEventRef = Rte_Ev_Cyclic_OsTask_App10ms_Core0_0_10ms
        RteUsedOsAlarmRef = Rte_Al_TE_OsTask_App10ms_Core0_0_10ms
      AppWakeUpCtrl_InitEvent (RteEventToTaskMapping): RteImmediateRestart=false, RtePositionInTask=3, RteEventRef=AppWakeUpCtrl_InitEvent, RteMappedToTaskRef=OsTask_App_Init_Task
    AppWakeUpCtrl (RteSwComponentType): RteComponentTypeRef=AppWakeUpCtrl, RteImplementationRef=AppWakeUpCtrl_Implementation
      ComponentTypeCalibration (RteComponentTypeCalibration): RteCalibrationSupportEnabled=false
    AppLedCtrl_EcuSwComposition (RteSwComponentInstance): RteSoftwareComponentInstanceRef=AppLedCtrl
      AppLedCtrl_InitEvent (RteEventToTaskMapping): RteImmediateRestart=false, RtePositionInTask=5, RteEventRef=AppLedCtrl_InitEvent, RteMappedToTaskRef=OsTask_App_Init_Task
      TMT_Runnable (RteEventToTaskMapping):
        RteImmediateRestart = false
        RtePositionInTask = 5
        RteEventRef = TMT_Runnable
        RteMappedToTaskRef = OsTask_App10ms_Core0
        RteUsedOsEventRef = Rte_Ev_Cyclic_OsTask_App10ms_Core0_0_10ms
        RteUsedOsAlarmRef = Rte_Al_TE_OsTask_App10ms_Core0_0_10ms
    AppButtonCtrl_EcuSwComposition (RteSwComponentInstance): RteSoftwareComponentInstanceRef=AppButtonCtrl
      TMT_AppButtonCtrl_MainFunction (RteEventToTaskMapping):
        RteImmediateRestart = false
        RtePositionInTask = 4
        RteEventRef = TMT_AppButtonCtrl_MainFunction
        RteMappedToTaskRef = OsTask_App10ms_Core0
        RteUsedOsEventRef = Rte_Ev_Cyclic_OsTask_App10ms_Core0_0_10ms
        RteUsedOsAlarmRef = Rte_Al_TE_OsTask_App10ms_Core0_0_10ms
      AppButtonCtrl_InitEvent (RteEventToTaskMapping): RteImmediateRestart=false, RtePositionInTask=4, RteEventRef=AppButtonCtrl_InitEvent, RteMappedToTaskRef=OsTask_App_Init_Task
    AppLedCtrl (RteSwComponentType): RteComponentTypeRef=AppLedCtrl, RteImplementationRef=AppLedCtrl_Implementation
      ComponentTypeCalibration (RteComponentTypeCalibration): RteCalibrationSupportEnabled=false
    AppButtonCtrl (RteSwComponentType): RteComponentTypeRef=AppButtonCtrl, RteImplementationRef=AppButtonCtrl_Implementation
      ComponentTypeCalibration (RteComponentTypeCalibration): RteCalibrationSupportEnabled=false
    IoHwAb_0 (RteBswModuleInstance): RteBswImplementationRef=IoHwAb_Impl, RteBswModuleConfigurationRef=IoHwAb
      IOHWAB_EXCLUSIVE_AREA_0 (RteBswExclusiveAreaImpl): RteExclusiveAreaImplMechanism=ALL_INTERRUPT_BLOCKING, RteBswExclusiveAreaRef=IOHWAB_EXCLUSIVE_AREA_0
    3 x RteSwComponentInstance:
      AppCtrl2_EcuSwComposition: RteSoftwareComponentInstanceRef=AppCtrl2
        TMT_AppCtrl2_MainFunction (RteEventToTaskMapping):
          RteImmediateRestart = false
          RtePositionInTask = 2
          RteEventRef = TMT_AppCtrl2_MainFunction
          RteMappedToTaskRef = OsTask_App10ms_Core2
          RteUsedOsEventRef = Rte_Ev_Run_AppCtrl2_AppCtrl2_MainFunction
          RteUsedOsAlarmRef = Rte_Al_TE_AppCtrl2_AppCtrl2_MainFunction
      IoHwAb_EcuSwComposition: RteSoftwareComponentInstanceRef=IoHwAb
        14 x RteEventToTaskMapping, all with RteImmediateRestart=false:
          OpEventIoHwAb_IoHwAbCS_LED1_IoHwAbOp_LED1_Write_IoHwAbOp_LED1_Write_IoHwAbCS_LED1: RteEventRef=OpEventIoHwAb_IoHwAbCS_LED1_IoHwAbOp_LED1_Write_IoHwAbOp_LED1_Write_IoHwAbCS_LED1
          OpEventIoHwAb_IoHwAbCS_LED1_IoHwAbOp_LED1_Read_IoHwAbOp_LED1_Read_IoHwAbCS_LED1: RteEventRef=OpEventIoHwAb_IoHwAbCS_LED1_IoHwAbOp_LED1_Read_IoHwAbOp_LED1_Read_IoHwAbCS_LED1
          OpEventIoHwAb_IoHwAbCS_LED2_IoHwAbOp_LED2_Write_IoHwAbOp_LED2_Write_IoHwAbCS_LED2: RteEventRef=OpEventIoHwAb_IoHwAbCS_LED2_IoHwAbOp_LED2_Write_IoHwAbOp_LED2_Write_IoHwAbCS_LED2
          OpEventIoHwAb_IoHwAbCS_LED2_IoHwAbOp_LED2_Read_IoHwAbOp_LED2_Read_IoHwAbCS_LED2: RteEventRef=OpEventIoHwAb_IoHwAbCS_LED2_IoHwAbOp_LED2_Read_IoHwAbOp_LED2_Read_IoHwAbCS_LED2
          OpEventIoHwAb_IoHwAbCS_LED3_IoHwAbOp_LED3_Write_IoHwAbOp_LED3_Write_IoHwAbCS_LED3: RteEventRef=OpEventIoHwAb_IoHwAbCS_LED3_IoHwAbOp_LED3_Write_IoHwAbOp_LED3_Write_IoHwAbCS_LED3
          OpEventIoHwAb_IoHwAbCS_LED3_IoHwAbOp_LED3_Read_IoHwAbOp_LED3_Read_IoHwAbCS_LED3: RteEventRef=OpEventIoHwAb_IoHwAbCS_LED3_IoHwAbOp_LED3_Read_IoHwAbOp_LED3_Read_IoHwAbCS_LED3
          OpEventIoHwAb_IoHwAbCS_LED4_IoHwAbOp_LED4_Write_IoHwAbOp_LED4_Write_IoHwAbCS_LED4: RteEventRef=OpEventIoHwAb_IoHwAbCS_LED4_IoHwAbOp_LED4_Write_IoHwAbOp_LED4_Write_IoHwAbCS_LED4
          OpEventIoHwAb_IoHwAbCS_LED4_IoHwAbOp_LED4_Read_IoHwAbOp_LED4_Read_IoHwAbCS_LED4: RteEventRef=OpEventIoHwAb_IoHwAbCS_LED4_IoHwAbOp_LED4_Read_IoHwAbOp_LED4_Read_IoHwAbCS_LED4
          OpEventIoHwAb_IoHwAbCS_Button{1..4}_IoHwAbOp_Button{1..4}_Read_IoHwAbOp_Button{1..4}_Read_IoHwAbCS_Button{1..4}: RteEventRef=OpEventIoHwAb_IoHwAbCS_Button{1..4}_IoHwAbOp_Button{1..4}_Read_IoHwAbOp_Button{1..4}_Read_IoHwAbCS_Button{1..4}
          OpEventIoHwAb_IoHwAbCS_KL15_IoHwAbOp_KL15_Read_IoHwAbOp_KL15_Read_IoHwAbCS_KL15: RteEventRef=OpEventIoHwAb_IoHwAbCS_KL15_IoHwAbOp_KL15_Read_IoHwAbOp_KL15_Read_IoHwAbCS_KL15
          Timer_IoHwAb_IoHwAbRunnable: RtePositionInTask=19, RteEventRef=Timer_IoHwAb_IoHwAbRunnable, RteMappedToTaskRef=OsTask_Bsw5ms_Core0, RteUsedOsEventRef=Rte_Ev_Run_IoHwAb_IoHwAb_IoHwAbRunnable, RteUsedOsAlarmRef=Rte_Al_TE_IoHwAb_IoHwAb_IoHwAbRunnable
      AppCtrl1_EcuSwComposition: RteSoftwareComponentInstanceRef=AppCtrl1
        TMT_AppCtrl1_MainFuntion (RteEventToTaskMapping):
          RteImmediateRestart = false
          RtePositionInTask = 4
          RteEventRef = TMT_AppCtrl1_MainFuntion
          RteMappedToTaskRef = OsTask_App10ms_Core1
          RteUsedOsEventRef = Rte_Ev_Run_AppCtrl1_AppCtrl1_MainFuntion
          RteUsedOsAlarmRef = Rte_Al_TE_AppCtrl1_AppCtrl1_MainFuntion
    3 x RteSwComponentType:
      AppCtrl2: RteComponentTypeRef=AppCtrl2, RteImplementationRef=AppCtrl2_Implementation
        ComponentTypeCalibration (RteComponentTypeCalibration): RteCalibrationSupportEnabled=false
      AppCtrl1: RteComponentTypeRef=AppCtrl1, RteImplementationRef=AppCtrl1_Implementation
        ComponentTypeCalibration (RteComponentTypeCalibration): RteCalibrationSupportEnabled=false
      IoHwAb: RteComponentTypeRef=IoHwAb, RteImplementationRef=IoHwAbImplementation
        ComponentTypeCalibration (RteComponentTypeCalibration): RteCalibrationSupportEnabled=false
    Dio (RteBswModuleInstance): RteBswImplementationRef=Dio_Impl, RteBswModuleConfigurationRef=Dio
    Port (RteBswModuleInstance): RteBswImplementationRef=Port_Impl, RteBswModuleConfigurationRef=Port
    IcuCdd_EcuSwComposition (RteSwComponentInstance): RteSoftwareComponentInstanceRef=IcuCdd
      IcuCdd_InitEvent (RteEventToTaskMapping): RteImmediateRestart=false, RtePositionInTask=6, RteEventRef=IcuCdd_InitEvent, RteMappedToTaskRef=OsTask_App_Init_Task
      TMT_IcuCdd_MainFunction (RteEventToTaskMapping):
        RteImmediateRestart = false
        RtePositionInTask = 6
        RteEventRef = TMT_IcuCdd_MainFunction
        RteMappedToTaskRef = OsTask_App10ms_Core0
        RteUsedOsEventRef = Rte_Ev_Cyclic_OsTask_App10ms_Core0_0_10ms
        RteUsedOsAlarmRef = Rte_Al_TE_OsTask_App10ms_Core0_0_10ms
    IcuCdd (RteSwComponentType): RteComponentTypeRef=IcuCdd, RteImplementationRef=IcuCdd_Implementation
      ComponentTypeCalibration (RteComponentTypeCalibration): RteCalibrationSupportEnabled=false
