AUTOSAR XML (schema 00046)
package /ActiveEcuC
  module config Cdd: implementation-config-variant=VARIANT-PRE-COMPILE, module-description=Cdd_Impl
    CddComStackContribution
      CddComIfUpperLayerContribution
        CddComIfUpperLayerRxPdu: CddComIfHandleId=0, CddComIfPduRef=Ecu_Receive_Msg_oDBCNetWork_Can0_364979cb_Rx
        CddComIfUpperLayerTxPdu: CddComIfHandleId=0, CddComIfPduRef=Ecu_Send_Msg_oDBCNetWork_Can0_da1e44e3_Tx
