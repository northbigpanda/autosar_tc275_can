AUTOSAR XML (schema 00046)
package /ActiveEcuC
  module config Com: implementation-config-variant=VARIANT-PRE-COMPILE, module-description=Com_Impl
    ComGeneration:
      ComOutOfBoundsWriteProtectionStrategy = NONE
      ComOutOfBoundsWriteSanitizer = false
      ComOutOfBoundsReadSanitizer = false
      ComReduceConstantData2Define = false
      ComBoolDataInArrayOfStructStrategy = BOOLEAN
      ComDeduplicateIndirectedData = true
      ComDataDeduplicationStrategy = WITH_CAST
      ComReduceBoolDataByNegationThreshold = 2
      ComReduceBoolDataByNumericalComparisonThreshold = 2
      ComReduceBoolDataByNumericalRelationThreshold = 2
      ComReduceBoolDataByNumericalOperandStrategy = WITH_ANY_VALUE
      ComReduceNumericalDataByOffsetThreshold = 2
      ComReduceNumericalDataByArraySubtractionThreshold = 2
      ComReduceDataByStreaming = false
      ComShortSymbols = false
      ComInterfacesForDeactivatedData = false
      ComReferringKeysInComments = false
    ComOptimization:
      ComTxCyclicProcessingISRLockThreshold = 1
      ComTxDeadlineMonitoringISRLockThreshold = 1
      ComTxProcessingISRLockThreshold = 1
      ComRxDeadlineMonitoringISRLockThreshold = 1
      ComRxDeferredProcessingISRLockThreshold = 1
      ComGatewayProcessingISRLockThreshold = 1
      ComGatewayDescriptionProcessingISRLockThreshold = 1
      ComIPduGroupISRLockThreshold = 1
    ComConfig: ComConfigurationId=0, ComRxDeferredNotificationCacheSize=1, ComRxImmediateNotificationCacheSize=0
      ComTimeBase: ComRxTimeBase=0.005, ComTxTimeBase=0.005, ComGwTimeBase=0.005
      XB_SUP_A_oDBCNetWork_Rx_d3c0144f (ComIPduGroup): ComIPduGroupHandleId=0
      XB_SUP_A_oDBCNetWork_Tx_859ab3c9 (ComIPduGroup): ComIPduGroupHandleId=1
      SupB_Led_Control_oDBCNetWork_eb16948d_Rx (ComIPdu):
        ComIPduDirection = RECEIVE
        ComIPduType = NORMAL
        ComIPduHandleId = 1
        ComIPduSignalProcessing = DEFERRED
        ComIPduCancellationSupport = false
        ComIPduGroupRef = XB_SUP_A_oDBCNetWork_Rx_d3c0144f
        ComIPduSignalGroupRef = SG_Sig_Grp_0x400_oSupB_Led_Control_oDBCNetWork_6275ac6f_Rx
        ComPduIdRef = SupB_Led_Control_oDBCNetWork_eb16948d_Rx
      SG_Sig_Grp_0x400_oSupB_Led_Control_oDBCNetWork_6275ac6f_Rx (ComSignalGroup):
        ComTimeout = 0
        ComTransferProperty = PENDING
        ComSignalGroupAccess = ACCESS_UNCLEAR
        ComHandleId = 0
        ComNotification = Rte_COMCbk_SG_Sig_Grp_0x400_oSupB_Led_Control_oDBCNetWork_6275ac6f_Rx
        ComSystemTemplateSignalGroupRef = SG_Sig_Grp_0x400
        9 x ComGroupSignal, all with ComSignalEndianness=BIG_ENDIAN, ComSignalAccess=ACCESS_UNCLEAR:
          SupB_Checksum_0x400_oSupB_Led_Control_oDBCNetWork_1c8bf5dc_Rx: ComBitPosition=7, ComBitSize=8, ComSignalInitValue=0, ComSignalType=UINT8, ComHandleId=7, ComSystemTemplateSystemSignalRef=SupB_Checksum_0x400
          Led2_Control_oSupB_Led_Control_oDBCNetWork_9bb26ddb_Rx: ComBitPosition=9, ComBitSize=1, ComSignalInitValue=1, ComSignalType=BOOLEAN, ComHandleId=4, ComSystemTemplateSystemSignalRef=Led2_Control
          SupB_Counter_0x400_oSupB_Led_Control_oDBCNetWork_2dd3ae1e_Rx: ComBitPosition=59, ComBitSize=4, ComSignalInitValue=0, ComSignalType=UINT8, ComHandleId=8, ComSystemTemplateSystemSignalRef=SupB_Counter_0x400
          CrcSig_Pack_1_oSupB_Led_Control_oDBCNetWork_e21b7252_Rx: ComBitPosition=23, ComBitSize=24, ComSignalInitValue=0, ComSignalType=UINT32, ComHandleId=1, ComSystemTemplateSystemSignalRef=CrcSig_Pack_1
          Led4_Control_oSupB_Led_Control_oDBCNetWork_e7f5526c_Rx: ComBitPosition=11, ComBitSize=1, ComSignalInitValue=1, ComSignalType=BOOLEAN, ComHandleId=6, ComSystemTemplateSystemSignalRef=Led4_Control
          Led3_Control_oSupB_Led_Control_oDBCNetWork_d53b6672_Rx: ComBitPosition=10, ComBitSize=1, ComSignalInitValue=1, ComSignalType=BOOLEAN, ComHandleId=5, ComSystemTemplateSystemSignalRef=Led3_Control
          CrcSig_Pack_0_oSupB_Led_Control_oDBCNetWork_ecfc9a83_Rx: ComBitPosition=15, ComBitSize=4, ComSignalInitValue=0, ComSignalType=UINT8, ComHandleId=0, ComSystemTemplateSystemSignalRef=CrcSig_Pack_0
          CrcSig_Pack_2_oSupB_Led_Control_oDBCNetWork_f1334b21_Rx: ComBitPosition=47, ComBitSize=20, ComSignalInitValue=0, ComSignalType=UINT32, ComHandleId=2, ComSystemTemplateSystemSignalRef=CrcSig_Pack_2
          Led1_Control_oSupB_Led_Control_oDBCNetWork_48297120_Rx: ComBitPosition=8, ComBitSize=1, ComSignalInitValue=1, ComSignalType=BOOLEAN, ComHandleId=3, ComSystemTemplateSystemSignalRef=Led1_Control
      SupA_Led_State_oDBCNetWork_43576f7c_Tx (ComIPdu):
        ComIPduDirection = SEND
        ComIPduType = NORMAL
        ComIPduHandleId = 3
        ComIPduSignalProcessing = DEFERRED
        ComIPduCancellationSupport = false
        ComIPduGroupRef = XB_SUP_A_oDBCNetWork_Tx_859ab3c9
        ComIPduSignalGroupRef = SG_Sig_Grp_0x110_oSupA_Led_State_oDBCNetWork_89d57c9b_Tx
        ComPduIdRef = SupA_Led_State_oDBCNetWork_43576f7c_Tx
        ComTxIPdu: ComMinimumDelayTime=0, ComTxIPduUnusedAreasDefault=0
          ComTxModeTrue
            ComTxMode: ComTxModeMode=PERIODIC, ComTxModeTimeOffset=0, ComTxModeTimePeriod=0.01
          ComTxModeFalse
            ComTxMode: ComTxModeMode=PERIODIC, ComTxModeTimeOffset=0, ComTxModeTimePeriod=0.01
      SG_Sig_Grp_0x111_oSupA_Button_State_oDBCNetWork_062df960_Tx (ComSignalGroup): ComTransferProperty=PENDING, ComSignalGroupAccess=ACCESS_UNCLEAR, ComHandleId=1, ComSystemTemplateSignalGroupRef=SG_Sig_Grp_0x111
        4 x ComGroupSignal, all with ComBitSize=1, ComSignalEndianness=BIG_ENDIAN, ComSignalInitValue=0, ComSignalType=BOOLEAN, ComTransferProperty=PENDING, ComSignalAccess=ACCESS_UNCLEAR:
          Button4_State_oSupA_Button_State_oDBCNetWork_2704068b_Tx: ComBitPosition=35, ComHandleId=7, ComSystemTemplateSystemSignalRef=Button4_State
          Button2_State_oSupA_Button_State_oDBCNetWork_bcd40645_Tx: ComBitPosition=33, ComHandleId=5, ComSystemTemplateSystemSignalRef=Button2_State
          Button3_State_oSupA_Button_State_oDBCNetWork_315cfba7_Tx: ComBitPosition=34, ComHandleId=6, ComSystemTemplateSystemSignalRef=Button3_State
          Button1_State_oSupA_Button_State_oDBCNetWork_f13c0622_Tx: ComBitPosition=32, ComHandleId=4, ComSystemTemplateSystemSignalRef=Button1_State
      4 x ComIPdu, all with ComIPduType=NORMAL, ComIPduSignalProcessing=DEFERRED, ComIPduCancellationSupport=false:
        SupA_Angle_oDBCNetWork_e5909e4f_Tx: ComIPduDirection=SEND, ComIPduHandleId=0, ComIPduGroupRef=XB_SUP_A_oDBCNetWork_Tx_859ab3c9, ComIPduSignalGroupRef=SG_Sig_Grp_0x113_oSupA_Angle_oDBCNetWork_c5c2558a_Tx, ComPduIdRef=SupA_Angle_oDBCNetWork_e5909e4f_Tx
          ComTxIPdu: ComMinimumDelayTime=0, ComTxIPduUnusedAreasDefault=0
            ComTxModeTrue
              ComTxMode: ComTxModeMode=PERIODIC, ComTxModeTimeOffset=0, ComTxModeTimePeriod=0.01
            ComTxModeFalse
              ComTxMode: ComTxModeMode=PERIODIC, ComTxModeTimeOffset=0, ComTxModeTimePeriod=0.01
        SupC_Function_2_oDBCNetWork_55d6a67c_Rx: ComIPduDirection=RECEIVE, ComIPduHandleId=3, ComIPduGroupRef=XB_SUP_A_oDBCNetWork_Rx_d3c0144f, ComIPduSignalGroupRef=SG_Sig_Grp_0x403_oSupC_Function_2_oDBCNetWork_a16481fd_Rx, ComPduIdRef=SupC_Function_2_oDBCNetWork_55d6a67c_Rx
        SupA_Button_State_oDBCNetWork_390399bb_Tx: ComIPduDirection=SEND, ComIPduHandleId=1, ComIPduGroupRef=XB_SUP_A_oDBCNetWork_Tx_859ab3c9, ComIPduSignalGroupRef=SG_Sig_Grp_0x111_oSupA_Button_State_oDBCNetWork_062df960_Tx, ComPduIdRef=SupA_Button_State_oDBCNetWork_390399bb_Tx
          ComTxIPdu: ComMinimumDelayTime=0, ComTxIPduUnusedAreasDefault=0
            ComTxModeTrue
              ComTxMode: ComTxModeMode=PERIODIC, ComTxModeTimeOffset=0, ComTxModeTimePeriod=0.01
            ComTxModeFalse
              ComTxMode: ComTxModeMode=PERIODIC, ComTxModeTimeOffset=0, ComTxModeTimePeriod=0.01
        SupA_PowerMode_oDBCNetWork_b77edafa_Tx: ComIPduDirection=SEND, ComIPduHandleId=4, ComIPduGroupRef=XB_SUP_A_oDBCNetWork_Tx_859ab3c9, ComIPduSignalGroupRef=SG_Sig_Grp_0x112_oSupA_PowerMode_oDBCNetWork_bbf37b55_Tx, ComPduIdRef=SupA_PowerMode_oDBCNetWork_b77edafa_Tx
          ComTxIPdu: ComMinimumDelayTime=0, ComTxIPduUnusedAreasDefault=0
            ComTxModeTrue
              ComTxMode: ComTxModeMode=PERIODIC, ComTxModeTimeOffset=0, ComTxModeTimePeriod=0.2
            ComTxModeFalse
              ComTxMode: ComTxModeMode=PERIODIC, ComTxModeTimeOffset=0, ComTxModeTimePeriod=0.2
      6 x ComSignalGroup, all with ComTransferProperty=PENDING, ComSignalGroupAccess=ACCESS_UNCLEAR:
        SG_Sig_Grp_0x112_oSupA_PowerMode_oDBCNetWork_bbf37b55_Tx: ComHandleId=2, ComSystemTemplateSignalGroupRef=SG_Sig_Grp_0x112
          3 x ComGroupSignal, all with ComSignalEndianness=BIG_ENDIAN, ComSignalInitValue=0, ComSignalType=UINT8, ComTransferProperty=PENDING, ComSignalAccess=ACCESS_UNCLEAR:
            SupA_Checksum_0x112_oSupA_PowerMode_oDBCNetWork_3f776c50_Tx: ComBitPosition=7, ComBitSize=8, ComHandleId=9, ComSystemTemplateSystemSignalRef=SupA_Checksum_0x112
            SupA_Counter_0x112_oSupA_PowerMode_oDBCNetWork_5e5c6751_Tx: ComBitPosition=59, ComBitSize=4, ComHandleId=10, ComSystemTemplateSystemSignalRef=SupA_Counter_0x112
            PowerMode_oSupA_PowerMode_oDBCNetWork_c3b722c7_Tx: ComBitPosition=10, ComBitSize=3, ComHandleId=8, ComSystemTemplateSystemSignalRef=PowerMode
        SG_Sig_Grp_0x403_oSupC_Function_2_oDBCNetWork_a16481fd_Rx: ComTimeout=0, ComHandleId=3, ComSystemTemplateSignalGroupRef=SG_Sig_Grp_0x403
          5 x ComGroupSignal, all with ComSignalEndianness=BIG_ENDIAN, ComSignalInitValue=0, ComSignalAccess=ACCESS_UNCLEAR:
            Sig_0x403_Used_1_oSupC_Function_2_oDBCNetWork_1ead65c3_Rx: ComBitPosition=7, ComBitSize=4, ComSignalType=UINT8, ComHandleId=18, ComSystemTemplateSystemSignalRef=Sig_0x403_Used_1
            Sig_0x403_Used_2_oSupC_Function_2_oDBCNetWork_5a0c40db_Rx: ComBitPosition=3, ComBitSize=12, ComSignalType=UINT16, ComHandleId=19, ComSystemTemplateSystemSignalRef=Sig_0x403_Used_2
            Sig_0x403_Used_5_oSupC_Function_2_oDBCNetWork_ef2ee9e3_Rx: ComBitPosition=55, ComBitSize=16, ComSignalType=UINT16, ComHandleId=22, ComSystemTemplateSystemSignalRef=Sig_0x403_Used_5
            Sig_0x403_Used_4_oSupC_Function_2_oDBCNetWork_d34e0aeb_Rx: ComBitPosition=39, ComBitSize=16, ComSignalType=UINT16, ComHandleId=21, ComSystemTemplateSystemSignalRef=Sig_0x403_Used_4
            Sig_0x403_Used_3_oSupC_Function_2_oDBCNetWork_666ca3d3_Rx: ComBitPosition=23, ComBitSize=16, ComSignalType=UINT16, ComHandleId=20, ComSystemTemplateSystemSignalRef=Sig_0x403_Used_3
        SG_Sig_Grp_0x113_oSupA_Angle_oDBCNetWork_c5c2558a_Tx: ComHandleId=3, ComSystemTemplateSignalGroupRef=SG_Sig_Grp_0x113
          AAA_Angle_oSupA_Angle_oDBCNetWork_1adb3bf0_Tx (ComGroupSignal):
            ComBitPosition = 5
            ComBitSize = 6
            ComSignalEndianness = BIG_ENDIAN
            ComSignalInitValue = 20
            ComSignalType = UINT8
            ComTransferProperty = PENDING
            ComSignalAccess = ACCESS_UNCLEAR
            ComHandleId = 11
            ComSystemTemplateSystemSignalRef = AAA_Angle
        SG_Sig_Grp_0x401_oSupB_Button_Control_oDBCNetWork_41809065_Rx: ComTimeout=0, ComHandleId=1, ComSystemTemplateSignalGroupRef=SG_Sig_Grp_0x401
          4 x ComGroupSignal, all with ComBitSize=1, ComSignalEndianness=BIG_ENDIAN, ComSignalInitValue=0, ComSignalType=BOOLEAN, ComSignalAccess=ACCESS_UNCLEAR:
            Button2_Control_oSupB_Button_Control_oDBCNetWork_f3f670b7_Rx: ComBitPosition=49, ComHandleId=10, ComSystemTemplateSystemSignalRef=Button2_Control
            Button3_Control_oSupB_Button_Control_oDBCNetWork_52cff459_Rx: ComBitPosition=50, ComHandleId=11, ComSystemTemplateSystemSignalRef=Button3_Control
            Button4_Control_oSupB_Button_Control_oDBCNetWork_83816651_Rx: ComBitPosition=51, ComHandleId=12, ComSystemTemplateSystemSignalRef=Button4_Control
            Button1_Control_oSupB_Button_Control_oDBCNetWork_cbcdfbc4_Rx: ComBitPosition=48, ComHandleId=9, ComSystemTemplateSystemSignalRef=Button1_Control
        SG_Sig_Grp_0x114_oSupA_Function_1_oDBCNetWork_fe007f55_Tx: ComHandleId=4, ComSystemTemplateSignalGroupRef=SG_Sig_Grp_0x114
          5 x ComGroupSignal, all with ComSignalEndianness=BIG_ENDIAN, ComSignalInitValue=0, ComTransferProperty=PENDING, ComSignalAccess=ACCESS_UNCLEAR:
            Sig_0x114_Used_1_oSupA_Function_1_oDBCNetWork_6c3a7273_Tx: ComBitPosition=7, ComBitSize=4, ComSignalType=UINT8, ComHandleId=12, ComSystemTemplateSystemSignalRef=Sig_0x114_Used_1
            Sig_0x114_Used_3_oSupA_Function_1_oDBCNetWork_14fbb463_Tx: ComBitPosition=23, ComBitSize=16, ComSignalType=UINT16, ComHandleId=14, ComSystemTemplateSystemSignalRef=Sig_0x114_Used_3
            Sig_0x114_Used_5_oSupA_Function_1_oDBCNetWork_9db9fe53_Tx: ComBitPosition=55, ComBitSize=8, ComSignalType=UINT8, ComHandleId=16, ComSystemTemplateSystemSignalRef=Sig_0x114_Used_5
            Sig_0x114_Used_2_oSupA_Function_1_oDBCNetWork_289b576b_Tx: ComBitPosition=3, ComBitSize=12, ComSignalType=UINT16, ComHandleId=13, ComSystemTemplateSystemSignalRef=Sig_0x114_Used_2
            Sig_0x114_Used_4_oSupA_Function_1_oDBCNetWork_a1d91d5b_Tx: ComBitPosition=39, ComBitSize=16, ComSignalType=UINT16, ComHandleId=15, ComSystemTemplateSystemSignalRef=Sig_0x114_Used_4
        SG_Sig_Grp_0x402_oSupC_Function_1_oDBCNetWork_20ce0e3b_Rx: ComTimeout=0, ComHandleId=2, ComSystemTemplateSignalGroupRef=SG_Sig_Grp_0x402
          5 x ComGroupSignal, all with ComSignalEndianness=BIG_ENDIAN, ComSignalInitValue=0, ComSignalAccess=ACCESS_UNCLEAR:
            Sig_0x402_Used_1_oSupC_Function_1_oDBCNetWork_23971e12_Rx: ComBitPosition=7, ComBitSize=4, ComSignalType=UINT8, ComHandleId=13, ComSystemTemplateSystemSignalRef=Sig_0x402_Used_1
            Sig_0x402_Used_5_oSupC_Function_1_oDBCNetWork_d2149232_Rx: ComBitPosition=55, ComBitSize=16, ComSignalType=UINT16, ComHandleId=17, ComSystemTemplateSystemSignalRef=Sig_0x402_Used_5
            Sig_0x402_Used_3_oSupC_Function_1_oDBCNetWork_5b56d802_Rx: ComBitPosition=23, ComBitSize=16, ComSignalType=UINT16, ComHandleId=15, ComSystemTemplateSystemSignalRef=Sig_0x402_Used_3
            Sig_0x402_Used_4_oSupC_Function_1_oDBCNetWork_ee74713a_Rx: ComBitPosition=39, ComBitSize=16, ComSignalType=UINT16, ComHandleId=16, ComSystemTemplateSystemSignalRef=Sig_0x402_Used_4
            Sig_0x402_Used_2_oSupC_Function_1_oDBCNetWork_67363b0a_Rx: ComBitPosition=3, ComBitSize=12, ComSignalType=UINT16, ComHandleId=14, ComSystemTemplateSystemSignalRef=Sig_0x402_Used_2
      SupA_Function_1_oDBCNetWork_312706bd_Tx (ComIPdu):
        ComIPduDirection = SEND
        ComIPduType = NORMAL
        ComIPduHandleId = 2
        ComIPduSignalProcessing = DEFERRED
        ComIPduCancellationSupport = false
        ComIPduGroupRef = XB_SUP_A_oDBCNetWork_Tx_859ab3c9
        ComIPduSignalGroupRef = SG_Sig_Grp_0x114_oSupA_Function_1_oDBCNetWork_fe007f55_Tx
        ComIPduSignalRef = Sig_0x114_Used_6_oSupA_Function_1_oDBCNetWork_d918db4b_Tx
        ComPduIdRef = SupA_Function_1_oDBCNetWork_312706bd_Tx
        ComTxIPdu: ComMinimumDelayTime=0, ComTxIPduUnusedAreasDefault=0
          ComTxModeTrue
            ComTxMode: ComTxModeMode=DIRECT, ComTxModeNumberOfRepetitions=4, ComTxModeRepetitionPeriod=0.02, ComTxModeTimeOffset=0, ComTxModeTimePeriod=0
          ComTxModeFalse
            ComTxMode: ComTxModeMode=DIRECT, ComTxModeNumberOfRepetitions=4, ComTxModeRepetitionPeriod=0.02, ComTxModeTimeOffset=0, ComTxModeTimePeriod=0
      SupC_Function_1_oDBCNetWork_e81ccab2_Rx (ComIPdu):
        ComIPduDirection = RECEIVE
        ComIPduType = NORMAL
        ComIPduHandleId = 2
        ComIPduSignalProcessing = DEFERRED
        ComIPduCancellationSupport = false
        ComIPduGroupRef = XB_SUP_A_oDBCNetWork_Rx_d3c0144f
        ComIPduSignalGroupRef = SG_Sig_Grp_0x402_oSupC_Function_1_oDBCNetWork_20ce0e3b_Rx
        ComPduIdRef = SupC_Function_1_oDBCNetWork_e81ccab2_Rx
      SG_Sig_Grp_0x110_oSupA_Led_State_oDBCNetWork_89d57c9b_Tx (ComSignalGroup): ComTransferProperty=PENDING, ComSignalGroupAccess=ACCESS_UNCLEAR, ComHandleId=0, ComSystemTemplateSignalGroupRef=SG_Sig_Grp_0x110
        4 x ComGroupSignal, all with ComBitSize=1, ComSignalEndianness=BIG_ENDIAN, ComSignalInitValue=0, ComSignalType=BOOLEAN, ComTransferProperty=PENDING, ComSignalAccess=ACCESS_UNCLEAR:
          Led3_State_oSupA_Led_State_oDBCNetWork_dc39af74_Tx: ComBitPosition=2, ComHandleId=2, ComSystemTemplateSystemSignalRef=Led3_State
          Led4_State_oSupA_Led_State_oDBCNetWork_df70c2cf_Tx: ComBitPosition=3, ComHandleId=3, ComSystemTemplateSystemSignalRef=Led4_State
          Led2_State_oSupA_Led_State_oDBCNetWork_13a7b8bc_Tx: ComBitPosition=1, ComHandleId=1, ComSystemTemplateSystemSignalRef=Led2_State
          Led1_State_oSupA_Led_State_oDBCNetWork_987486a5_Tx: ComBitPosition=0, ComHandleId=0, ComSystemTemplateSystemSignalRef=Led1_State
      SupB_Button_Control_oDBCNetWork_0c40490d_Rx (ComIPdu):
        ComIPduDirection = RECEIVE
        ComIPduType = NORMAL
        ComIPduHandleId = 0
        ComIPduSignalProcessing = DEFERRED
        ComIPduCancellationSupport = false
        ComIPduGroupRef = XB_SUP_A_oDBCNetWork_Rx_d3c0144f
        ComIPduSignalGroupRef = SG_Sig_Grp_0x401_oSupB_Button_Control_oDBCNetWork_41809065_Rx
        ComPduIdRef = SupB_Button_Control_oDBCNetWork_0c40490d_Rx
      Sig_0x114_Used_6_oSupA_Function_1_oDBCNetWork_d918db4b_Tx (ComSignal):
        ComBitPosition = 63
        ComBitSize = 8
        ComSignalEndianness = BIG_ENDIAN
        ComSignalInitValue = 0
        ComSignalType = UINT8
        ComTransferProperty = TRIGGERED
        ComSignalAccess = ACCESS_UNCLEAR
        ComHandleId = 17
        ComSystemTemplateSystemSignalRef = Sig_0x114_Used_6
    ComGeneral:
      ComConfigurationUseDet = true
      ComSafeBswChecks = false
      ComEnableSignalGroupArrayApi = false
      ComRetryFailedTransmitRequests = false
      ComSupportedIPduGroups = 2
      ComVersionInfoApi = false
      ComAdvancedIPduCallouts = true
      ComOptimizedIPduGroupHandling = false
      ComMetaDataSupport = false
      ComReceiveSignalMacroAPI = false
      ComDeferredEventCacheSupport = false
      ComMainfunctionTimingDomainSupport = false
      ComSignalGateway = false
      ComDescriptionGateway = false
      ComDescriptionRoutingCodeGeneration = false
      ComUserCbkHeaderFile = Rte_Cbk.h
