AUTOSAR XML (schema 00046)
package /ActiveEcuC
  module config CanNm: implementation-config-variant=VARIANT-PRE-COMPILE, module-description=CanNm_Impl
    CanNmGlobalConfig:
      CanNmPnEiraCalcEnabled = false
      CanNmUserDataEnabled = true
      CanNmBusLoadReductionEnabled = false
      CanNmBusSynchronizationEnabled = false
      CanNmComUserDataSupport = false
      CanNmCoordinatorSyncSupport = false
      CanNmDevErrorDetect = true
      CanNmImmediateTxconfEnabled = false
      CanNmMainFunctionPeriod = 0.005
      CanNmPassiveModeEnabled = false
      CanNmPduRxIndicationEnabled = false
      CanNmRemoteSleepIndEnabled = false
      CanNmStateChangeIndEnabled = false
      CanNmVersionInfoApi = false
      CanNmDisableTxErrReport = false
      CanNmApiOptimization = false
      CanNmCanIfRangeConfigDLCCheck = true
      CanNmRuntimeMeasurementSupport = false
      CanNmSafeBswChecks = false
      CanNmGeneration: CanNmOutOfBoundsWriteSanitizer=false, CanNmOutOfBoundsReadSanitizer=false, CanNmInterfacesForDeactivatedData=false
      DBCNetWork_CAN_9b3bc41d (CanNmChannelConfig):
        CanNmNodeId = 1
        CanNmTimeoutTime = 2
        CanNmUserDataLength = 6
        CanNmWaitBusSleepTime = 2
        CanNmBusLoadReductionActive = false
        CanNmCarWakeUpRxEnabled = false
        CanNmImmediateNmTransmissions = 0
        CanNmMsgCycleOffset = 0
        CanNmMsgCycleTime = 0.1
        CanNmMsgReducedTime = 0.08
        CanNmMsgTimeoutTime = 0.06
        CanNmPduCbvPosition = CANNM_PDU_BYTE_1
        CanNmPduNidPosition = CANNM_PDU_BYTE_0
        CanNmRemoteSleepIndTime = 0.5
        CanNmRepeatMessageTime = 0.4
        CanNmActiveWakeupBitEnabled = false
        CanNmNodeIdEnabled = true
        CanNmNodeDetectionEnabled = false
        CanNmRepeatMsgIndEnabled = false
        CanNmImmediateRestartEnabled = false
        CanNmComControlEnabled = false
        CanNmCriBitAlwaysEnabled = false
        CanNmComMNetworkHandleRef = CN_DBCNetWork_9ed72b09
        DBCNetWork_CAN_9b3bc41d_Rx (CanNmRxPdu): CanNmRxPduId=0, CanNmRxPduRef=XB_SUP_A_17ea32c5_Rx
        Meg_NmTx_oDBCNetWork_5d9e34f5_Tx (CanNmTxPdu): CanNmTxConfirmationPduId=0, CanNmTxPduRef=Meg_NmTx_oDBCNetWork_5d9e34f5_Tx
