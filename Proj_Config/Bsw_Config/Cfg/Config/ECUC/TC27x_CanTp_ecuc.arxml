AUTOSAR XML (schema 00046)
package /ActiveEcuC
  module config CanTp: implementation-config-variant=VARIANT-PRE-COMPILE, module-description=CanTp_Impl
    CanTpGeneral:
      CanTpChangeParameterApi = false
      CanTpDevErrorDetect = true
      CanTpPaddingByte = 204
      CanTpReadParameterApi = false
      CanTpVersionInfoApi = false
      CanTpPaddingActive = true
      CanTpHavePaddingByte = false
      CanTpNumRxChannels = 0
      CanTpNumTxChannels = 0
      CanTpEnableSplitMainFunction = false
      CanTpSupportStandardAddressing = true
      CanTpSupportExtendedAddressing = true
      CanTpSupportMixed11Addressing = true
      CanTpSupportMixed29Addressing = true
      CanTpSupportNormalFixedAddressing = true
      CanTpOnlyNotifyInformedAppl = true
      CanTpRc = false
      CanTpTc = false
      CanTpSafeBswChecks = false
      CanTpEnableConstantBS = true
      CanTpEnableTransmitQueue = false
      CanTpUseOnlyFirstFc = true
      CanTpEnableSynchronousTransmit = true
    CanTpConfig: CanTpMainFunctionPeriod=0.005
      TPCH_6f1a700a (CanTpChannel): CanTpChannelMode=CANTP_MODE_FULL_DUPLEX
        CanTpRxNSdu_ee3c4bd1 (CanTpRxNSdu):
          CanTpRxAddressingFormat = CANTP_STANDARD
          CanTpRxDl = 8
          CanTpRxTaType = CANTP_FUNCTIONAL
          CanTpNbr = 0.1
          CanTpRxNSduId = 0
          CanTpRxPaddingActivation = CANTP_ON
          CanTpRxNSduRef = Meg_FunDiag_oDBCNetWork_245e23dc_Rx
          CanTpRxNPdu_e39092f8 (CanTpRxNPdu): CanTpRxNPduId=1, CanTpRxNPduRef=Meg_FunDiag_Tp_oDBCNetWork_1b821788_Rx
      TPCH_ce641bee (CanTpChannel): CanTpChannelMode=CANTP_MODE_FULL_DUPLEX
        CanTpTxNSdu_a51614e7 (CanTpTxNSdu):
          CanTpTxAddressingFormat = CANTP_STANDARD
          CanTpTxDl = 8
          CanTpTxTaType = CANTP_PHYSICAL
          CanTpNas = 0.1
          CanTpNcs = 0.2
          CanTpTc = false
          CanTpTxNSduId = 0
          CanTpTxPaddingActivation = CANTP_ON
          CanTpNbs = 0.025
          CanTpTxNSduRef = Meg_ResDiag_oDBCNetWork_1336e721_Tx
          CanTpRxFcNPdu_eb22513d (CanTpRxFcNPdu): CanTpRxFcNPduId=0, CanTpRxFcNPduRef=Meg_PhyDiag_Tp_oDBCNetWork_ff3be21a_Rx
          CanTpTxNPdu_eb22513d (CanTpTxNPdu): CanTpTxNPduConfirmationPduId=0, CanTpTxNPduRef=Meg_ResDiag_Tp_oDBCNetWork_4a610c1c_Tx
        CanTpRxNSdu_a51614e7 (CanTpRxNSdu):
          CanTpRxAddressingFormat = CANTP_STANDARD
          CanTpRxDl = 8
          CanTpRxTaType = CANTP_PHYSICAL
          CanTpNbr = 0.1
          CanTpRxNSduId = 1
          CanTpRxPaddingActivation = CANTP_ON
          CanTpBs = 8
          CanTpNar = 0.025
          CanTpNcr = 0.025
          CanTpRxWftMax = 1
          CanTpSTmin = 0.02
          CanTpRxNSduRef = Meg_PhyDiag_oDBCNetWork_e94a8f4d_Rx
          CanTpTxFcNPdu_c9d885cf (CanTpTxFcNPdu): CanTpTxFcNPduConfirmationPduId=0, CanTpTxFcNPduRef=Meg_ResDiag_Tp_oDBCNetWork_4a610c1c_Tx
          CanTpRxNPdu_c9d885cf (CanTpRxNPdu): CanTpRxNPduId=0, CanTpRxNPduRef=Meg_PhyDiag_Tp_oDBCNetWork_ff3be21a_Rx
