AUTOSAR XML (schema 00046)
package /ActiveEcuC
  module config Nm: implementation-config-variant=VARIANT-PRE-COMPILE, module-description=Nm_Impl
    NmGlobalConfig
      NmGlobalFeatures:
        NmBusSynchronizationEnabled = false
        NmNodeIdEnabled = true
        NmUserDataEnabled = true
        NmCarWakeUpRxEnabled = false
        NmComControlEnabled = false
        NmComUserDataSupport = false
        NmCoordinatorSupportEnabled = false
        NmNodeDetectionEnabled = false
        NmPduRxIndicationEnabled = false
        NmRemoteSleepIndEnabled = false
        NmRepeatMsgIndEnabled = false
        NmStateChangeIndEnabled = false
        NmMacroLayerEnabled = false
        NmCoordinatorSyncSupport = false
        NmRuntimeMeasurementSupport = false
        NmCoordinatorRequestChannelsInBusSleep = false
        NmCoordinatorPassiveStartUpForwarding = false
        NmPassiveModeEnabled = false
      NmGeneration:
        NmOutOfBoundsWriteSanitizer = false
        NmOutOfBoundsReadSanitizer = false
        NmShortSymbols = false
        NmInterfacesForDeactivatedData = false
        NmReferringKeysInComments = false
      NmGlobalProperties: NmDevErrorDetect=true, NmVersionInfoApi=false, NmSafeBswChecks=false
      NmGlobalConstants
    CN_DBCNetWork_9ed72b09 (NmChannelConfig):
      NmPassiveModeEnabled = false
      NmChannelId = 0
      NmChannelSleepMaster = false
      NmStateReportEnabled = false
      NmSynchronizingNetwork = false
      NmComMChannelRef = CN_DBCNetWork_9ed72b09
      DBCNetWork_CAN_9b3bc41d (NmBusType)
        NmStandardBusNmConfig: NmStandardBusType=NM_BUSNM_CANNM  # DBCNetWork_CAN
