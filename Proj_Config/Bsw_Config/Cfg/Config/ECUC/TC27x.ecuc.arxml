AUTOSAR XML (schema 00046)
package /ActiveEcuC
  ecuc value collection ActiveEcuC: ecu-extract=SYSTEM
    ecuc-values:
      Com
      Rte
      EcuM
      CanNm
      Os
      PduR
      CanSM
      Nm
      Can
      CanIf
      Det
      ComM
      EcuC
      BswM
      vSet
      vLinkGen
      vBaseEnv
      vBRS
      Dem
      Dcm
      CanTp
      CanTrcv
      E2EPW
      Crc
      Icu
      Irq
      Mcu
      IoHwAb
      Dio
      Port
      Cdd
