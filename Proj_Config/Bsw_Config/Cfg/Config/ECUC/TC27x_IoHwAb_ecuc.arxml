AUTOSAR XML (schema 00046)
package /ActiveEcuC
  module config IoHwAb: implementation-config-variant=VARIANT-PRE-COMPILE, module-description=IoHwAb_Impl
    8 x IoHwAbCSPortInterface, all with IoHwAbTemplate=IoHwAb_Template_None:
      IoHwAbCSIf_Button4
        IoHwAbApplicationError: IoHwAbErrorCode=1
        IoHwAbOp_Button4_Read (IoHwAbOperation)
          IoHwAbOperationArgument: IoHwAbArgDirection=IOHWAB_OUT, IoHwAbOperationArgumentPosition=0, IoHwAbArgTypeRef=boolean
      IoHwAbCSIf_Button3
        IoHwAbApplicationError: IoHwAbErrorCode=1
        IoHwAbOp_Button3_Read (IoHwAbOperation)
          IoHwAbOperationArgument: IoHwAbArgDirection=IOHWAB_OUT, IoHwAbOperationArgumentPosition=0, IoHwAbArgTypeRef=boolean
      IoHwAbCSIf_Button2
        IoHwAbApplicationError: IoHwAbErrorCode=1
        IoHwAbOp_Button2_Read (IoHwAbOperation)
          IoHwAbOperationArgument: IoHwAbArgDirection=IOHWAB_OUT, IoHwAbOperationArgumentPosition=0, IoHwAbArgTypeRef=boolean
      IoHwAbCSIf_Button1
        IoHwAbApplicationError: IoHwAbErrorCode=1
        IoHwAbOp_Button1_Read (IoHwAbOperation)
          IoHwAbOperationArgument: IoHwAbArgDirection=IOHWAB_OUT, IoHwAbOperationArgumentPosition=0, IoHwAbArgTypeRef=boolean
      IoHwAbCSIf_LED4
        IoHwAbOp_LED4_Write (IoHwAbOperation)
          IoHwAbOperationArgument: IoHwAbArgDirection=IOHWAB_IN, IoHwAbOperationArgumentPosition=0, IoHwAbArgTypeRef=boolean
        IoHwAbApplicationError: IoHwAbErrorCode=1
        IoHwAbOp_LED4_Read (IoHwAbOperation)
          IoHwAbOperationArgument: IoHwAbArgDirection=IOHWAB_OUT, IoHwAbOperationArgumentPosition=0, IoHwAbArgTypeRef=boolean
      IoHwAbCSIf_LED3
        IoHwAbOp_LED3_Write (IoHwAbOperation)
          IoHwAbOperationArgument: IoHwAbArgDirection=IOHWAB_IN, IoHwAbOperationArgumentPosition=0, IoHwAbArgTypeRef=boolean
        IoHwAbApplicationError: IoHwAbErrorCode=1
        IoHwAbOp_LED3_Read (IoHwAbOperation)
          IoHwAbOperationArgument: IoHwAbArgDirection=IOHWAB_OUT, IoHwAbOperationArgumentPosition=0, IoHwAbArgTypeRef=boolean
      IoHwAbCSIf_KL15
        IoHwAbApplicationError: IoHwAbErrorCode=1
        IoHwAbOp_KL15_Read (IoHwAbOperation)
          IoHwAbOperationArgument: IoHwAbArgDirection=IOHWAB_OUT, IoHwAbOperationArgumentPosition=0, IoHwAbArgTypeRef=boolean
      IoHwAbCSIf_LED2
        IoHwAbOp_LED2_Write (IoHwAbOperation)
          IoHwAbOperationArgument: IoHwAbArgDirection=IOHWAB_IN, IoHwAbOperationArgumentPosition=0, IoHwAbArgTypeRef=boolean
        IoHwAbApplicationError: IoHwAbErrorCode=1
        IoHwAbOp_LED2_Read (IoHwAbOperation)
          IoHwAbOperationArgument: IoHwAbArgDirection=IOHWAB_OUT, IoHwAbOperationArgumentPosition=0, IoHwAbArgTypeRef=boolean
    IoHwAbDatatypes
      9 x IoHwAbBaseType:
        float64: IoHwAbBaseDataType=IOHWAB_FLOAT64
        float32: IoHwAbBaseDataType=IOHWAB_FLOAT32
        sint32: IoHwAbBaseDataType=IOHWAB_SINT32
        sint16: IoHwAbBaseDataType=IOHWAB_SINT16
        sint8: IoHwAbBaseDataType=IOHWAB_SINT8
        uint32: IoHwAbBaseDataType=IOHWAB_UINT32
        uint16: IoHwAbBaseDataType=IOHWAB_UINT16
        uint8: IoHwAbBaseDataType=IOHWAB_UINT8
        boolean: IoHwAbBaseDataType=IOHWAB_BOOL
      IoHwAbImplementationTypes
    IoHwAbGeneral: IoHwAbDevErrorDetect=true, IoHwAbVersionInfoApi=false, IoHwAbUseInitFunction=true
    IoHwAbCSIf_LED1 (IoHwAbCSPortInterface): IoHwAbTemplate=IoHwAb_Template_None
      IoHwAbOp_LED1_Write (IoHwAbOperation)
        IoHwAbOperationArgument: IoHwAbArgDirection=IOHWAB_IN, IoHwAbOperationArgumentPosition=0, IoHwAbArgTypeRef=boolean
      IoHwAbApplicationError: IoHwAbErrorCode=1
      IoHwAbOp_LED1_Read (IoHwAbOperation)
        IoHwAbOperationArgument: IoHwAbArgDirection=IOHWAB_OUT, IoHwAbOperationArgumentPosition=0, IoHwAbArgTypeRef=boolean
    9 x IoHwAbCSPortPrototype, all with IoHwAbCSDirection=IOHWAB_SERVER:
      IoHwAbCS_LED{1..4}: IoHwAbCSPortInterfaceRef=IoHwAbCSIf_LED{1..4}
      IoHwAbCS_Button{1..4}: IoHwAbCSPortInterfaceRef=IoHwAbCSIf_Button{1..4}
      IoHwAbCS_KL15: IoHwAbCSPortInterfaceRef=IoHwAbCSIf_KL15
    IoHwAbRunnable: IoHwAbTriggerPeriod=5, IoHwAbTimebase=IoHwAbMSec
