AUTOSAR XML (schema 00046)
package /ActiveEcuC
  module config Dem: implementation-config-variant=VARIANT-PRE-COMPILE, module-description=Dem_Impl
    DemConfigSet
      DTCClass_DTC_0x402011 (DemDTCClass): DemUdsDTC=4202513, DemImmediateNvStorage=false
      DTC_0x402011 (DemEventParameter):
        DemEventKind = DEM_EVENT_KIND_SWC
        DemEventTimeSeries = DEM_TIMESERIES_SNAPSHOT_NONE
        DemEventAvailable = true
        DemEventId = 1
        DemEventAvailableInVariant = true
        DemEventLatchTestFailed = false
        DemEventCreateInfoPort = true
        DemDTCClassRef = DTCClass_DTC_0x402011
        DemEventClass:
          DemEventDestination = DEM_DTC_ORIGIN_PRIMARY_MEMORY
          DemEventSignificance = DEM_EVENT_SIGNIFICANCE_FAULT
          DemAgingAllowed = false
          DemConsiderPtoStatus = false
          DemEventPriority = 2
          DemFFPrestorageSupported = false
          DemAgingCycleRef = PowerCycle
          DemOperationCycleRef = PowerCycle
          DemDebounceAlgorithmClass
            DemDebounceMonitorInternal
              DemCallbackGetFDC
    DemGeneral:
      DemAgingCycleCounterProcessing = DEM_PROCESS_AGINGCTR_INTERN
      DemDtcStatusAvailabilityMask = 127
      DemMaxNumberEventEntryMirror = 0
      DemPTOSupport = false
      DemTypeOfFreezeFrameRecordNumeration = DEM_FF_RECNUM_CALCULATED
      DemGeneralInterfaceSupport = false
      DemDataElementDefaultEndianness = LITTLE_ENDIAN
      DemAgingRequieresTestedCycle = false
      DemTriggerMonitorInitBeforeClearOk = true
      DemExtendedDataCapture = DEM_TRIGGER_EVENT_MEMORY_STORAGE
      DemFreezeFrameCapture = DEM_TRIGGER_EVENT_MEMORY_STORAGE
      DemOperationCycleProcessing = DEM_PROCESS_OPCYC_STATE
      DemMaxNumberTimeSeriesSnapshots = 0
      DemAvailabilitySupport = DEM_NO_AVAILABILITY
      DemAvailabilityStorage = false
      DemBswErrorBufferSize = 0
      DemClearDTCBehavior = DEM_CLRRESP_VOLATILE
      DemClearDTCLimitation = DEM_ALL_SUPPORTED_DTCS
      DemDebounceCounterBasedSupport = true
      DemDebounceTimeBasedSupport = false
      DemDevErrorDetect = true
      DemEnableConditionSupport = false
      DemEventCombinationSupport = DEM_EVCOMB_DISABLED
      DemEventDisplacementStrategy = DEM_DISPLACEMENT_LEGACY_403
      DemEventMemoryEntryStorageTrigger = DEM_STORAGE_ON_TEST_FAILED
      DemMaxNumberEventEntryOBDFreezeFrame = 0
      DemMaxNumberEventEntryPermanent = 0
      DemMaxNumberEventEntryPrimary = 8
      DemMaxNumberEventEntrySecondary = 0
      DemMaxNumberPrestoredFF = 0
      DemOBDSupport = DEM_OBD_NO_OBD_SUPPORT
      DemOccurrenceCounterProcessing = DEM_PROCESS_OCCCTR_TF
      DemOperationCycleStatusStorage = false
      DemResetConfirmedBitOnOverflow = true
      DemStatusBitHandlingTestFailedSinceLastClear = DEM_STATUS_BIT_NORMAL
      DemStatusBitStorageTestFailed = true
      DemStorageConditionSupport = false
      DemSuppressionSupport = DEM_NO_SUPPRESSION
      DemTaskTime = 0.005
      DemTriggerDcmReports = false
      DemTriggerDltReports = false
      DemTriggerFiMReports = false
      DemTriggerFiMReportsExtended = false
      DemTriggerMonitorInitForEnableConditions = false
      DemTypeOfDTCSupported = DEM_DTC_TRANSLATION_ISO14229_1
      DemVersionInfoApi = false
      DemBswApiVersion = DEM_BSW_API_4_XX_XX
      DemBswApiVersionNvM = DEM_BSW_API_4_XX_XX
      DemBswApiVersionFiM = DEM_BSW_API_4_XX_XX
      DemAgingAfterHealing = DEM_AGING_WHILE_HEALING
      DemAgingBehavior = DEM_AGING_TYPE_1
      DemAgingCounterBehavior = DEM_AGING_COUNT_ALWAYS
      DemAgingCounterReporting = DEM_AGING_NORMAL_REPORTING
      DemAgingRetainEnvironmentalData = false
      DemCompiledPostbuildCrc = 553938695
      DemCompiledPostbuildCrcMode = DEM_POSTBUILD_CRC_AUTOMATIC
      DemEventDisplacementFallbackStrategy = DEM_FALLBACK_DISCARD_NEW_EVENT
      DemGeneralDiagnosticInfoSupport = true
      DemJ1939Support = false
      DemNvSynchronizeSupport = false
      DemPendingDtcProcessing = DEM_PROCESS_PDTC_STOREDONLY
      DemResetDebounceBehavior = DEM_RESET_DEBOUNCE_ON_DISABLE_ENABLE_CONDITIONS
      DemResetTestFailedOnOperationCycleStart = false
      DemRetryStorageSupport = false
      DemSafeBswChecks = false
      DemUseMemcopyMacros = false
      DemUseRte = true
      DemUserControlledWirBehavior = DEM_ENABLED_DURING_CONTROLDTCSETTING
      DemUserDefinedCompareAndSwap = false
      DemWarningIndicatorRequestedProcessing = DEM_PROCESS_WIR_STOREDONLY
      DemUseMultiPartitionFiM = false
      DemReportSuppressedDTCsInService19x0A = false
      DemSupportAgingForAllDTCs = false
      DemLatchTestFailedBehavior = DEM_LATCH_TF_CONFIRMED_AND_THIS_CYCLE
      DemImmediateNvStorageSupport = true
      DemUseNvm = false
      DemPostbuild: DemEventAvailableDefaultSupport=true, DemMaxSizeFreezeFrame=0, DemMaxNumberDtr=0, DemMaxSizeGlobalFreezeFrame=0
      PowerCycle (DemOperationCycle): DemOperationCycleType=DEM_OPCYC_POWER, DemOperationCycleAutomaticEnd=false, DemOperationCycleAutostart=false
      DemEventMemorySet
      DemClient: DemClientId=0
