AUTOSAR XML (schema 00046)
package /ComponentTypes
  complex device driver sw component type IoCtrl
    behavior IoCtrl_InternalBehavior
      timing event TMT_IoCtrl_MainFunction: start-on-event=IoCtrl_MainFunction, period=0.01
      runnable IoCtrl_MainFunction
  swc implementation IoCtrl_Implementation: behavior=IoCtrl_InternalBehavior
