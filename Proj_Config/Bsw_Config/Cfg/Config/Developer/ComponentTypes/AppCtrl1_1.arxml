AUTOSAR XML (schema 00046)
package /ComponentTypes
  application sw component type AppCtrl1
    behavior AppCtrl1_InternalBehavior
      timing event TMT_AppCtrl1_MainFuntion: start-on-event=AppCtrl1_MainFuntion, period=0.01
      runnable AppCtrl1_MainFuntion
  swc implementation AppCtrl1_Implementation: behavior=AppCtrl1_InternalBehavior
