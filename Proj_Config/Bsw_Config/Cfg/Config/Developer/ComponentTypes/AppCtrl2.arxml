AUTOSAR XML (schema 00046)
package /ComponentTypes
  application sw component type AppCtrl2
    behavior AppCtrl2_InternalBehavior
      timing event TMT_AppCtrl2_MainFunction: start-on-event=AppCtrl2_MainFunction, period=0.01
      runnable AppCtrl2_MainFunction
  swc implementation AppCtrl2_Implementation: behavior=AppCtrl2_InternalBehavior
