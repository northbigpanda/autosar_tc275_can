AUTOSAR XML (schema 00046)
package /ComponentTypes
  complex device driver sw component type IoHwAb
    behavior IoHwAb_InternalBehavior
      timing event TMT_IoHwAb_MainFunction: start-on-event=AppIoHwAb_MainFunction, period=0.01
      runnable AppIoHwAb_MainFunction: symbol=IoHwAb_MainFunction
  swc implementation IoHwAb_Implementation: behavior=IoHwAb_InternalBehavior
